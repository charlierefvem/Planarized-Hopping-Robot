/******************************************************************************
* ASAP2 file: PHRControl.a2l
* Academic License - for use in teaching, academic research, and meeting
* course requirements at degree granting institutions only. Not for
* government, commercial, or other organizational use.
* Code generation for model "PHRControl".
* Model version : 1.67
* Simulink Coder version : 10.5 R2022a
* C source code generated on : Thu Aug 11 15:04:33 2022
* Target selection: slrealtime.tlc
* Embedded hardware selection: Intel->x86-64 (Linux 64)
* Code generation objectives: Unspecified
* Validation result: Not run
* (add additional file header information here)
******************************************************************************/ ASAP2_VERSION 1 71
/begin PROJECT ProjectName "Project Comment Goes Here"
/begin HEADER "Header Comments go here" /end HEADER
/begin MODULE ModuleName "Module Comment Goes Here"
/begin IF_DATA XCP
 /begin PROTOCOL_LAYER 0x0100 0x03E8 0x00C8 0x0000 0x0000 0x0000 0x0000 0x0000 0xFC 0x0578 BYTE_ORDER_MSB_LAST ADDRESS_GRANULARITY_BYTE OPTIONAL_CMD ALLOC_ODT_ENTRY OPTIONAL_CMD ALLOC_ODT OPTIONAL_CMD ALLOC_DAQ OPTIONAL_CMD FREE_DAQ OPTIONAL_CMD GET_DAQ_CLOCK OPTIONAL_CMD GET_DAQ_RESOLUTION_INFO OPTIONAL_CMD GET_DAQ_PROCESSOR_INFO OPTIONAL_CMD START_STOP_SYNCH OPTIONAL_CMD START_STOP_DAQ_LIST OPTIONAL_CMD SET_DAQ_LIST_MODE OPTIONAL_CMD WRITE_DAQ OPTIONAL_CMD SET_DAQ_PTR OPTIONAL_CMD GET_CAL_PAGE OPTIONAL_CMD SET_CAL_PAGE OPTIONAL_CMD COPY_CAL_PAGE OPTIONAL_CMD SHORT_DOWNLOAD OPTIONAL_CMD DOWNLOAD_MAX OPTIONAL_CMD DOWNLOAD OPTIONAL_CMD SHORT_UPLOAD OPTIONAL_CMD UPLOAD OPTIONAL_CMD SET_MTA OPTIONAL_CMD GET_SEGMENT_INFO OPTIONAL_CMD GET_PAGE_INFO OPTIONAL_CMD SET_SEGMENT_MODE OPTIONAL_CMD GET_SEGMENT_MODE OPTIONAL_CMD GET_PAG_PROCESSOR_INFO OPTIONAL_CMD MODIFY_BITS /end PROTOCOL_LAYER
 /begin DAQ DYNAMIC 0x0000 0x0080 0x00 OPTIMISATION_TYPE_DEFAULT ADDRESS_EXTENSION_FREE IDENTIFICATION_FIELD_TYPE_RELATIVE_WORD_ALIGNED GRANULARITY_ODT_ENTRY_SIZE_DAQ_BYTE 0xFF OVERLOAD_INDICATION_PID PRESCALER_SUPPORTED /begin STIM GRANULARITY_ODT_ENTRY_SIZE_STIM_BYTE 0xFF /end STIM /begin TIMESTAMP_SUPPORTED 0x0001 SIZE_DWORD UNIT_1US TIMESTAMP_FIXED /end TIMESTAMP_SUPPORTED /begin EVENT "5 ms" "5 ms" 0x0000 DAQ 0xFF 0x05 0x06 0x00 /end EVENT /end DAQ
 /begin XCP_ON_UDP_IP 0x0100 0x15B3 ADDRESS "192.168.7.5" /end XCP_ON_UDP_IP
/end IF_DATA
/begin MOD_PAR "MOD PAR Comment Goes Here"
 /begin MEMORY_SEGMENT PHRControl_cal_impl "PHRControl_cal_impl" DATA FLASH INTERN 0x0021B020 0xDB8 -1 -1 -1 -1 -1
  /begin IF_DATA XCP
   /begin SEGMENT 0x00 0x02 0x00 0x00 0x00
    /begin PAGE 0x00 ECU_ACCESS_DONT_CARE XCP_READ_ACCESS_DONT_CARE XCP_WRITE_ACCESS_NOT_ALLOWED /end PAGE
    /begin PAGE 0x01 ECU_ACCESS_DONT_CARE XCP_READ_ACCESS_DONT_CARE XCP_WRITE_ACCESS_DONT_CARE /end PAGE
   /end SEGMENT
  /end IF_DATA
 /end MEMORY_SEGMENT
/end MOD_PAR
/begin MOD_COMMON "Mod Common Comment Here" BYTE_ORDER MSB_LAST ALIGNMENT_BYTE 1 ALIGNMENT_WORD 2 ALIGNMENT_LONG 4 ALIGNMENT_FLOAT32_IEEE 4 ALIGNMENT_FLOAT64_IEEE 8 ALIGNMENT_INT64 8 /end MOD_COMMON
/begin CHARACTERISTIC PHRControl_cal_impl.CANRead_P1 "" VAL_BLK 0x0021B4B0 Scalar_FLOAT64_IEEE 0 PHRControl_CM_double -1.7E+308 1.7E+308 MATRIX_DIM 7 1 /end CHARACTERISTIC
/begin CHARACTERISTIC PHRControl_cal_impl.CANSetup_P1 "" VAL_BLK 0x0021B6A8 Scalar_FLOAT64_IEEE 0 PHRControl_CM_double -1.7E+308 1.7E+308 MATRIX_DIM 40 1 /end CHARACTERISTIC
/begin CHARACTERISTIC PHRControl_cal_impl.CANSetup_P2 "" VALUE 0x0021B7F8 Scalar_FLOAT64_IEEE 0 PHRControl_CM_double -1.7E+308 1.7E+308 /end CHARACTERISTIC
/begin CHARACTERISTIC PHRControl_cal_impl.CANSetup_P3 "" VALUE 0x0021B810 Scalar_FLOAT64_IEEE 0 PHRControl_CM_double -1.7E+308 1.7E+308 /end CHARACTERISTIC
/begin CHARACTERISTIC PHRControl_cal_impl.CANStatus_P1 "" VALUE 0x0021B890 Scalar_FLOAT64_IEEE 0 PHRControl_CM_double -1.7E+308 1.7E+308 /end CHARACTERISTIC
/begin CHARACTERISTIC PHRControl_cal_impl.CANStatus_P10 "" VALUE 0x0021B968 Scalar_FLOAT64_IEEE 0 PHRControl_CM_double -1.7E+308 1.7E+308 /end CHARACTERISTIC
/begin CHARACTERISTIC PHRControl_cal_impl.CANStatus_P11 "" VALUE 0x0021B980 Scalar_FLOAT64_IEEE 0 PHRControl_CM_double -1.7E+308 1.7E+308 /end CHARACTERISTIC
/begin CHARACTERISTIC PHRControl_cal_impl.CANStatus_P12 "" VALUE 0x0021B998 Scalar_FLOAT64_IEEE 0 PHRControl_CM_double -1.7E+308 1.7E+308 /end CHARACTERISTIC
/begin CHARACTERISTIC PHRControl_cal_impl.CANStatus_P13 "" VALUE 0x0021B9B0 Scalar_FLOAT64_IEEE 0 PHRControl_CM_double -1.7E+308 1.7E+308 /end CHARACTERISTIC
/begin CHARACTERISTIC PHRControl_cal_impl.CANStatus_P14 "" VALUE 0x0021B9C8 Scalar_FLOAT64_IEEE 0 PHRControl_CM_double -1.7E+308 1.7E+308 /end CHARACTERISTIC
/begin CHARACTERISTIC PHRControl_cal_impl.CANStatus_P15 "" VALUE 0x0021B9E0 Scalar_FLOAT64_IEEE 0 PHRControl_CM_double -1.7E+308 1.7E+308 /end CHARACTERISTIC
/begin CHARACTERISTIC PHRControl_cal_impl.CANStatus_P16 "" VALUE 0x0021B9F8 Scalar_FLOAT64_IEEE 0 PHRControl_CM_double -1.7E+308 1.7E+308 /end CHARACTERISTIC
/begin CHARACTERISTIC PHRControl_cal_impl.CANStatus_P17 "" VALUE 0x0021BA10 Scalar_FLOAT64_IEEE 0 PHRControl_CM_double -1.7E+308 1.7E+308 /end CHARACTERISTIC
/begin CHARACTERISTIC PHRControl_cal_impl.CANStatus_P18 "" VALUE 0x0021BA28 Scalar_FLOAT64_IEEE 0 PHRControl_CM_double -1.7E+308 1.7E+308 /end CHARACTERISTIC
/begin CHARACTERISTIC PHRControl_cal_impl.CANStatus_P19 "" VALUE 0x0021BA40 Scalar_FLOAT64_IEEE 0 PHRControl_CM_double -1.7E+308 1.7E+308 /end CHARACTERISTIC
/begin CHARACTERISTIC PHRControl_cal_impl.CANStatus_P2 "" VALUE 0x0021B8A8 Scalar_FLOAT64_IEEE 0 PHRControl_CM_double -1.7E+308 1.7E+308 /end CHARACTERISTIC
/begin CHARACTERISTIC PHRControl_cal_impl.CANStatus_P20 "" VALUE 0x0021BA58 Scalar_FLOAT64_IEEE 0 PHRControl_CM_double -1.7E+308 1.7E+308 /end CHARACTERISTIC
/begin CHARACTERISTIC PHRControl_cal_impl.CANStatus_P21 "" VALUE 0x0021BA70 Scalar_FLOAT64_IEEE 0 PHRControl_CM_double -1.7E+308 1.7E+308 /end CHARACTERISTIC
/begin CHARACTERISTIC PHRControl_cal_impl.CANStatus_P22 "" VALUE 0x0021BA88 Scalar_FLOAT64_IEEE 0 PHRControl_CM_double -1.7E+308 1.7E+308 /end CHARACTERISTIC
/begin CHARACTERISTIC PHRControl_cal_impl.CANStatus_P23 "" VALUE 0x0021BAA0 Scalar_FLOAT64_IEEE 0 PHRControl_CM_double -1.7E+308 1.7E+308 /end CHARACTERISTIC
/begin CHARACTERISTIC PHRControl_cal_impl.CANStatus_P24 "" VALUE 0x0021BAB8 Scalar_FLOAT64_IEEE 0 PHRControl_CM_double -1.7E+308 1.7E+308 /end CHARACTERISTIC
/begin CHARACTERISTIC PHRControl_cal_impl.CANStatus_P25 "" VALUE 0x0021BAD0 Scalar_FLOAT64_IEEE 0 PHRControl_CM_double -1.7E+308 1.7E+308 /end CHARACTERISTIC
/begin CHARACTERISTIC PHRControl_cal_impl.CANStatus_P26 "" VALUE 0x0021BAE8 Scalar_FLOAT64_IEEE 0 PHRControl_CM_double -1.7E+308 1.7E+308 /end CHARACTERISTIC
/begin CHARACTERISTIC PHRControl_cal_impl.CANStatus_P27 "" VALUE 0x0021BB00 Scalar_FLOAT64_IEEE 0 PHRControl_CM_double -1.7E+308 1.7E+308 /end CHARACTERISTIC
/begin CHARACTERISTIC PHRControl_cal_impl.CANStatus_P28 "" VALUE 0x0021BB18 Scalar_FLOAT64_IEEE 0 PHRControl_CM_double -1.7E+308 1.7E+308 /end CHARACTERISTIC
/begin CHARACTERISTIC PHRControl_cal_impl.CANStatus_P29 "" VALUE 0x0021BB30 Scalar_FLOAT64_IEEE 0 PHRControl_CM_double -1.7E+308 1.7E+308 /end CHARACTERISTIC
/begin CHARACTERISTIC PHRControl_cal_impl.CANStatus_P3 "" VALUE 0x0021B8C0 Scalar_FLOAT64_IEEE 0 PHRControl_CM_double -1.7E+308 1.7E+308 /end CHARACTERISTIC
/begin CHARACTERISTIC PHRControl_cal_impl.CANStatus_P30 "" VALUE 0x0021BB48 Scalar_FLOAT64_IEEE 0 PHRControl_CM_double -1.7E+308 1.7E+308 /end CHARACTERISTIC
/begin CHARACTERISTIC PHRControl_cal_impl.CANStatus_P31 "" VALUE 0x0021BB60 Scalar_FLOAT64_IEEE 0 PHRControl_CM_double -1.7E+308 1.7E+308 /end CHARACTERISTIC
/begin CHARACTERISTIC PHRControl_cal_impl.CANStatus_P32 "" VALUE 0x0021BB78 Scalar_FLOAT64_IEEE 0 PHRControl_CM_double -1.7E+308 1.7E+308 /end CHARACTERISTIC
/begin CHARACTERISTIC PHRControl_cal_impl.CANStatus_P33 "" VALUE 0x0021BB90 Scalar_FLOAT64_IEEE 0 PHRControl_CM_double -1.7E+308 1.7E+308 /end CHARACTERISTIC
/begin CHARACTERISTIC PHRControl_cal_impl.CANStatus_P34 "" VALUE 0x0021BBA8 Scalar_FLOAT64_IEEE 0 PHRControl_CM_double -1.7E+308 1.7E+308 /end CHARACTERISTIC
/begin CHARACTERISTIC PHRControl_cal_impl.CANStatus_P4 "" VALUE 0x0021B8D8 Scalar_FLOAT64_IEEE 0 PHRControl_CM_double -1.7E+308 1.7E+308 /end CHARACTERISTIC
/begin CHARACTERISTIC PHRControl_cal_impl.CANStatus_P5 "" VALUE 0x0021B8F0 Scalar_FLOAT64_IEEE 0 PHRControl_CM_double -1.7E+308 1.7E+308 /end CHARACTERISTIC
/begin CHARACTERISTIC PHRControl_cal_impl.CANStatus_P6 "" VALUE 0x0021B908 Scalar_FLOAT64_IEEE 0 PHRControl_CM_double -1.7E+308 1.7E+308 /end CHARACTERISTIC
/begin CHARACTERISTIC PHRControl_cal_impl.CANStatus_P7 "" VALUE 0x0021B920 Scalar_FLOAT64_IEEE 0 PHRControl_CM_double -1.7E+308 1.7E+308 /end CHARACTERISTIC
/begin CHARACTERISTIC PHRControl_cal_impl.CANStatus_P8 "" VALUE 0x0021B938 Scalar_FLOAT64_IEEE 0 PHRControl_CM_double -1.7E+308 1.7E+308 /end CHARACTERISTIC
/begin CHARACTERISTIC PHRControl_cal_impl.CANStatus_P9 "" VALUE 0x0021B950 Scalar_FLOAT64_IEEE 0 PHRControl_CM_double -1.7E+308 1.7E+308 /end CHARACTERISTIC
/begin CHARACTERISTIC PHRControl_cal_impl.CANWrite1_P1 "" VAL_BLK 0x0021B320 Scalar_FLOAT64_IEEE 0 PHRControl_CM_double -1.7E+308 1.7E+308 MATRIX_DIM 8 1 /end CHARACTERISTIC
/begin CHARACTERISTIC PHRControl_cal_impl.CANWrite1_P1_l "" VAL_BLK 0x0021B420 Scalar_FLOAT64_IEEE 0 PHRControl_CM_double -1.7E+308 1.7E+308 MATRIX_DIM 8 1 /end CHARACTERISTIC
/begin CHARACTERISTIC PHRControl_cal_impl.CANWrite1_P1_o "" VAL_BLK 0x0021B3C8 Scalar_FLOAT64_IEEE 0 PHRControl_CM_double -1.7E+308 1.7E+308 MATRIX_DIM 8 1 /end CHARACTERISTIC
/begin CHARACTERISTIC PHRControl_cal_impl.CANWrite2_P1 "" VAL_BLK 0x0021B370 Scalar_FLOAT64_IEEE 0 PHRControl_CM_double -1.7E+308 1.7E+308 MATRIX_DIM 8 1 /end CHARACTERISTIC
/begin CHARACTERISTIC PHRControl_cal_impl.CPR "" VALUE 0x0021B020 Scalar_FLOAT64_IEEE 0 PHRControl_CM_double -1.7E+308 1.7E+308 /end CHARACTERISTIC
/begin CHARACTERISTIC PHRControl_cal_impl.Constant1_Value "" VALUE 0x0021B578 Scalar_FLOAT64_IEEE 0 PHRControl_CM_double -1.7E+308 1.7E+308 /end CHARACTERISTIC
/begin CHARACTERISTIC PHRControl_cal_impl.Constant1_Value_d "" VAL_BLK 0x0021BC3B Scalar_UBYTE 0 PHRControl_CM_uint8 0 255 MATRIX_DIM 8 1 /end CHARACTERISTIC
/begin CHARACTERISTIC PHRControl_cal_impl.Constant1_Value_n "" VAL_BLK 0x0021BC23 Scalar_UBYTE 0 PHRControl_CM_uint8 0 255 MATRIX_DIM 8 1 /end CHARACTERISTIC
/begin CHARACTERISTIC PHRControl_cal_impl.Constant1_Value_p "" VALUE 0x0021B678 Scalar_FLOAT64_IEEE 0 PHRControl_CM_double -1.7E+308 1.7E+308 /end CHARACTERISTIC
/begin CHARACTERISTIC PHRControl_cal_impl.Constant2_Value "" VALUE 0x0021B518 Scalar_FLOAT64_IEEE 0 PHRControl_CM_double -1.7E+308 1.7E+308 /end CHARACTERISTIC
/begin CHARACTERISTIC PHRControl_cal_impl.Constant2_Value_e "" VALUE 0x0021B5B0 Scalar_FLOAT64_IEEE 0 PHRControl_CM_double -1.7E+308 1.7E+308 /end CHARACTERISTIC
/begin CHARACTERISTIC PHRControl_cal_impl.Constant2_Value_ea "" VALUE 0x0021B650 Scalar_FLOAT64_IEEE 0 PHRControl_CM_double -1.7E+308 1.7E+308 /end CHARACTERISTIC
/begin CHARACTERISTIC PHRControl_cal_impl.Constant2_Value_f "" VALUE 0x0021B660 Scalar_FLOAT64_IEEE 0 PHRControl_CM_double -1.7E+308 1.7E+308 /end CHARACTERISTIC
/begin CHARACTERISTIC PHRControl_cal_impl.Constant2_Value_g "" VAL_BLK 0x0021BC2B Scalar_UBYTE 0 PHRControl_CM_uint8 0 255 MATRIX_DIM 8 1 /end CHARACTERISTIC
/begin CHARACTERISTIC PHRControl_cal_impl.Constant2_Value_h "" VALUE 0x0021B568 Scalar_FLOAT64_IEEE 0 PHRControl_CM_double -1.7E+308 1.7E+308 /end CHARACTERISTIC
/begin CHARACTERISTIC PHRControl_cal_impl.Constant2_Value_hf "" VALUE 0x0021B878 Scalar_FLOAT64_IEEE 0 PHRControl_CM_double -1.7E+308 1.7E+308 /end CHARACTERISTIC
/begin CHARACTERISTIC PHRControl_cal_impl.Constant2_Value_j "" VALUE 0x0021B5D8 Scalar_FLOAT64_IEEE 0 PHRControl_CM_double -1.7E+308 1.7E+308 /end CHARACTERISTIC
/begin CHARACTERISTIC PHRControl_cal_impl.Constant2_Value_n "" VALUE 0x0021B580 Scalar_FLOAT64_IEEE 0 PHRControl_CM_double -1.7E+308 1.7E+308 /end CHARACTERISTIC
/begin CHARACTERISTIC PHRControl_cal_impl.Constant2_Value_o "" VALUE 0x0021B620 Scalar_FLOAT64_IEEE 0 PHRControl_CM_double -1.7E+308 1.7E+308 /end CHARACTERISTIC
/begin CHARACTERISTIC PHRControl_cal_impl.Constant2_Value_of "" VAL_BLK 0x0021BC43 Scalar_UBYTE 0 PHRControl_CM_uint8 0 255 MATRIX_DIM 8 1 /end CHARACTERISTIC
/begin CHARACTERISTIC PHRControl_cal_impl.Constant2_Value_p "" VALUE 0x0021B5F8 Scalar_FLOAT64_IEEE 0 PHRControl_CM_double -1.7E+308 1.7E+308 /end CHARACTERISTIC
/begin CHARACTERISTIC PHRControl_cal_impl.Constant3_Value "" VALUE 0x0021B3B0 Scalar_FLOAT64_IEEE 0 PHRControl_CM_double -1.7E+308 1.7E+308 /end CHARACTERISTIC
/begin CHARACTERISTIC PHRControl_cal_impl.Constant3_Value_e "" VALUE 0x0021B408 Scalar_FLOAT64_IEEE 0 PHRControl_CM_double -1.7E+308 1.7E+308 /end CHARACTERISTIC
/begin CHARACTERISTIC PHRControl_cal_impl.Constant3_Value_m "" VALUE 0x0021B670 Scalar_FLOAT64_IEEE 0 PHRControl_CM_double -1.7E+308 1.7E+308 /end CHARACTERISTIC
/begin CHARACTERISTIC PHRControl_cal_impl.Constant4_Value "" VALUE 0x0021B680 Scalar_FLOAT64_IEEE 0 PHRControl_CM_double -1.7E+308 1.7E+308 /end CHARACTERISTIC
/begin CHARACTERISTIC PHRControl_cal_impl.Constant5_Value "" VALUE 0x0021B688 Scalar_FLOAT64_IEEE 0 PHRControl_CM_double -1.7E+308 1.7E+308 /end CHARACTERISTIC
/begin CHARACTERISTIC PHRControl_cal_impl.Constant6_Value "" VALUE 0x0021B690 Scalar_FLOAT64_IEEE 0 PHRControl_CM_double -1.7E+308 1.7E+308 /end CHARACTERISTIC
/begin CHARACTERISTIC PHRControl_cal_impl.Constant7_Value "" VALUE 0x0021B530 Scalar_FLOAT64_IEEE 0 PHRControl_CM_double -1.7E+308 1.7E+308 /end CHARACTERISTIC
/begin CHARACTERISTIC PHRControl_cal_impl.Constant8_Value "" VALUE 0x0021B520 Scalar_FLOAT64_IEEE 0 PHRControl_CM_double -1.7E+308 1.7E+308 /end CHARACTERISTIC
/begin CHARACTERISTIC PHRControl_cal_impl.Constant8_Value_d "" VALUE 0x0021B658 Scalar_FLOAT64_IEEE 0 PHRControl_CM_double -1.7E+308 1.7E+308 /end CHARACTERISTIC
/begin CHARACTERISTIC PHRControl_cal_impl.Constant9_Value "" VALUE 0x0021B528 Scalar_FLOAT64_IEEE 0 PHRControl_CM_double -1.7E+308 1.7E+308 /end CHARACTERISTIC
/begin CHARACTERISTIC PHRControl_cal_impl.Constant_Value "" VALUE 0x0021B570 Scalar_FLOAT64_IEEE 0 PHRControl_CM_double -1.7E+308 1.7E+308 /end CHARACTERISTIC
/begin CHARACTERISTIC PHRControl_cal_impl.Constant_Value_c "" VALUE 0x0021B668 Scalar_FLOAT64_IEEE 0 PHRControl_CM_double -1.7E+308 1.7E+308 /end CHARACTERISTIC
/begin CHARACTERISTIC PHRControl_cal_impl.Constant_Value_f "" VALUE 0x0021B5A8 Scalar_FLOAT64_IEEE 0 PHRControl_CM_double -1.7E+308 1.7E+308 /end CHARACTERISTIC
/begin CHARACTERISTIC PHRControl_cal_impl.Constant_Value_fg "" VAL_BLK 0x0021BC1B Scalar_UBYTE 0 PHRControl_CM_uint8 0 255 MATRIX_DIM 8 1 /end CHARACTERISTIC
/begin CHARACTERISTIC PHRControl_cal_impl.Constant_Value_g "" VALUE 0x0021BC1A Scalar_UBYTE 0 PHRControl_CM_uint8 0 255 /end CHARACTERISTIC
/begin CHARACTERISTIC PHRControl_cal_impl.Constant_Value_k "" VAL_BLK 0x0021BC33 Scalar_UBYTE 0 PHRControl_CM_uint8 0 255 MATRIX_DIM 8 1 /end CHARACTERISTIC
/begin CHARACTERISTIC PHRControl_cal_impl.Constant_Value_l "" VALUE 0x0021B648 Scalar_FLOAT64_IEEE 0 PHRControl_CM_double -1.7E+308 1.7E+308 /end CHARACTERISTIC
/begin CHARACTERISTIC PHRControl_cal_impl.DataStoreMemory12_InitialValue "" VALUE 0x0021BBB8 Scalar_FLOAT64_IEEE 0 PHRControl_CM_double -1.7E+308 1.7E+308 /end CHARACTERISTIC
/begin CHARACTERISTIC PHRControl_cal_impl.DataStoreMemory13_InitialValue "" VALUE 0x0021BBC0 Scalar_FLOAT64_IEEE 0 PHRControl_CM_double -1.7E+308 1.7E+308 /end CHARACTERISTIC
/begin CHARACTERISTIC PHRControl_cal_impl.DataStoreMemory14_InitialValue "" VALUE 0x0021BBC8 Scalar_FLOAT64_IEEE 0 PHRControl_CM_double -1.7E+308 1.7E+308 /end CHARACTERISTIC
/begin CHARACTERISTIC PHRControl_cal_impl.DataStoreMemory15_InitialValue "" VALUE 0x0021BBD0 Scalar_FLOAT64_IEEE 0 PHRControl_CM_double -1.7E+308 1.7E+308 /end CHARACTERISTIC
/begin CHARACTERISTIC PHRControl_cal_impl.DataStoreMemory16_InitialValue "" VALUE 0x0021BBD8 Scalar_FLOAT64_IEEE 0 PHRControl_CM_double -1.7E+308 1.7E+308 /end CHARACTERISTIC
/begin CHARACTERISTIC PHRControl_cal_impl.DataStoreMemory1_InitialValue "" VALUE 0x0021BBB0 Scalar_FLOAT64_IEEE 0 PHRControl_CM_double -1.7E+308 1.7E+308 /end CHARACTERISTIC
/begin CHARACTERISTIC PHRControl_cal_impl.DataStoreMemory2_InitialValue "" VALUE 0x0021BBE0 Scalar_FLOAT64_IEEE 0 PHRControl_CM_double -1.7E+308 1.7E+308 /end CHARACTERISTIC
/begin CHARACTERISTIC PHRControl_cal_impl.DataStoreMemory3_InitialValue "" VALUE 0x0021BBE8 Scalar_FLOAT64_IEEE 0 PHRControl_CM_double -1.7E+308 1.7E+308 /end CHARACTERISTIC
/begin CHARACTERISTIC PHRControl_cal_impl.DataStoreMemory4_InitialValue "" VALUE 0x0021BBF0 Scalar_FLOAT64_IEEE 0 PHRControl_CM_double -1.7E+308 1.7E+308 /end CHARACTERISTIC
/begin CHARACTERISTIC PHRControl_cal_impl.DataStoreMemory5_InitialValue "" VALUE 0x0021BBF8 Scalar_FLOAT64_IEEE 0 PHRControl_CM_double -1.7E+308 1.7E+308 /end CHARACTERISTIC
/begin CHARACTERISTIC PHRControl_cal_impl.DataStoreMemory6_InitialValue "" VALUE 0x0021BC00 Scalar_FLOAT64_IEEE 0 PHRControl_CM_double -1.7E+308 1.7E+308 /end CHARACTERISTIC
/begin CHARACTERISTIC PHRControl_cal_impl.DataStoreMemory7_InitialValue "" VALUE 0x0021BC08 Scalar_FLOAT64_IEEE 0 PHRControl_CM_double -1.7E+308 1.7E+308 /end CHARACTERISTIC
/begin CHARACTERISTIC PHRControl_cal_impl.DataStoreMemory8_InitialValue "" VALUE 0x0021BC10 Scalar_FLOAT64_IEEE 0 PHRControl_CM_double -1.7E+308 1.7E+308 /end CHARACTERISTIC
/begin CHARACTERISTIC PHRControl_cal_impl.DataStoreMemory_InitialValue "" VALUE 0x0021BC19 Scalar_BOOLEAN 0 PHRControl_CM_logical 0 1 /end CHARACTERISTIC
/begin CHARACTERISTIC PHRControl_cal_impl.Delay1_InitialCondition "" VAL_BLK 0x0021B848 Scalar_FLOAT64_IEEE 0 PHRControl_CM_double -1.7E+308 1.7E+308 MATRIX_DIM 2 1 /end CHARACTERISTIC
/begin CHARACTERISTIC PHRControl_cal_impl.Delay2_InitialCondition "" VALUE 0x0021BC18 Scalar_BOOLEAN 0 PHRControl_CM_logical 0 1 /end CHARACTERISTIC
/begin CHARACTERISTIC PHRControl_cal_impl.DiscreteDerivative1_ICPrevScaledInput "" VALUE 0x0021B180 Scalar_FLOAT64_IEEE 0 PHRControl_CM_double -1.7E+308 1.7E+308 /end CHARACTERISTIC
/begin CHARACTERISTIC PHRControl_cal_impl.DiscreteDerivative_ICPrevScaledInput "" VALUE 0x0021B188 Scalar_FLOAT64_IEEE 0 PHRControl_CM_double -1.7E+308 1.7E+308 /end CHARACTERISTIC
/begin CHARACTERISTIC PHRControl_cal_impl.DiscreteTimeIntegrator_IC "" VALUE 0x0021B540 Scalar_FLOAT64_IEEE 0 PHRControl_CM_double -1.7E+308 1.7E+308 /end CHARACTERISTIC
/begin CHARACTERISTIC PHRControl_cal_impl.DiscreteTimeIntegrator_IC_m "" VALUE 0x0021B838 Scalar_FLOAT64_IEEE 0 PHRControl_CM_double -1.7E+308 1.7E+308 /end CHARACTERISTIC
/begin CHARACTERISTIC PHRControl_cal_impl.DiscreteTimeIntegrator_gainval "" VALUE 0x0021B538 Scalar_FLOAT64_IEEE 0 PHRControl_CM_double -1.7E+308 1.7E+308 /end CHARACTERISTIC
/begin CHARACTERISTIC PHRControl_cal_impl.DiscreteTimeIntegrator_gainval_f "" VALUE 0x0021B830 Scalar_FLOAT64_IEEE 0 PHRControl_CM_double -1.7E+308 1.7E+308 /end CHARACTERISTIC
/begin CHARACTERISTIC PHRControl_cal_impl.Filter_gainval "" VALUE 0x0021B4F8 Scalar_FLOAT64_IEEE 0 PHRControl_CM_double -1.7E+308 1.7E+308 /end CHARACTERISTIC
/begin CHARACTERISTIC PHRControl_cal_impl.Filter_gainval_b "" VALUE 0x0021B558 Scalar_FLOAT64_IEEE 0 PHRControl_CM_double -1.7E+308 1.7E+308 /end CHARACTERISTIC
/begin CHARACTERISTIC PHRControl_cal_impl.Filter_gainval_c "" VALUE 0x0021B588 Scalar_FLOAT64_IEEE 0 PHRControl_CM_double -1.7E+308 1.7E+308 /end CHARACTERISTIC
/begin CHARACTERISTIC PHRControl_cal_impl.Filter_gainval_c2 "" VALUE 0x0021B5B8 Scalar_FLOAT64_IEEE 0 PHRControl_CM_double -1.7E+308 1.7E+308 /end CHARACTERISTIC
/begin CHARACTERISTIC PHRControl_cal_impl.Filter_gainval_d "" VALUE 0x0021B600 Scalar_FLOAT64_IEEE 0 PHRControl_CM_double -1.7E+308 1.7E+308 /end CHARACTERISTIC
/begin CHARACTERISTIC PHRControl_cal_impl.Filter_gainval_e "" VALUE 0x0021B508 Scalar_FLOAT64_IEEE 0 PHRControl_CM_double -1.7E+308 1.7E+308 /end CHARACTERISTIC
/begin CHARACTERISTIC PHRControl_cal_impl.Filter_gainval_ew "" VALUE 0x0021B5E8 Scalar_FLOAT64_IEEE 0 PHRControl_CM_double -1.7E+308 1.7E+308 /end CHARACTERISTIC
/begin CHARACTERISTIC PHRControl_cal_impl.Filter_gainval_f "" VALUE 0x0021B548 Scalar_FLOAT64_IEEE 0 PHRControl_CM_double -1.7E+308 1.7E+308 /end CHARACTERISTIC
/begin CHARACTERISTIC PHRControl_cal_impl.Filter_gainval_g "" VALUE 0x0021B5C8 Scalar_FLOAT64_IEEE 0 PHRControl_CM_double -1.7E+308 1.7E+308 /end CHARACTERISTIC
/begin CHARACTERISTIC PHRControl_cal_impl.Filter_gainval_gw "" VALUE 0x0021B638 Scalar_FLOAT64_IEEE 0 PHRControl_CM_double -1.7E+308 1.7E+308 /end CHARACTERISTIC
/begin CHARACTERISTIC PHRControl_cal_impl.Filter_gainval_l "" VALUE 0x0021B610 Scalar_FLOAT64_IEEE 0 PHRControl_CM_double -1.7E+308 1.7E+308 /end CHARACTERISTIC
/begin CHARACTERISTIC PHRControl_cal_impl.Filter_gainval_m "" VALUE 0x0021B628 Scalar_FLOAT64_IEEE 0 PHRControl_CM_double -1.7E+308 1.7E+308 /end CHARACTERISTIC
/begin CHARACTERISTIC PHRControl_cal_impl.Gain10_Gain "" VALUE 0x0021B858 Scalar_FLOAT64_IEEE 0 PHRControl_CM_double -1.7E+308 1.7E+308 /end CHARACTERISTIC
/begin CHARACTERISTIC PHRControl_cal_impl.Gain1_Gain "" VALUE 0x0021B870 Scalar_FLOAT64_IEEE 0 PHRControl_CM_double -1.7E+308 1.7E+308 /end CHARACTERISTIC
/begin CHARACTERISTIC PHRControl_cal_impl.Gain2_Gain "" VALUE 0x0021B4F0 Scalar_FLOAT64_IEEE 0 PHRControl_CM_double -1.7E+308 1.7E+308 /end CHARACTERISTIC
/begin CHARACTERISTIC PHRControl_cal_impl.Gain6_Gain "" VALUE 0x0021B868 Scalar_FLOAT64_IEEE 0 PHRControl_CM_double -1.7E+308 1.7E+308 /end CHARACTERISTIC
/begin CHARACTERISTIC PHRControl_cal_impl.Gain8_Gain "" VALUE 0x0021B860 Scalar_FLOAT64_IEEE 0 PHRControl_CM_double -1.7E+308 1.7E+308 /end CHARACTERISTIC
/begin CHARACTERISTIC PHRControl_cal_impl.Gain_Gain "" VALUE 0x0021B4E8 Scalar_FLOAT64_IEEE 0 PHRControl_CM_double -1.7E+308 1.7E+308 /end CHARACTERISTIC
/begin CHARACTERISTIC PHRControl_cal_impl.Gain_Gain_k "" VALUE 0x0021B5E0 Scalar_FLOAT64_IEEE 0 PHRControl_CM_double -1.7E+308 1.7E+308 /end CHARACTERISTIC
/begin CHARACTERISTIC PHRControl_cal_impl.I1_Y0 "" VALUE 0x0021B480 Scalar_FLOAT64_IEEE 0 PHRControl_CM_double -1.7E+308 1.7E+308 /end CHARACTERISTIC
/begin CHARACTERISTIC PHRControl_cal_impl.I2_Y0 "" VALUE 0x0021B488 Scalar_FLOAT64_IEEE 0 PHRControl_CM_double -1.7E+308 1.7E+308 /end CHARACTERISTIC
/begin CHARACTERISTIC PHRControl_cal_impl.Integrator_gainval "" VALUE 0x0021B500 Scalar_FLOAT64_IEEE 0 PHRControl_CM_double -1.7E+308 1.7E+308 /end CHARACTERISTIC
/begin CHARACTERISTIC PHRControl_cal_impl.Integrator_gainval_a "" VALUE 0x0021B560 Scalar_FLOAT64_IEEE 0 PHRControl_CM_double -1.7E+308 1.7E+308 /end CHARACTERISTIC
/begin CHARACTERISTIC PHRControl_cal_impl.Integrator_gainval_b "" VALUE 0x0021B550 Scalar_FLOAT64_IEEE 0 PHRControl_CM_double -1.7E+308 1.7E+308 /end CHARACTERISTIC
/begin CHARACTERISTIC PHRControl_cal_impl.Integrator_gainval_d "" VALUE 0x0021B5D0 Scalar_FLOAT64_IEEE 0 PHRControl_CM_double -1.7E+308 1.7E+308 /end CHARACTERISTIC
/begin CHARACTERISTIC PHRControl_cal_impl.Integrator_gainval_e "" VALUE 0x0021B5F0 Scalar_FLOAT64_IEEE 0 PHRControl_CM_double -1.7E+308 1.7E+308 /end CHARACTERISTIC
/begin CHARACTERISTIC PHRControl_cal_impl.Integrator_gainval_eb "" VALUE 0x0021B630 Scalar_FLOAT64_IEEE 0 PHRControl_CM_double -1.7E+308 1.7E+308 /end CHARACTERISTIC
/begin CHARACTERISTIC PHRControl_cal_impl.Integrator_gainval_g "" VALUE 0x0021B590 Scalar_FLOAT64_IEEE 0 PHRControl_CM_double -1.7E+308 1.7E+308 /end CHARACTERISTIC
/begin CHARACTERISTIC PHRControl_cal_impl.Integrator_gainval_gd "" VALUE 0x0021B5C0 Scalar_FLOAT64_IEEE 0 PHRControl_CM_double -1.7E+308 1.7E+308 /end CHARACTERISTIC
/begin CHARACTERISTIC PHRControl_cal_impl.Integrator_gainval_l "" VALUE 0x0021B510 Scalar_FLOAT64_IEEE 0 PHRControl_CM_double -1.7E+308 1.7E+308 /end CHARACTERISTIC
/begin CHARACTERISTIC PHRControl_cal_impl.Integrator_gainval_o "" VALUE 0x0021B618 Scalar_FLOAT64_IEEE 0 PHRControl_CM_double -1.7E+308 1.7E+308 /end CHARACTERISTIC
/begin CHARACTERISTIC PHRControl_cal_impl.Integrator_gainval_oy "" VALUE 0x0021B640 Scalar_FLOAT64_IEEE 0 PHRControl_CM_double -1.7E+308 1.7E+308 /end CHARACTERISTIC
/begin CHARACTERISTIC PHRControl_cal_impl.Integrator_gainval_p "" VALUE 0x0021B608 Scalar_FLOAT64_IEEE 0 PHRControl_CM_double -1.7E+308 1.7E+308 /end CHARACTERISTIC
/begin CHARACTERISTIC PHRControl_cal_impl.PHRControl_Idle_cal.Constant_Value "" VALUE 0x0021BDD0 Scalar_FLOAT64_IEEE 0 PHRControl_CM_double -1.7E+308 1.7E+308 /end CHARACTERISTIC
/begin CHARACTERISTIC PHRControl_cal_impl.PHRControl_Idle_cal.Filter_gainval "" VALUE 0x0021BDB0 Scalar_FLOAT64_IEEE 0 PHRControl_CM_double -1.7E+308 1.7E+308 /end CHARACTERISTIC
/begin CHARACTERISTIC PHRControl_cal_impl.PHRControl_Idle_cal.Filter_gainval_o "" VALUE 0x0021BDC0 Scalar_FLOAT64_IEEE 0 PHRControl_CM_double -1.7E+308 1.7E+308 /end CHARACTERISTIC
/begin CHARACTERISTIC PHRControl_cal_impl.PHRControl_Idle_cal.Integrator_gainval "" VALUE 0x0021BDB8 Scalar_FLOAT64_IEEE 0 PHRControl_CM_double -1.7E+308 1.7E+308 /end CHARACTERISTIC
/begin CHARACTERISTIC PHRControl_cal_impl.PHRControl_Idle_cal.Integrator_gainval_b "" VALUE 0x0021BDC8 Scalar_FLOAT64_IEEE 0 PHRControl_CM_double -1.7E+308 1.7E+308 /end CHARACTERISTIC
/begin CHARACTERISTIC PHRControl_cal_impl.PHRControl_Idle_cal.PIDController1_D "" VALUE 0x0021BD58 Scalar_FLOAT64_IEEE 0 PHRControl_CM_double -1.7E+308 1.7E+308 /end CHARACTERISTIC
/begin CHARACTERISTIC PHRControl_cal_impl.PHRControl_Idle_cal.PIDController_InitialConditionForFilter "" VALUE 0x0021BD70 Scalar_FLOAT64_IEEE 0 PHRControl_CM_double -1.7E+308 1.7E+308 /end CHARACTERISTIC
/begin CHARACTERISTIC PHRControl_cal_impl.PHRControl_Idle_l_cal.Constant_Value "" VALUE 0x0021BD30 Scalar_FLOAT64_IEEE 0 PHRControl_CM_double -1.7E+308 1.7E+308 /end CHARACTERISTIC
/begin CHARACTERISTIC PHRControl_cal_impl.PHRControl_Idle_l_cal.Filter_gainval "" VALUE 0x0021BD10 Scalar_FLOAT64_IEEE 0 PHRControl_CM_double -1.7E+308 1.7E+308 /end CHARACTERISTIC
/begin CHARACTERISTIC PHRControl_cal_impl.PHRControl_Idle_l_cal.Filter_gainval_o "" VALUE 0x0021BD20 Scalar_FLOAT64_IEEE 0 PHRControl_CM_double -1.7E+308 1.7E+308 /end CHARACTERISTIC
/begin CHARACTERISTIC PHRControl_cal_impl.PHRControl_Idle_l_cal.Integrator_gainval "" VALUE 0x0021BD18 Scalar_FLOAT64_IEEE 0 PHRControl_CM_double -1.7E+308 1.7E+308 /end CHARACTERISTIC
/begin CHARACTERISTIC PHRControl_cal_impl.PHRControl_Idle_l_cal.Integrator_gainval_b "" VALUE 0x0021BD28 Scalar_FLOAT64_IEEE 0 PHRControl_CM_double -1.7E+308 1.7E+308 /end CHARACTERISTIC
/begin CHARACTERISTIC PHRControl_cal_impl.PHRControl_Idle_l_cal.PIDController1_I "" VALUE 0x0021BCC8 Scalar_FLOAT64_IEEE 0 PHRControl_CM_double -1.7E+308 1.7E+308 /end CHARACTERISTIC
/begin CHARACTERISTIC PHRControl_cal_impl.PHRControl_Idle_l_cal.PIDController1_InitialConditionForFilter "" VALUE 0x0021BCD8 Scalar_FLOAT64_IEEE 0 PHRControl_CM_double -1.7E+308 1.7E+308 /end CHARACTERISTIC
/begin CHARACTERISTIC PHRControl_cal_impl.PHRControl_Idle_l_cal.PIDController1_InitialConditionForIntegrator "" VALUE 0x0021BCE8 Scalar_FLOAT64_IEEE 0 PHRControl_CM_double -1.7E+308 1.7E+308 /end CHARACTERISTIC
/begin CHARACTERISTIC PHRControl_cal_impl.PHRControl_Idle_l_cal.PIDController1_N "" VALUE 0x0021BCF8 Scalar_FLOAT64_IEEE 0 PHRControl_CM_double -1.7E+308 1.7E+308 /end CHARACTERISTIC
/begin CHARACTERISTIC PHRControl_cal_impl.PHRControl_Idle_l_cal.PIDController1_P "" VALUE 0x0021BD08 Scalar_FLOAT64_IEEE 0 PHRControl_CM_double -1.7E+308 1.7E+308 /end CHARACTERISTIC
/begin CHARACTERISTIC PHRControl_cal_impl.PHRControl_Idle_l_cal.PIDController_D "" VALUE 0x0021BCB0 Scalar_FLOAT64_IEEE 0 PHRControl_CM_double -1.7E+308 1.7E+308 /end CHARACTERISTIC
/begin CHARACTERISTIC PHRControl_cal_impl.PHRControl_Idle_l_cal.PIDController_I "" VALUE 0x0021BCC0 Scalar_FLOAT64_IEEE 0 PHRControl_CM_double -1.7E+308 1.7E+308 /end CHARACTERISTIC
/begin CHARACTERISTIC PHRControl_cal_impl.PHRControl_Idle_l_cal.PIDController_InitialConditionForIntegrator "" VALUE 0x0021BCE0 Scalar_FLOAT64_IEEE 0 PHRControl_CM_double -1.7E+308 1.7E+308 /end CHARACTERISTIC
/begin CHARACTERISTIC PHRControl_cal_impl.PHRControl_Idle_l_cal.PIDController_N "" VALUE 0x0021BCF0 Scalar_FLOAT64_IEEE 0 PHRControl_CM_double -1.7E+308 1.7E+308 /end CHARACTERISTIC
/begin CHARACTERISTIC PHRControl_cal_impl.PHRControl_Idle_l_cal.PIDController_P "" VALUE 0x0021BD00 Scalar_FLOAT64_IEEE 0 PHRControl_CM_double -1.7E+308 1.7E+308 /end CHARACTERISTIC
/begin CHARACTERISTIC PHRControl_cal_impl.PHRControl_Load_cal.Constant1_Value "" VALUE 0x0021BD40 Scalar_FLOAT64_IEEE 0 PHRControl_CM_double -1.7E+308 1.7E+308 /end CHARACTERISTIC
/begin CHARACTERISTIC PHRControl_cal_impl.PHRControl_Load_cal.Constant2_Value "" VALUE 0x0021BD48 Scalar_FLOAT64_IEEE 0 PHRControl_CM_double -1.7E+308 1.7E+308 /end CHARACTERISTIC
/begin CHARACTERISTIC PHRControl_cal_impl.PHRControl_Load_cal.Constant_Value "" VALUE 0x0021BD38 Scalar_FLOAT64_IEEE 0 PHRControl_CM_double -1.7E+308 1.7E+308 /end CHARACTERISTIC
/begin CHARACTERISTIC PHRControl_cal_impl.PHRControl_Load_h_cal.Constant1_Value "" VALUE 0x0021BCA0 Scalar_FLOAT64_IEEE 0 PHRControl_CM_double -1.7E+308 1.7E+308 /end CHARACTERISTIC
/begin CHARACTERISTIC PHRControl_cal_impl.PHRControl_Load_h_cal.Constant2_Value "" VALUE 0x0021BCA8 Scalar_FLOAT64_IEEE 0 PHRControl_CM_double -1.7E+308 1.7E+308 /end CHARACTERISTIC
/begin CHARACTERISTIC PHRControl_cal_impl.PHRControl_Load_h_cal.Constant_Value "" VALUE 0x0021BC98 Scalar_FLOAT64_IEEE 0 PHRControl_CM_double -1.7E+308 1.7E+308 /end CHARACTERISTIC
/begin CHARACTERISTIC PHRControl_cal_impl.PHRControl_Load_k_cal.Constant1_Value "" VALUE 0x0021BC70 Scalar_FLOAT64_IEEE 0 PHRControl_CM_double -1.7E+308 1.7E+308 /end CHARACTERISTIC
/begin CHARACTERISTIC PHRControl_cal_impl.PHRControl_Load_k_cal.Constant2_Value "" VALUE 0x0021BC78 Scalar_FLOAT64_IEEE 0 PHRControl_CM_double -1.7E+308 1.7E+308 /end CHARACTERISTIC
/begin CHARACTERISTIC PHRControl_cal_impl.PHRControl_Load_k_cal.Constant_Value "" VALUE 0x0021BC68 Scalar_FLOAT64_IEEE 0 PHRControl_CM_double -1.7E+308 1.7E+308 /end CHARACTERISTIC
/begin CHARACTERISTIC PHRControl_cal_impl.PHRControl_Unload_l_cal.Constant1_Value "" VALUE 0x0021BC88 Scalar_FLOAT64_IEEE 0 PHRControl_CM_double -1.7E+308 1.7E+308 /end CHARACTERISTIC
/begin CHARACTERISTIC PHRControl_cal_impl.PHRControl_Unload_l_cal.Constant2_Value "" VALUE 0x0021BC90 Scalar_FLOAT64_IEEE 0 PHRControl_CM_double -1.7E+308 1.7E+308 /end CHARACTERISTIC
/begin CHARACTERISTIC PHRControl_cal_impl.PHRControl_Unload_l_cal.Constant_Value "" VALUE 0x0021BC80 Scalar_FLOAT64_IEEE 0 PHRControl_CM_double -1.7E+308 1.7E+308 /end CHARACTERISTIC
/begin CHARACTERISTIC PHRControl_cal_impl.PHRControl_Unload_le_cal.Constant1_Value "" VALUE 0x0021BC58 Scalar_FLOAT64_IEEE 0 PHRControl_CM_double -1.7E+308 1.7E+308 /end CHARACTERISTIC
/begin CHARACTERISTIC PHRControl_cal_impl.PHRControl_Unload_le_cal.Constant2_Value "" VALUE 0x0021BC60 Scalar_FLOAT64_IEEE 0 PHRControl_CM_double -1.7E+308 1.7E+308 /end CHARACTERISTIC
/begin CHARACTERISTIC PHRControl_cal_impl.PHRControl_Unload_le_cal.Constant_Value "" VALUE 0x0021BC50 Scalar_FLOAT64_IEEE 0 PHRControl_CM_double -1.7E+308 1.7E+308 /end CHARACTERISTIC
/begin CHARACTERISTIC PHRControl_cal_impl.PIDController1_D "" VALUE 0x0021B0C8 Scalar_FLOAT64_IEEE 0 PHRControl_CM_double -1.7E+308 1.7E+308 /end CHARACTERISTIC
/begin CHARACTERISTIC PHRControl_cal_impl.PIDController1_D_j "" VALUE 0x0021B0F0 Scalar_FLOAT64_IEEE 0 PHRControl_CM_double -1.7E+308 1.7E+308 /end CHARACTERISTIC
/begin CHARACTERISTIC PHRControl_cal_impl.PIDController1_D_l "" VALUE 0x0021B118 Scalar_FLOAT64_IEEE 0 PHRControl_CM_double -1.7E+308 1.7E+308 /end CHARACTERISTIC
/begin CHARACTERISTIC PHRControl_cal_impl.PIDController1_D_o "" VALUE 0x0021B108 Scalar_FLOAT64_IEEE 0 PHRControl_CM_double -1.7E+308 1.7E+308 /end CHARACTERISTIC
/begin CHARACTERISTIC PHRControl_cal_impl.PIDController1_I "" VALUE 0x0021B128 Scalar_FLOAT64_IEEE 0 PHRControl_CM_double -1.7E+308 1.7E+308 /end CHARACTERISTIC
/begin CHARACTERISTIC PHRControl_cal_impl.PIDController1_I_b "" VALUE 0x0021B178 Scalar_FLOAT64_IEEE 0 PHRControl_CM_double -1.7E+308 1.7E+308 /end CHARACTERISTIC
/begin CHARACTERISTIC PHRControl_cal_impl.PIDController1_I_i "" VALUE 0x0021B168 Scalar_FLOAT64_IEEE 0 PHRControl_CM_double -1.7E+308 1.7E+308 /end CHARACTERISTIC
/begin CHARACTERISTIC PHRControl_cal_impl.PIDController1_I_k "" VALUE 0x0021B150 Scalar_FLOAT64_IEEE 0 PHRControl_CM_double -1.7E+308 1.7E+308 /end CHARACTERISTIC
/begin CHARACTERISTIC PHRControl_cal_impl.PIDController1_InitialConditionForFilter "" VALUE 0x0021B198 Scalar_FLOAT64_IEEE 0 PHRControl_CM_double -1.7E+308 1.7E+308 /end CHARACTERISTIC
/begin CHARACTERISTIC PHRControl_cal_impl.PIDController1_InitialConditionForFilter_b "" VALUE 0x0021B1C0 Scalar_FLOAT64_IEEE 0 PHRControl_CM_double -1.7E+308 1.7E+308 /end CHARACTERISTIC
/begin CHARACTERISTIC PHRControl_cal_impl.PIDController1_InitialConditionForFilter_h "" VALUE 0x0021B1E8 Scalar_FLOAT64_IEEE 0 PHRControl_CM_double -1.7E+308 1.7E+308 /end CHARACTERISTIC
/begin CHARACTERISTIC PHRControl_cal_impl.PIDController1_InitialConditionForFilter_p "" VALUE 0x0021B1D8 Scalar_FLOAT64_IEEE 0 PHRControl_CM_double -1.7E+308 1.7E+308 /end CHARACTERISTIC
/begin CHARACTERISTIC PHRControl_cal_impl.PIDController1_InitialConditionForIntegrator "" VALUE 0x0021B1F8 Scalar_FLOAT64_IEEE 0 PHRControl_CM_double -1.7E+308 1.7E+308 /end CHARACTERISTIC
/begin CHARACTERISTIC PHRControl_cal_impl.PIDController1_InitialConditionForIntegrator_d "" VALUE 0x0021B220 Scalar_FLOAT64_IEEE 0 PHRControl_CM_double -1.7E+308 1.7E+308 /end CHARACTERISTIC
/begin CHARACTERISTIC PHRControl_cal_impl.PIDController1_InitialConditionForIntegrator_dr "" VALUE 0x0021B238 Scalar_FLOAT64_IEEE 0 PHRControl_CM_double -1.7E+308 1.7E+308 /end CHARACTERISTIC
/begin CHARACTERISTIC PHRControl_cal_impl.PIDController1_InitialConditionForIntegrator_o "" VALUE 0x0021B248 Scalar_FLOAT64_IEEE 0 PHRControl_CM_double -1.7E+308 1.7E+308 /end CHARACTERISTIC
/begin CHARACTERISTIC PHRControl_cal_impl.PIDController1_N "" VALUE 0x0021B258 Scalar_FLOAT64_IEEE 0 PHRControl_CM_double -1.7E+308 1.7E+308 /end CHARACTERISTIC
/begin CHARACTERISTIC PHRControl_cal_impl.PIDController1_N_j "" VALUE 0x0021B2A8 Scalar_FLOAT64_IEEE 0 PHRControl_CM_double -1.7E+308 1.7E+308 /end CHARACTERISTIC
/begin CHARACTERISTIC PHRControl_cal_impl.PIDController1_N_n "" VALUE 0x0021B298 Scalar_FLOAT64_IEEE 0 PHRControl_CM_double -1.7E+308 1.7E+308 /end CHARACTERISTIC
/begin CHARACTERISTIC PHRControl_cal_impl.PIDController1_N_o "" VALUE 0x0021B280 Scalar_FLOAT64_IEEE 0 PHRControl_CM_double -1.7E+308 1.7E+308 /end CHARACTERISTIC
/begin CHARACTERISTIC PHRControl_cal_impl.PIDController1_P "" VALUE 0x0021B2B8 Scalar_FLOAT64_IEEE 0 PHRControl_CM_double -1.7E+308 1.7E+308 /end CHARACTERISTIC
/begin CHARACTERISTIC PHRControl_cal_impl.PIDController1_P_e "" VALUE 0x0021B2E0 Scalar_FLOAT64_IEEE 0 PHRControl_CM_double -1.7E+308 1.7E+308 /end CHARACTERISTIC
/begin CHARACTERISTIC PHRControl_cal_impl.PIDController1_P_ex "" VALUE 0x0021B308 Scalar_FLOAT64_IEEE 0 PHRControl_CM_double -1.7E+308 1.7E+308 /end CHARACTERISTIC
/begin CHARACTERISTIC PHRControl_cal_impl.PIDController1_P_j "" VALUE 0x0021B2F8 Scalar_FLOAT64_IEEE 0 PHRControl_CM_double -1.7E+308 1.7E+308 /end CHARACTERISTIC
/begin CHARACTERISTIC PHRControl_cal_impl.PIDController2_D "" VALUE 0x0021B0D0 Scalar_FLOAT64_IEEE 0 PHRControl_CM_double -1.7E+308 1.7E+308 /end CHARACTERISTIC
/begin CHARACTERISTIC PHRControl_cal_impl.PIDController2_D_l "" VALUE 0x0021B0E0 Scalar_FLOAT64_IEEE 0 PHRControl_CM_double -1.7E+308 1.7E+308 /end CHARACTERISTIC
/begin CHARACTERISTIC PHRControl_cal_impl.PIDController2_D_m "" VALUE 0x0021B0F8 Scalar_FLOAT64_IEEE 0 PHRControl_CM_double -1.7E+308 1.7E+308 /end CHARACTERISTIC
/begin CHARACTERISTIC PHRControl_cal_impl.PIDController2_I "" VALUE 0x0021B130 Scalar_FLOAT64_IEEE 0 PHRControl_CM_double -1.7E+308 1.7E+308 /end CHARACTERISTIC
/begin CHARACTERISTIC PHRControl_cal_impl.PIDController2_I_c "" VALUE 0x0021B158 Scalar_FLOAT64_IEEE 0 PHRControl_CM_double -1.7E+308 1.7E+308 /end CHARACTERISTIC
/begin CHARACTERISTIC PHRControl_cal_impl.PIDController2_I_i "" VALUE 0x0021B140 Scalar_FLOAT64_IEEE 0 PHRControl_CM_double -1.7E+308 1.7E+308 /end CHARACTERISTIC
/begin CHARACTERISTIC PHRControl_cal_impl.PIDController2_InitialConditionForFilter "" VALUE 0x0021B1A0 Scalar_FLOAT64_IEEE 0 PHRControl_CM_double -1.7E+308 1.7E+308 /end CHARACTERISTIC
/begin CHARACTERISTIC PHRControl_cal_impl.PIDController2_InitialConditionForFilter_e "" VALUE 0x0021B1C8 Scalar_FLOAT64_IEEE 0 PHRControl_CM_double -1.7E+308 1.7E+308 /end CHARACTERISTIC
/begin CHARACTERISTIC PHRControl_cal_impl.PIDController2_InitialConditionForFilter_j "" VALUE 0x0021B1B0 Scalar_FLOAT64_IEEE 0 PHRControl_CM_double -1.7E+308 1.7E+308 /end CHARACTERISTIC
/begin CHARACTERISTIC PHRControl_cal_impl.PIDController2_InitialConditionForIntegrator "" VALUE 0x0021B200 Scalar_FLOAT64_IEEE 0 PHRControl_CM_double -1.7E+308 1.7E+308 /end CHARACTERISTIC
/begin CHARACTERISTIC PHRControl_cal_impl.PIDController2_InitialConditionForIntegrator_f "" VALUE 0x0021B228 Scalar_FLOAT64_IEEE 0 PHRControl_CM_double -1.7E+308 1.7E+308 /end CHARACTERISTIC
/begin CHARACTERISTIC PHRControl_cal_impl.PIDController2_InitialConditionForIntegrator_j "" VALUE 0x0021B210 Scalar_FLOAT64_IEEE 0 PHRControl_CM_double -1.7E+308 1.7E+308 /end CHARACTERISTIC
/begin CHARACTERISTIC PHRControl_cal_impl.PIDController2_N "" VALUE 0x0021B260 Scalar_FLOAT64_IEEE 0 PHRControl_CM_double -1.7E+308 1.7E+308 /end CHARACTERISTIC
/begin CHARACTERISTIC PHRControl_cal_impl.PIDController2_N_j "" VALUE 0x0021B288 Scalar_FLOAT64_IEEE 0 PHRControl_CM_double -1.7E+308 1.7E+308 /end CHARACTERISTIC
/begin CHARACTERISTIC PHRControl_cal_impl.PIDController2_N_l "" VALUE 0x0021B270 Scalar_FLOAT64_IEEE 0 PHRControl_CM_double -1.7E+308 1.7E+308 /end CHARACTERISTIC
/begin CHARACTERISTIC PHRControl_cal_impl.PIDController2_P "" VALUE 0x0021B2C0 Scalar_FLOAT64_IEEE 0 PHRControl_CM_double -1.7E+308 1.7E+308 /end CHARACTERISTIC
/begin CHARACTERISTIC PHRControl_cal_impl.PIDController2_P_i "" VALUE 0x0021B2D0 Scalar_FLOAT64_IEEE 0 PHRControl_CM_double -1.7E+308 1.7E+308 /end CHARACTERISTIC
/begin CHARACTERISTIC PHRControl_cal_impl.PIDController2_P_o "" VALUE 0x0021B2E8 Scalar_FLOAT64_IEEE 0 PHRControl_CM_double -1.7E+308 1.7E+308 /end CHARACTERISTIC
/begin CHARACTERISTIC PHRControl_cal_impl.PIDController3_D "" VALUE 0x0021B0D8 Scalar_FLOAT64_IEEE 0 PHRControl_CM_double -1.7E+308 1.7E+308 /end CHARACTERISTIC
/begin CHARACTERISTIC PHRControl_cal_impl.PIDController3_I "" VALUE 0x0021B138 Scalar_FLOAT64_IEEE 0 PHRControl_CM_double -1.7E+308 1.7E+308 /end CHARACTERISTIC
/begin CHARACTERISTIC PHRControl_cal_impl.PIDController3_InitialConditionForFilter "" VALUE 0x0021B1A8 Scalar_FLOAT64_IEEE 0 PHRControl_CM_double -1.7E+308 1.7E+308 /end CHARACTERISTIC
/begin CHARACTERISTIC PHRControl_cal_impl.PIDController3_InitialConditionForIntegrator "" VALUE 0x0021B208 Scalar_FLOAT64_IEEE 0 PHRControl_CM_double -1.7E+308 1.7E+308 /end CHARACTERISTIC
/begin CHARACTERISTIC PHRControl_cal_impl.PIDController3_N "" VALUE 0x0021B268 Scalar_FLOAT64_IEEE 0 PHRControl_CM_double -1.7E+308 1.7E+308 /end CHARACTERISTIC
/begin CHARACTERISTIC PHRControl_cal_impl.PIDController3_P "" VALUE 0x0021B2C8 Scalar_FLOAT64_IEEE 0 PHRControl_CM_double -1.7E+308 1.7E+308 /end CHARACTERISTIC
/begin CHARACTERISTIC PHRControl_cal_impl.PIDController_D "" VALUE 0x0021B0C0 Scalar_FLOAT64_IEEE 0 PHRControl_CM_double -1.7E+308 1.7E+308 /end CHARACTERISTIC
/begin CHARACTERISTIC PHRControl_cal_impl.PIDController_D_b "" VALUE 0x0021B0E8 Scalar_FLOAT64_IEEE 0 PHRControl_CM_double -1.7E+308 1.7E+308 /end CHARACTERISTIC
/begin CHARACTERISTIC PHRControl_cal_impl.PIDController_D_f "" VALUE 0x0021B110 Scalar_FLOAT64_IEEE 0 PHRControl_CM_double -1.7E+308 1.7E+308 /end CHARACTERISTIC
/begin CHARACTERISTIC PHRControl_cal_impl.PIDController_D_l "" VALUE 0x0021B100 Scalar_FLOAT64_IEEE 0 PHRControl_CM_double -1.7E+308 1.7E+308 /end CHARACTERISTIC
/begin CHARACTERISTIC PHRControl_cal_impl.PIDController_I "" VALUE 0x0021B120 Scalar_FLOAT64_IEEE 0 PHRControl_CM_double -1.7E+308 1.7E+308 /end CHARACTERISTIC
/begin CHARACTERISTIC PHRControl_cal_impl.PIDController_I_e "" VALUE 0x0021B170 Scalar_FLOAT64_IEEE 0 PHRControl_CM_double -1.7E+308 1.7E+308 /end CHARACTERISTIC
/begin CHARACTERISTIC PHRControl_cal_impl.PIDController_I_k "" VALUE 0x0021B148 Scalar_FLOAT64_IEEE 0 PHRControl_CM_double -1.7E+308 1.7E+308 /end CHARACTERISTIC
/begin CHARACTERISTIC PHRControl_cal_impl.PIDController_I_m "" VALUE 0x0021B160 Scalar_FLOAT64_IEEE 0 PHRControl_CM_double -1.7E+308 1.7E+308 /end CHARACTERISTIC
/begin CHARACTERISTIC PHRControl_cal_impl.PIDController_InitialConditionForFilter "" VALUE 0x0021B190 Scalar_FLOAT64_IEEE 0 PHRControl_CM_double -1.7E+308 1.7E+308 /end CHARACTERISTIC
/begin CHARACTERISTIC PHRControl_cal_impl.PIDController_InitialConditionForFilter_i "" VALUE 0x0021B1B8 Scalar_FLOAT64_IEEE 0 PHRControl_CM_double -1.7E+308 1.7E+308 /end CHARACTERISTIC
/begin CHARACTERISTIC PHRControl_cal_impl.PIDController_InitialConditionForFilter_j "" VALUE 0x0021B1E0 Scalar_FLOAT64_IEEE 0 PHRControl_CM_double -1.7E+308 1.7E+308 /end CHARACTERISTIC
/begin CHARACTERISTIC PHRControl_cal_impl.PIDController_InitialConditionForFilter_n "" VALUE 0x0021B1D0 Scalar_FLOAT64_IEEE 0 PHRControl_CM_double -1.7E+308 1.7E+308 /end CHARACTERISTIC
/begin CHARACTERISTIC PHRControl_cal_impl.PIDController_InitialConditionForIntegrator "" VALUE 0x0021B1F0 Scalar_FLOAT64_IEEE 0 PHRControl_CM_double -1.7E+308 1.7E+308 /end CHARACTERISTIC
/begin CHARACTERISTIC PHRControl_cal_impl.PIDController_InitialConditionForIntegrator_f "" VALUE 0x0021B230 Scalar_FLOAT64_IEEE 0 PHRControl_CM_double -1.7E+308 1.7E+308 /end CHARACTERISTIC
/begin CHARACTERISTIC PHRControl_cal_impl.PIDController_InitialConditionForIntegrator_n "" VALUE 0x0021B218 Scalar_FLOAT64_IEEE 0 PHRControl_CM_double -1.7E+308 1.7E+308 /end CHARACTERISTIC
/begin CHARACTERISTIC PHRControl_cal_impl.PIDController_InitialConditionForIntegrator_p "" VALUE 0x0021B240 Scalar_FLOAT64_IEEE 0 PHRControl_CM_double -1.7E+308 1.7E+308 /end CHARACTERISTIC
/begin CHARACTERISTIC PHRControl_cal_impl.PIDController_N "" VALUE 0x0021B250 Scalar_FLOAT64_IEEE 0 PHRControl_CM_double -1.7E+308 1.7E+308 /end CHARACTERISTIC
/begin CHARACTERISTIC PHRControl_cal_impl.PIDController_N_b "" VALUE 0x0021B290 Scalar_FLOAT64_IEEE 0 PHRControl_CM_double -1.7E+308 1.7E+308 /end CHARACTERISTIC
/begin CHARACTERISTIC PHRControl_cal_impl.PIDController_N_l "" VALUE 0x0021B278 Scalar_FLOAT64_IEEE 0 PHRControl_CM_double -1.7E+308 1.7E+308 /end CHARACTERISTIC
/begin CHARACTERISTIC PHRControl_cal_impl.PIDController_N_n "" VALUE 0x0021B2A0 Scalar_FLOAT64_IEEE 0 PHRControl_CM_double -1.7E+308 1.7E+308 /end CHARACTERISTIC
/begin CHARACTERISTIC PHRControl_cal_impl.PIDController_P "" VALUE 0x0021B2B0 Scalar_FLOAT64_IEEE 0 PHRControl_CM_double -1.7E+308 1.7E+308 /end CHARACTERISTIC
/begin CHARACTERISTIC PHRControl_cal_impl.PIDController_P_i "" VALUE 0x0021B300 Scalar_FLOAT64_IEEE 0 PHRControl_CM_double -1.7E+308 1.7E+308 /end CHARACTERISTIC
/begin CHARACTERISTIC PHRControl_cal_impl.PIDController_P_j "" VALUE 0x0021B2F0 Scalar_FLOAT64_IEEE 0 PHRControl_CM_double -1.7E+308 1.7E+308 /end CHARACTERISTIC
/begin CHARACTERISTIC PHRControl_cal_impl.PIDController_P_n "" VALUE 0x0021B2D8 Scalar_FLOAT64_IEEE 0 PHRControl_CM_double -1.7E+308 1.7E+308 /end CHARACTERISTIC
/begin CHARACTERISTIC PHRControl_cal_impl.Saturation1_LowerSat "" VALUE 0x0021B5A0 Scalar_FLOAT64_IEEE 0 PHRControl_CM_double -1.7E+308 1.7E+308 /end CHARACTERISTIC
/begin CHARACTERISTIC PHRControl_cal_impl.Saturation1_UpperSat "" VALUE 0x0021B598 Scalar_FLOAT64_IEEE 0 PHRControl_CM_double -1.7E+308 1.7E+308 /end CHARACTERISTIC
/begin CHARACTERISTIC PHRControl_cal_impl.Switch_Threshold "" VALUE 0x0021B840 Scalar_FLOAT64_IEEE 0 PHRControl_CM_double -1.7E+308 1.7E+308 /end CHARACTERISTIC
/begin CHARACTERISTIC PHRControl_cal_impl.TSamp_WtEt "" VALUE 0x0021B818 Scalar_FLOAT64_IEEE 0 PHRControl_CM_double -1.7E+308 1.7E+308 /end CHARACTERISTIC
/begin CHARACTERISTIC PHRControl_cal_impl.TSamp_WtEt_n "" VALUE 0x0021B820 Scalar_FLOAT64_IEEE 0 PHRControl_CM_double -1.7E+308 1.7E+308 /end CHARACTERISTIC
/begin CHARACTERISTIC PHRControl_cal_impl.X_Y0 "" VALUE 0x0021B490 Scalar_FLOAT64_IEEE 0 PHRControl_CM_double -1.7E+308 1.7E+308 /end CHARACTERISTIC
/begin CHARACTERISTIC PHRControl_cal_impl.Xd_Y0 "" VALUE 0x0021B468 Scalar_FLOAT64_IEEE 0 PHRControl_CM_double -1.7E+308 1.7E+308 /end CHARACTERISTIC
/begin CHARACTERISTIC PHRControl_cal_impl.Z_Y0 "" VALUE 0x0021B460 Scalar_FLOAT64_IEEE 0 PHRControl_CM_double -1.7E+308 1.7E+308 /end CHARACTERISTIC
/begin CHARACTERISTIC PHRControl_cal_impl.Zd_Y0 "" VALUE 0x0021B498 Scalar_FLOAT64_IEEE 0 PHRControl_CM_double -1.7E+308 1.7E+308 /end CHARACTERISTIC
/begin CHARACTERISTIC PHRControl_cal_impl.amplitude "" VALUE 0x0021B028 Scalar_FLOAT64_IEEE 0 PHRControl_CM_double -1.7E+308 1.7E+308 /end CHARACTERISTIC
/begin CHARACTERISTIC PHRControl_cal_impl.contactTime "" VALUE 0x0021B030 Scalar_FLOAT64_IEEE 0 PHRControl_CM_double -1.7E+308 1.7E+308 /end CHARACTERISTIC
/begin CHARACTERISTIC PHRControl_cal_impl.desired_speed "" VALUE 0x0021B038 Scalar_FLOAT64_IEEE 0 PHRControl_CM_double -1.7E+308 1.7E+308 /end CHARACTERISTIC
/begin CHARACTERISTIC PHRControl_cal_impl.equilibrium_length "" VALUE 0x0021B040 Scalar_FLOAT64_IEEE 0 PHRControl_CM_double -1.7E+308 1.7E+308 /end CHARACTERISTIC
/begin CHARACTERISTIC PHRControl_cal_impl.h "" VALUE 0x0021B048 Scalar_FLOAT64_IEEE 0 PHRControl_CM_double -1.7E+308 1.7E+308 /end CHARACTERISTIC
/begin CHARACTERISTIC PHRControl_cal_impl.hip_bend_factor "" VALUE 0x0021B050 Scalar_FLOAT64_IEEE 0 PHRControl_CM_double -1.7E+308 1.7E+308 /end CHARACTERISTIC
/begin CHARACTERISTIC PHRControl_cal_impl.hip_fuzz "" VALUE 0x0021B058 Scalar_FLOAT64_IEEE 0 PHRControl_CM_double -1.7E+308 1.7E+308 /end CHARACTERISTIC
/begin CHARACTERISTIC PHRControl_cal_impl.initHip "" VALUE 0x0021B060 Scalar_FLOAT64_IEEE 0 PHRControl_CM_double -1.7E+308 1.7E+308 /end CHARACTERISTIC
/begin CHARACTERISTIC PHRControl_cal_impl.initKnee "" VALUE 0x0021B068 Scalar_FLOAT64_IEEE 0 PHRControl_CM_double -1.7E+308 1.7E+308 /end CHARACTERISTIC
/begin CHARACTERISTIC PHRControl_cal_impl.isReady_Value "" VALUE 0x0021B828 Scalar_FLOAT64_IEEE 0 PHRControl_CM_double -1.7E+308 1.7E+308 /end CHARACTERISTIC
/begin CHARACTERISTIC PHRControl_cal_impl.k_landing_angle "" VALUE 0x0021B070 Scalar_FLOAT64_IEEE 0 PHRControl_CM_double -1.7E+308 1.7E+308 /end CHARACTERISTIC
/begin CHARACTERISTIC PHRControl_cal_impl.k_slip "" VALUE 0x0021B078 Scalar_FLOAT64_IEEE 0 PHRControl_CM_double -1.7E+308 1.7E+308 /end CHARACTERISTIC
/begin CHARACTERISTIC PHRControl_cal_impl.knee_bend_factor "" VALUE 0x0021B080 Scalar_FLOAT64_IEEE 0 PHRControl_CM_double -1.7E+308 1.7E+308 /end CHARACTERISTIC
/begin CHARACTERISTIC PHRControl_cal_impl.knee_fuzz "" VALUE 0x0021B088 Scalar_FLOAT64_IEEE 0 PHRControl_CM_double -1.7E+308 1.7E+308 /end CHARACTERISTIC
/begin CHARACTERISTIC PHRControl_cal_impl.lower_leg_length "" VALUE 0x0021B090 Scalar_FLOAT64_IEEE 0 PHRControl_CM_double -1.7E+308 1.7E+308 /end CHARACTERISTIC
/begin CHARACTERISTIC PHRControl_cal_impl.max_torque "" VALUE 0x0021B098 Scalar_FLOAT64_IEEE 0 PHRControl_CM_double -1.7E+308 1.7E+308 /end CHARACTERISTIC
/begin CHARACTERISTIC PHRControl_cal_impl.r "" VALUE 0x0021B0A0 Scalar_FLOAT64_IEEE 0 PHRControl_CM_double -1.7E+308 1.7E+308 /end CHARACTERISTIC
/begin CHARACTERISTIC PHRControl_cal_impl.th1_Y0 "" VALUE 0x0021B470 Scalar_FLOAT64_IEEE 0 PHRControl_CM_double -1.7E+308 1.7E+308 /end CHARACTERISTIC
/begin CHARACTERISTIC PHRControl_cal_impl.th2_Y0 "" VALUE 0x0021B478 Scalar_FLOAT64_IEEE 0 PHRControl_CM_double -1.7E+308 1.7E+308 /end CHARACTERISTIC
/begin CHARACTERISTIC PHRControl_cal_impl.upper_leg_length "" VALUE 0x0021B0A8 Scalar_FLOAT64_IEEE 0 PHRControl_CM_double -1.7E+308 1.7E+308 /end CHARACTERISTIC
/begin CHARACTERISTIC PHRControl_cal_impl.v_des "" VALUE 0x0021B0B0 Scalar_FLOAT64_IEEE 0 PHRControl_CM_double -1.7E+308 1.7E+308 /end CHARACTERISTIC
/begin CHARACTERISTIC PHRControl_cal_impl.z_des "" VALUE 0x0021B0B8 Scalar_FLOAT64_IEEE 0 PHRControl_CM_double -1.7E+308 1.7E+308 /end CHARACTERISTIC
/begin MEASUREMENT PHRControl_B.BytePacking "" UBYTE PHRControl_CM_uint8 0 0 0 255 LAYOUT COLUMN_DIR MATRIX_DIM 8 ECU_ADDRESS 0x00220910 /end MEASUREMENT
/begin MEASUREMENT PHRControl_B.BytePacking_l "" UBYTE PHRControl_CM_uint8 0 0 0 255 LAYOUT COLUMN_DIR MATRIX_DIM 8 ECU_ADDRESS 0x00220920 /end MEASUREMENT
/begin MEASUREMENT PHRControl_B.CANRead_o1 "" UBYTE PHRControl_CM_logical 0 0 0 1 ECU_ADDRESS 0x0022092A /end MEASUREMENT
/begin MEASUREMENT PHRControl_B.CANUnpack1_o3 "" UBYTE PHRControl_CM_uint8 0 0 0 255 ECU_ADDRESS 0x00220905 /end MEASUREMENT
/begin MEASUREMENT PHRControl_B.CANUnpack2_o3 "" UBYTE PHRControl_CM_uint8 0 0 0 255 ECU_ADDRESS 0x00220906 /end MEASUREMENT
/begin MEASUREMENT PHRControl_B.CANUnpack3_o1 "" FLOAT64_IEEE PHRControl_CM_double 0 0 -1.7E+308 1.7E+308 ECU_ADDRESS 0x002208A8 /end MEASUREMENT
/begin MEASUREMENT PHRControl_B.CANUnpack3_o2 "" FLOAT64_IEEE PHRControl_CM_double 0 0 -1.7E+308 1.7E+308 ECU_ADDRESS 0x002208B0 /end MEASUREMENT
/begin MEASUREMENT PHRControl_B.CANUnpack3_o3 "" FLOAT64_IEEE PHRControl_CM_double 0 0 -1.7E+308 1.7E+308 ECU_ADDRESS 0x002208B8 /end MEASUREMENT
/begin MEASUREMENT PHRControl_B.CANUnpack3_o5 "" UBYTE PHRControl_CM_uint8 0 0 0 255 ECU_ADDRESS 0x00220907 /end MEASUREMENT
/begin MEASUREMENT PHRControl_B.CANUnpack_o1 "" FLOAT64_IEEE PHRControl_CM_double 0 0 -1.7E+308 1.7E+308 ECU_ADDRESS 0x00220868 /end MEASUREMENT
/begin MEASUREMENT PHRControl_B.CANUnpack_o2 "" FLOAT64_IEEE PHRControl_CM_double 0 0 -1.7E+308 1.7E+308 ECU_ADDRESS 0x00220870 /end MEASUREMENT
/begin MEASUREMENT PHRControl_B.CANUnpack_o3 "" FLOAT64_IEEE PHRControl_CM_double 0 0 -1.7E+308 1.7E+308 ECU_ADDRESS 0x00220878 /end MEASUREMENT
/begin MEASUREMENT PHRControl_B.CANUnpack_o5 "" UBYTE PHRControl_CM_uint8 0 0 0 255 ECU_ADDRESS 0x00220904 /end MEASUREMENT
/begin MEASUREMENT PHRControl_B.Clock "" FLOAT64_IEEE PHRControl_CM_double 0 0 -1.7E+308 1.7E+308 ECU_ADDRESS 0x0021FE78 /end MEASUREMENT
/begin MEASUREMENT PHRControl_B.Cos "" FLOAT64_IEEE PHRControl_CM_double 0 0 -1.7E+308 1.7E+308 ECU_ADDRESS 0x0021FF78 /end MEASUREMENT
/begin MEASUREMENT PHRControl_B.Cos1 "" FLOAT64_IEEE PHRControl_CM_double 0 0 -1.7E+308 1.7E+308 ECU_ADDRESS 0x00220250 /end MEASUREMENT
/begin MEASUREMENT PHRControl_B.Cos2 "" FLOAT64_IEEE PHRControl_CM_double 0 0 -1.7E+308 1.7E+308 ECU_ADDRESS 0x00220268 /end MEASUREMENT
/begin MEASUREMENT PHRControl_B.Cos_f "" FLOAT64_IEEE PHRControl_CM_double 0 0 -1.7E+308 1.7E+308 ECU_ADDRESS 0x00220248 /end MEASUREMENT
/begin MEASUREMENT PHRControl_B.DataStoreRead "" FLOAT64_IEEE PHRControl_CM_double 0 0 -1.7E+308 1.7E+308 ECU_ADDRESS 0x00220428 /end MEASUREMENT
/begin MEASUREMENT PHRControl_B.DataStoreRead1 "" FLOAT64_IEEE PHRControl_CM_double 0 0 -1.7E+308 1.7E+308 ECU_ADDRESS 0x002206A8 /end MEASUREMENT
/begin MEASUREMENT PHRControl_B.DataStoreRead_e "" FLOAT64_IEEE PHRControl_CM_double 0 0 -1.7E+308 1.7E+308 ECU_ADDRESS 0x00220650 /end MEASUREMENT
/begin MEASUREMENT PHRControl_B.DataStoreRead_h "" UBYTE PHRControl_CM_logical 0 0 0 1 ECU_ADDRESS 0x00220929 /end MEASUREMENT
/begin MEASUREMENT PHRControl_B.DataStoreRead_n "" FLOAT64_IEEE PHRControl_CM_double 0 0 -1.7E+308 1.7E+308 ECU_ADDRESS 0x00220778 /end MEASUREMENT
/begin MEASUREMENT PHRControl_B.Delay1 "" FLOAT64_IEEE PHRControl_CM_double 0 0 -1.7E+308 1.7E+308 LAYOUT COLUMN_DIR MATRIX_DIM 2 ECU_ADDRESS 0x0021FED0 /end MEASUREMENT
/begin MEASUREMENT PHRControl_B.Delay2 "" UBYTE PHRControl_CM_logical 0 0 0 1 ECU_ADDRESS 0x00220928 /end MEASUREMENT
/begin MEASUREMENT PHRControl_B.DerivativeGain "" FLOAT64_IEEE PHRControl_CM_double 0 0 -1.7E+308 1.7E+308 ECU_ADDRESS 0x00220320 /end MEASUREMENT
/begin MEASUREMENT PHRControl_B.DerivativeGain_b "" FLOAT64_IEEE PHRControl_CM_double 0 0 -1.7E+308 1.7E+308 ECU_ADDRESS 0x00220370 /end MEASUREMENT
/begin MEASUREMENT PHRControl_B.DerivativeGain_d "" FLOAT64_IEEE PHRControl_CM_double 0 0 -1.7E+308 1.7E+308 ECU_ADDRESS 0x002204D0 /end MEASUREMENT
/begin MEASUREMENT PHRControl_B.DerivativeGain_e "" FLOAT64_IEEE PHRControl_CM_double 0 0 -1.7E+308 1.7E+308 ECU_ADDRESS 0x00220610 /end MEASUREMENT
/begin MEASUREMENT PHRControl_B.DerivativeGain_f "" FLOAT64_IEEE PHRControl_CM_double 0 0 -1.7E+308 1.7E+308 ECU_ADDRESS 0x002206C8 /end MEASUREMENT
/begin MEASUREMENT PHRControl_B.DerivativeGain_g "" FLOAT64_IEEE PHRControl_CM_double 0 0 -1.7E+308 1.7E+308 ECU_ADDRESS 0x00220710 /end MEASUREMENT
/begin MEASUREMENT PHRControl_B.DerivativeGain_h "" FLOAT64_IEEE PHRControl_CM_double 0 0 -1.7E+308 1.7E+308 ECU_ADDRESS 0x00220668 /end MEASUREMENT
/begin MEASUREMENT PHRControl_B.DerivativeGain_l "" FLOAT64_IEEE PHRControl_CM_double 0 0 -1.7E+308 1.7E+308 ECU_ADDRESS 0x00220828 /end MEASUREMENT
/begin MEASUREMENT PHRControl_B.DerivativeGain_m "" FLOAT64_IEEE PHRControl_CM_double 0 0 -1.7E+308 1.7E+308 ECU_ADDRESS 0x00220530 /end MEASUREMENT
/begin MEASUREMENT PHRControl_B.DerivativeGain_mb "" FLOAT64_IEEE PHRControl_CM_double 0 0 -1.7E+308 1.7E+308 ECU_ADDRESS 0x002207E0 /end MEASUREMENT
/begin MEASUREMENT PHRControl_B.DerivativeGain_o "" FLOAT64_IEEE PHRControl_CM_double 0 0 -1.7E+308 1.7E+308 ECU_ADDRESS 0x00220488 /end MEASUREMENT
/begin MEASUREMENT PHRControl_B.DerivativeGain_p "" FLOAT64_IEEE PHRControl_CM_double 0 0 -1.7E+308 1.7E+308 ECU_ADDRESS 0x002205C8 /end MEASUREMENT
/begin MEASUREMENT PHRControl_B.Diff "" FLOAT64_IEEE PHRControl_CM_double 0 0 -1.7E+308 1.7E+308 ECU_ADDRESS 0x0021FE98 /end MEASUREMENT
/begin MEASUREMENT PHRControl_B.Diff_l "" FLOAT64_IEEE PHRControl_CM_double 0 0 -1.7E+308 1.7E+308 ECU_ADDRESS 0x0021FEB0 /end MEASUREMENT
/begin MEASUREMENT PHRControl_B.DiscreteTimeIntegrator "" FLOAT64_IEEE PHRControl_CM_double 0 0 -1.7E+308 1.7E+308 ECU_ADDRESS 0x0021FEC0 /end MEASUREMENT
/begin MEASUREMENT PHRControl_B.DiscreteTimeIntegrator_f "" FLOAT64_IEEE PHRControl_CM_double 0 0 -1.7E+308 1.7E+308 ECU_ADDRESS 0x002206B8 /end MEASUREMENT
/begin MEASUREMENT PHRControl_B.Divide "" FLOAT64_IEEE PHRControl_CM_double 0 0 -1.7E+308 1.7E+308 ECU_ADDRESS 0x00220078 /end MEASUREMENT
/begin MEASUREMENT PHRControl_B.Divide_f "" FLOAT64_IEEE PHRControl_CM_double 0 0 -1.7E+308 1.7E+308 ECU_ADDRESS 0x00220098 /end MEASUREMENT
/begin MEASUREMENT PHRControl_B.Divide_j "" FLOAT64_IEEE PHRControl_CM_double 0 0 -1.7E+308 1.7E+308 ECU_ADDRESS 0x00220238 /end MEASUREMENT
/begin MEASUREMENT PHRControl_B.Divide_m "" FLOAT64_IEEE PHRControl_CM_double 0 0 -1.7E+308 1.7E+308 ECU_ADDRESS 0x00220178 /end MEASUREMENT
/begin MEASUREMENT PHRControl_B.Filter "" FLOAT64_IEEE PHRControl_CM_double 0 0 -1.7E+308 1.7E+308 MATRIX_DIM 1 1 ECU_ADDRESS 0x00220328 /end MEASUREMENT
/begin MEASUREMENT PHRControl_B.FilterCoefficient "" FLOAT64_IEEE PHRControl_CM_double 0 0 -1.7E+308 1.7E+308 MATRIX_DIM 1 1 ECU_ADDRESS 0x00220348 /end MEASUREMENT
/begin MEASUREMENT PHRControl_B.FilterCoefficient_a "" FLOAT64_IEEE PHRControl_CM_double 0 0 -1.7E+308 1.7E+308 MATRIX_DIM 1 1 ECU_ADDRESS 0x002204F8 /end MEASUREMENT
/begin MEASUREMENT PHRControl_B.FilterCoefficient_c "" FLOAT64_IEEE PHRControl_CM_double 0 0 -1.7E+308 1.7E+308 MATRIX_DIM 1 1 ECU_ADDRESS 0x00220690 /end MEASUREMENT
/begin MEASUREMENT PHRControl_B.FilterCoefficient_d "" FLOAT64_IEEE PHRControl_CM_double 0 0 -1.7E+308 1.7E+308 MATRIX_DIM 1 1 ECU_ADDRESS 0x00220808 /end MEASUREMENT
/begin MEASUREMENT PHRControl_B.FilterCoefficient_e "" FLOAT64_IEEE PHRControl_CM_double 0 0 -1.7E+308 1.7E+308 MATRIX_DIM 1 1 ECU_ADDRESS 0x002205F0 /end MEASUREMENT
/begin MEASUREMENT PHRControl_B.FilterCoefficient_f "" FLOAT64_IEEE PHRControl_CM_double 0 0 -1.7E+308 1.7E+308 MATRIX_DIM 1 1 ECU_ADDRESS 0x00220638 /end MEASUREMENT
/begin MEASUREMENT PHRControl_B.FilterCoefficient_h "" FLOAT64_IEEE PHRControl_CM_double 0 0 -1.7E+308 1.7E+308 MATRIX_DIM 1 1 ECU_ADDRESS 0x002204B0 /end MEASUREMENT
/begin MEASUREMENT PHRControl_B.FilterCoefficient_hu "" FLOAT64_IEEE PHRControl_CM_double 0 0 -1.7E+308 1.7E+308 MATRIX_DIM 1 1 ECU_ADDRESS 0x00220850 /end MEASUREMENT
/begin MEASUREMENT PHRControl_B.FilterCoefficient_hx "" FLOAT64_IEEE PHRControl_CM_double 0 0 -1.7E+308 1.7E+308 ECU_ADDRESS 0x00220738 /end MEASUREMENT
/begin MEASUREMENT PHRControl_B.FilterCoefficient_l "" FLOAT64_IEEE PHRControl_CM_double 0 0 -1.7E+308 1.7E+308 MATRIX_DIM 1 1 ECU_ADDRESS 0x00220558 /end MEASUREMENT
/begin MEASUREMENT PHRControl_B.FilterCoefficient_m "" FLOAT64_IEEE PHRControl_CM_double 0 0 -1.7E+308 1.7E+308 ECU_ADDRESS 0x002206F0 /end MEASUREMENT
/begin MEASUREMENT PHRControl_B.FilterCoefficient_p "" FLOAT64_IEEE PHRControl_CM_double 0 0 -1.7E+308 1.7E+308 MATRIX_DIM 1 1 ECU_ADDRESS 0x00220398 /end MEASUREMENT
/begin MEASUREMENT PHRControl_B.Filter_a "" FLOAT64_IEEE PHRControl_CM_double 0 0 -1.7E+308 1.7E+308 MATRIX_DIM 1 1 ECU_ADDRESS 0x002207E8 /end MEASUREMENT
/begin MEASUREMENT PHRControl_B.Filter_c "" FLOAT64_IEEE PHRControl_CM_double 0 0 -1.7E+308 1.7E+308 MATRIX_DIM 1 1 ECU_ADDRESS 0x00220538 /end MEASUREMENT
/begin MEASUREMENT PHRControl_B.Filter_d "" FLOAT64_IEEE PHRControl_CM_double 0 0 -1.7E+308 1.7E+308 ECU_ADDRESS 0x00220718 /end MEASUREMENT
/begin MEASUREMENT PHRControl_B.Filter_f "" FLOAT64_IEEE PHRControl_CM_double 0 0 -1.7E+308 1.7E+308 MATRIX_DIM 1 1 ECU_ADDRESS 0x00220670 /end MEASUREMENT
/begin MEASUREMENT PHRControl_B.Filter_g "" FLOAT64_IEEE PHRControl_CM_double 0 0 -1.7E+308 1.7E+308 MATRIX_DIM 1 1 ECU_ADDRESS 0x00220490 /end MEASUREMENT
/begin MEASUREMENT PHRControl_B.Filter_i "" FLOAT64_IEEE PHRControl_CM_double 0 0 -1.7E+308 1.7E+308 ECU_ADDRESS 0x002206D0 /end MEASUREMENT
/begin MEASUREMENT PHRControl_B.Filter_j "" FLOAT64_IEEE PHRControl_CM_double 0 0 -1.7E+308 1.7E+308 MATRIX_DIM 1 1 ECU_ADDRESS 0x00220618 /end MEASUREMENT
/begin MEASUREMENT PHRControl_B.Filter_jl "" FLOAT64_IEEE PHRControl_CM_double 0 0 -1.7E+308 1.7E+308 MATRIX_DIM 1 1 ECU_ADDRESS 0x00220830 /end MEASUREMENT
/begin MEASUREMENT PHRControl_B.Filter_k "" FLOAT64_IEEE PHRControl_CM_double 0 0 -1.7E+308 1.7E+308 MATRIX_DIM 1 1 ECU_ADDRESS 0x00220378 /end MEASUREMENT
/begin MEASUREMENT PHRControl_B.Filter_kx "" FLOAT64_IEEE PHRControl_CM_double 0 0 -1.7E+308 1.7E+308 MATRIX_DIM 1 1 ECU_ADDRESS 0x002205D0 /end MEASUREMENT
/begin MEASUREMENT PHRControl_B.Filter_n "" FLOAT64_IEEE PHRControl_CM_double 0 0 -1.7E+308 1.7E+308 MATRIX_DIM 1 1 ECU_ADDRESS 0x002204D8 /end MEASUREMENT
/begin MEASUREMENT PHRControl_B.Gain "" FLOAT64_IEEE PHRControl_CM_double 0 0 -1.7E+308 1.7E+308 ECU_ADDRESS 0x002208C8 /end MEASUREMENT
/begin MEASUREMENT PHRControl_B.Gain1 "" FLOAT64_IEEE PHRControl_CM_double 0 0 -1.7E+308 1.7E+308 ECU_ADDRESS 0x0021FF00 /end MEASUREMENT
/begin MEASUREMENT PHRControl_B.Gain10 "" FLOAT64_IEEE PHRControl_CM_double 0 0 -1.7E+308 1.7E+308 ECU_ADDRESS 0x0021FEE8 /end MEASUREMENT
/begin MEASUREMENT PHRControl_B.Gain2 "" FLOAT64_IEEE PHRControl_CM_double 0 0 -1.7E+308 1.7E+308 ECU_ADDRESS 0x002208D0 /end MEASUREMENT
/begin MEASUREMENT PHRControl_B.Gain6 "" FLOAT64_IEEE PHRControl_CM_double 0 0 -1.7E+308 1.7E+308 ECU_ADDRESS 0x0021FEF8 /end MEASUREMENT
/begin MEASUREMENT PHRControl_B.Gain8 "" FLOAT64_IEEE PHRControl_CM_double 0 0 -1.7E+308 1.7E+308 ECU_ADDRESS 0x0021FEF0 /end MEASUREMENT
/begin MEASUREMENT PHRControl_B.HSW "" FLOAT64_IEEE PHRControl_CM_double 0 0 -1.7E+308 1.7E+308 ECU_ADDRESS 0x00220770 /end MEASUREMENT
/begin MEASUREMENT PHRControl_B.ID "" FLOAT64_IEEE PHRControl_CM_double 0 0 -1.7E+308 1.7E+308 ECU_ADDRESS 0x00220880 /end MEASUREMENT
/begin MEASUREMENT PHRControl_B.ID_j "" FLOAT64_IEEE PHRControl_CM_double 0 0 -1.7E+308 1.7E+308 ECU_ADDRESS 0x002208C0 /end MEASUREMENT
/begin MEASUREMENT PHRControl_B.Idle.DerivativeGain "" FLOAT64_IEEE PHRControl_CM_double 0 0 -1.7E+308 1.7E+308 ECU_ADDRESS 0x002209D0 /end MEASUREMENT
/begin MEASUREMENT PHRControl_B.Idle.DerivativeGain_f "" FLOAT64_IEEE PHRControl_CM_double 0 0 -1.7E+308 1.7E+308 ECU_ADDRESS 0x00220A20 /end MEASUREMENT
/begin MEASUREMENT PHRControl_B.Idle.Filter "" FLOAT64_IEEE PHRControl_CM_double 0 0 -1.7E+308 1.7E+308 MATRIX_DIM 1 1 ECU_ADDRESS 0x002209D8 /end MEASUREMENT
/begin MEASUREMENT PHRControl_B.Idle.FilterCoefficient "" FLOAT64_IEEE PHRControl_CM_double 0 0 -1.7E+308 1.7E+308 MATRIX_DIM 1 1 ECU_ADDRESS 0x002209F8 /end MEASUREMENT
/begin MEASUREMENT PHRControl_B.Idle.FilterCoefficient_i "" FLOAT64_IEEE PHRControl_CM_double 0 0 -1.7E+308 1.7E+308 MATRIX_DIM 1 1 ECU_ADDRESS 0x00220A48 /end MEASUREMENT
/begin MEASUREMENT PHRControl_B.Idle.Filter_k "" FLOAT64_IEEE PHRControl_CM_double 0 0 -1.7E+308 1.7E+308 MATRIX_DIM 1 1 ECU_ADDRESS 0x00220A28 /end MEASUREMENT
/begin MEASUREMENT PHRControl_B.Idle.IntegralGain "" FLOAT64_IEEE PHRControl_CM_double 0 0 -1.7E+308 1.7E+308 ECU_ADDRESS 0x002209E8 /end MEASUREMENT
/begin MEASUREMENT PHRControl_B.Idle.IntegralGain_m "" FLOAT64_IEEE PHRControl_CM_double 0 0 -1.7E+308 1.7E+308 ECU_ADDRESS 0x00220A38 /end MEASUREMENT
/begin MEASUREMENT PHRControl_B.Idle.Integrator "" FLOAT64_IEEE PHRControl_CM_double 0 0 -1.7E+308 1.7E+308 ECU_ADDRESS 0x002209F0 /end MEASUREMENT
/begin MEASUREMENT PHRControl_B.Idle.Integrator_j "" FLOAT64_IEEE PHRControl_CM_double 0 0 -1.7E+308 1.7E+308 ECU_ADDRESS 0x00220A40 /end MEASUREMENT
/begin MEASUREMENT PHRControl_B.Idle.ProportionalGain "" FLOAT64_IEEE PHRControl_CM_double 0 0 -1.7E+308 1.7E+308 ECU_ADDRESS 0x00220A00 /end MEASUREMENT
/begin MEASUREMENT PHRControl_B.Idle.ProportionalGain_h "" FLOAT64_IEEE PHRControl_CM_double 0 0 -1.7E+308 1.7E+308 ECU_ADDRESS 0x00220A50 /end MEASUREMENT
/begin MEASUREMENT PHRControl_B.Idle.Sum "" FLOAT64_IEEE PHRControl_CM_double 0 0 -1.7E+308 1.7E+308 MATRIX_DIM 1 1 ECU_ADDRESS 0x00220A08 /end MEASUREMENT
/begin MEASUREMENT PHRControl_B.Idle.Sum1 "" FLOAT64_IEEE PHRControl_CM_double 0 0 -1.7E+308 1.7E+308 ECU_ADDRESS 0x002209C8 /end MEASUREMENT
/begin MEASUREMENT PHRControl_B.Idle.Sum2 "" FLOAT64_IEEE PHRControl_CM_double 0 0 -1.7E+308 1.7E+308 ECU_ADDRESS 0x00220A18 /end MEASUREMENT
/begin MEASUREMENT PHRControl_B.Idle.Sum6 "" FLOAT64_IEEE PHRControl_CM_double 0 0 -1.7E+308 1.7E+308 ECU_ADDRESS 0x00220A10 /end MEASUREMENT
/begin MEASUREMENT PHRControl_B.Idle.SumD "" FLOAT64_IEEE PHRControl_CM_double 0 0 -1.7E+308 1.7E+308 MATRIX_DIM 1 1 ECU_ADDRESS 0x002209E0 /end MEASUREMENT
/begin MEASUREMENT PHRControl_B.Idle.SumD_l "" FLOAT64_IEEE PHRControl_CM_double 0 0 -1.7E+308 1.7E+308 MATRIX_DIM 1 1 ECU_ADDRESS 0x00220A30 /end MEASUREMENT
/begin MEASUREMENT PHRControl_B.Idle.Sum_b "" FLOAT64_IEEE PHRControl_CM_double 0 0 -1.7E+308 1.7E+308 MATRIX_DIM 1 1 ECU_ADDRESS 0x00220A58 /end MEASUREMENT
/begin MEASUREMENT PHRControl_B.Idle_l.DerivativeGain "" FLOAT64_IEEE PHRControl_CM_double 0 0 -1.7E+308 1.7E+308 ECU_ADDRESS 0x00220938 /end MEASUREMENT
/begin MEASUREMENT PHRControl_B.Idle_l.DerivativeGain_f "" FLOAT64_IEEE PHRControl_CM_double 0 0 -1.7E+308 1.7E+308 ECU_ADDRESS 0x00220988 /end MEASUREMENT
/begin MEASUREMENT PHRControl_B.Idle_l.Filter "" FLOAT64_IEEE PHRControl_CM_double 0 0 -1.7E+308 1.7E+308 MATRIX_DIM 1 1 ECU_ADDRESS 0x00220940 /end MEASUREMENT
/begin MEASUREMENT PHRControl_B.Idle_l.FilterCoefficient "" FLOAT64_IEEE PHRControl_CM_double 0 0 -1.7E+308 1.7E+308 MATRIX_DIM 1 1 ECU_ADDRESS 0x00220960 /end MEASUREMENT
/begin MEASUREMENT PHRControl_B.Idle_l.FilterCoefficient_i "" FLOAT64_IEEE PHRControl_CM_double 0 0 -1.7E+308 1.7E+308 MATRIX_DIM 1 1 ECU_ADDRESS 0x002209B0 /end MEASUREMENT
/begin MEASUREMENT PHRControl_B.Idle_l.Filter_k "" FLOAT64_IEEE PHRControl_CM_double 0 0 -1.7E+308 1.7E+308 MATRIX_DIM 1 1 ECU_ADDRESS 0x00220990 /end MEASUREMENT
/begin MEASUREMENT PHRControl_B.Idle_l.IntegralGain "" FLOAT64_IEEE PHRControl_CM_double 0 0 -1.7E+308 1.7E+308 ECU_ADDRESS 0x00220950 /end MEASUREMENT
/begin MEASUREMENT PHRControl_B.Idle_l.IntegralGain_m "" FLOAT64_IEEE PHRControl_CM_double 0 0 -1.7E+308 1.7E+308 ECU_ADDRESS 0x002209A0 /end MEASUREMENT
/begin MEASUREMENT PHRControl_B.Idle_l.Integrator "" FLOAT64_IEEE PHRControl_CM_double 0 0 -1.7E+308 1.7E+308 ECU_ADDRESS 0x00220958 /end MEASUREMENT
/begin MEASUREMENT PHRControl_B.Idle_l.Integrator_j "" FLOAT64_IEEE PHRControl_CM_double 0 0 -1.7E+308 1.7E+308 ECU_ADDRESS 0x002209A8 /end MEASUREMENT
/begin MEASUREMENT PHRControl_B.Idle_l.ProportionalGain "" FLOAT64_IEEE PHRControl_CM_double 0 0 -1.7E+308 1.7E+308 ECU_ADDRESS 0x00220968 /end MEASUREMENT
/begin MEASUREMENT PHRControl_B.Idle_l.ProportionalGain_h "" FLOAT64_IEEE PHRControl_CM_double 0 0 -1.7E+308 1.7E+308 ECU_ADDRESS 0x002209B8 /end MEASUREMENT
/begin MEASUREMENT PHRControl_B.Idle_l.Sum "" FLOAT64_IEEE PHRControl_CM_double 0 0 -1.7E+308 1.7E+308 MATRIX_DIM 1 1 ECU_ADDRESS 0x00220970 /end MEASUREMENT
/begin MEASUREMENT PHRControl_B.Idle_l.Sum1 "" FLOAT64_IEEE PHRControl_CM_double 0 0 -1.7E+308 1.7E+308 ECU_ADDRESS 0x00220930 /end MEASUREMENT
/begin MEASUREMENT PHRControl_B.Idle_l.Sum2 "" FLOAT64_IEEE PHRControl_CM_double 0 0 -1.7E+308 1.7E+308 ECU_ADDRESS 0x00220980 /end MEASUREMENT
/begin MEASUREMENT PHRControl_B.Idle_l.Sum6 "" FLOAT64_IEEE PHRControl_CM_double 0 0 -1.7E+308 1.7E+308 ECU_ADDRESS 0x00220978 /end MEASUREMENT
/begin MEASUREMENT PHRControl_B.Idle_l.SumD "" FLOAT64_IEEE PHRControl_CM_double 0 0 -1.7E+308 1.7E+308 MATRIX_DIM 1 1 ECU_ADDRESS 0x00220948 /end MEASUREMENT
/begin MEASUREMENT PHRControl_B.Idle_l.SumD_l "" FLOAT64_IEEE PHRControl_CM_double 0 0 -1.7E+308 1.7E+308 MATRIX_DIM 1 1 ECU_ADDRESS 0x00220998 /end MEASUREMENT
/begin MEASUREMENT PHRControl_B.Idle_l.Sum_b "" FLOAT64_IEEE PHRControl_CM_double 0 0 -1.7E+308 1.7E+308 MATRIX_DIM 1 1 ECU_ADDRESS 0x002209C0 /end MEASUREMENT
/begin MEASUREMENT PHRControl_B.IntegralGain "" FLOAT64_IEEE PHRControl_CM_double 0 0 -1.7E+308 1.7E+308 ECU_ADDRESS 0x00220338 /end MEASUREMENT
/begin MEASUREMENT PHRControl_B.IntegralGain_a "" FLOAT64_IEEE PHRControl_CM_double 0 0 -1.7E+308 1.7E+308 ECU_ADDRESS 0x002206E0 /end MEASUREMENT
/begin MEASUREMENT PHRControl_B.IntegralGain_c "" FLOAT64_IEEE PHRControl_CM_double 0 0 -1.7E+308 1.7E+308 ECU_ADDRESS 0x00220628 /end MEASUREMENT
/begin MEASUREMENT PHRControl_B.IntegralGain_f "" FLOAT64_IEEE PHRControl_CM_double 0 0 -1.7E+308 1.7E+308 ECU_ADDRESS 0x00220388 /end MEASUREMENT
/begin MEASUREMENT PHRControl_B.IntegralGain_g "" FLOAT64_IEEE PHRControl_CM_double 0 0 -1.7E+308 1.7E+308 ECU_ADDRESS 0x002205E0 /end MEASUREMENT
/begin MEASUREMENT PHRControl_B.IntegralGain_h "" FLOAT64_IEEE PHRControl_CM_double 0 0 -1.7E+308 1.7E+308 ECU_ADDRESS 0x00220680 /end MEASUREMENT
/begin MEASUREMENT PHRControl_B.IntegralGain_i "" FLOAT64_IEEE PHRControl_CM_double 0 0 -1.7E+308 1.7E+308 ECU_ADDRESS 0x002204A0 /end MEASUREMENT
/begin MEASUREMENT PHRControl_B.IntegralGain_j "" FLOAT64_IEEE PHRControl_CM_double 0 0 -1.7E+308 1.7E+308 ECU_ADDRESS 0x00220840 /end MEASUREMENT
/begin MEASUREMENT PHRControl_B.IntegralGain_k "" FLOAT64_IEEE PHRControl_CM_double 0 0 -1.7E+308 1.7E+308 ECU_ADDRESS 0x00220548 /end MEASUREMENT
/begin MEASUREMENT PHRControl_B.IntegralGain_m "" FLOAT64_IEEE PHRControl_CM_double 0 0 -1.7E+308 1.7E+308 ECU_ADDRESS 0x002207F8 /end MEASUREMENT
/begin MEASUREMENT PHRControl_B.IntegralGain_p "" FLOAT64_IEEE PHRControl_CM_double 0 0 -1.7E+308 1.7E+308 ECU_ADDRESS 0x002204E8 /end MEASUREMENT
/begin MEASUREMENT PHRControl_B.IntegralGain_pj "" FLOAT64_IEEE PHRControl_CM_double 0 0 -1.7E+308 1.7E+308 ECU_ADDRESS 0x00220728 /end MEASUREMENT
/begin MEASUREMENT PHRControl_B.Integrator "" FLOAT64_IEEE PHRControl_CM_double 0 0 -1.7E+308 1.7E+308 ECU_ADDRESS 0x00220340 /end MEASUREMENT
/begin MEASUREMENT PHRControl_B.Integrator_b "" FLOAT64_IEEE PHRControl_CM_double 0 0 -1.7E+308 1.7E+308 ECU_ADDRESS 0x002205E8 /end MEASUREMENT
/begin MEASUREMENT PHRControl_B.Integrator_c "" FLOAT64_IEEE PHRControl_CM_double 0 0 -1.7E+308 1.7E+308 ECU_ADDRESS 0x002206E8 /end MEASUREMENT
/begin MEASUREMENT PHRControl_B.Integrator_g "" FLOAT64_IEEE PHRControl_CM_double 0 0 -1.7E+308 1.7E+308 ECU_ADDRESS 0x00220730 /end MEASUREMENT
/begin MEASUREMENT PHRControl_B.Integrator_i "" FLOAT64_IEEE PHRControl_CM_double 0 0 -1.7E+308 1.7E+308 ECU_ADDRESS 0x00220390 /end MEASUREMENT
/begin MEASUREMENT PHRControl_B.Integrator_j "" FLOAT64_IEEE PHRControl_CM_double 0 0 -1.7E+308 1.7E+308 ECU_ADDRESS 0x00220630 /end MEASUREMENT
/begin MEASUREMENT PHRControl_B.Integrator_k "" FLOAT64_IEEE PHRControl_CM_double 0 0 -1.7E+308 1.7E+308 ECU_ADDRESS 0x00220550 /end MEASUREMENT
/begin MEASUREMENT PHRControl_B.Integrator_n "" FLOAT64_IEEE PHRControl_CM_double 0 0 -1.7E+308 1.7E+308 ECU_ADDRESS 0x002204A8 /end MEASUREMENT
/begin MEASUREMENT PHRControl_B.Integrator_n0 "" FLOAT64_IEEE PHRControl_CM_double 0 0 -1.7E+308 1.7E+308 ECU_ADDRESS 0x002204F0 /end MEASUREMENT
/begin MEASUREMENT PHRControl_B.Integrator_o "" FLOAT64_IEEE PHRControl_CM_double 0 0 -1.7E+308 1.7E+308 ECU_ADDRESS 0x00220688 /end MEASUREMENT
/begin MEASUREMENT PHRControl_B.Integrator_ob "" FLOAT64_IEEE PHRControl_CM_double 0 0 -1.7E+308 1.7E+308 ECU_ADDRESS 0x00220800 /end MEASUREMENT
/begin MEASUREMENT PHRControl_B.Integrator_p "" FLOAT64_IEEE PHRControl_CM_double 0 0 -1.7E+308 1.7E+308 ECU_ADDRESS 0x00220848 /end MEASUREMENT
/begin MEASUREMENT PHRControl_B.Kd1 "" FLOAT64_IEEE PHRControl_CM_double 0 0 -1.7E+308 1.7E+308 ECU_ADDRESS 0x0021FF48 /end MEASUREMENT
/begin MEASUREMENT PHRControl_B.Kd2 "" FLOAT64_IEEE PHRControl_CM_double 0 0 -1.7E+308 1.7E+308 ECU_ADDRESS 0x0021FF50 /end MEASUREMENT
/begin MEASUREMENT PHRControl_B.KneeJointAngle1 "" FLOAT64_IEEE PHRControl_CM_double 0 0 -1.7E+308 1.7E+308 ECU_ADDRESS 0x00220780 /end MEASUREMENT
/begin MEASUREMENT PHRControl_B.Kp1 "" FLOAT64_IEEE PHRControl_CM_double 0 0 -1.7E+308 1.7E+308 ECU_ADDRESS 0x0021FF38 /end MEASUREMENT
/begin MEASUREMENT PHRControl_B.Kp2 "" FLOAT64_IEEE PHRControl_CM_double 0 0 -1.7E+308 1.7E+308 ECU_ADDRESS 0x0021FF40 /end MEASUREMENT
/begin MEASUREMENT PHRControl_B.MachineState "" FLOAT64_IEEE PHRControl_CM_double 0 0 -1.7E+308 1.7E+308 ECU_ADDRESS 0x0021FF58 /end MEASUREMENT
/begin MEASUREMENT PHRControl_B.Minus "" FLOAT64_IEEE PHRControl_CM_double 0 0 -1.7E+308 1.7E+308 ECU_ADDRESS 0x002201D8 /end MEASUREMENT
/begin MEASUREMENT PHRControl_B.MultiportSwitch "" FLOAT64_IEEE PHRControl_CM_double 0 0 -1.7E+308 1.7E+308 ECU_ADDRESS 0x0021FEE0 /end MEASUREMENT
/begin MEASUREMENT PHRControl_B.MultiportSwitch_e "" UBYTE PHRControl_CM_uint8 0 0 0 255 LAYOUT COLUMN_DIR MATRIX_DIM 8 ECU_ADDRESS 0x00220908 /end MEASUREMENT
/begin MEASUREMENT PHRControl_B.MultiportSwitch_l "" UBYTE PHRControl_CM_uint8 0 0 0 255 LAYOUT COLUMN_DIR MATRIX_DIM 8 ECU_ADDRESS 0x00220918 /end MEASUREMENT
/begin MEASUREMENT PHRControl_B.NP "" FLOAT64_IEEE PHRControl_CM_double 0 0 -1.7E+308 1.7E+308 ECU_ADDRESS 0x00220470 /end MEASUREMENT
/begin MEASUREMENT PHRControl_B.NPOffset "" FLOAT64_IEEE PHRControl_CM_double 0 0 -1.7E+308 1.7E+308 ECU_ADDRESS 0x00220438 /end MEASUREMENT
/begin MEASUREMENT PHRControl_B.NPOffset_l "" FLOAT64_IEEE PHRControl_CM_double 0 0 -1.7E+308 1.7E+308 ECU_ADDRESS 0x00220790 /end MEASUREMENT
/begin MEASUREMENT PHRControl_B.NP_h "" FLOAT64_IEEE PHRControl_CM_double 0 0 -1.7E+308 1.7E+308 ECU_ADDRESS 0x002207C0 /end MEASUREMENT
/begin MEASUREMENT PHRControl_B.Product "" FLOAT64_IEEE PHRControl_CM_double 0 0 -1.7E+308 1.7E+308 ECU_ADDRESS 0x00220190 /end MEASUREMENT
/begin MEASUREMENT PHRControl_B.Product1 "" FLOAT64_IEEE PHRControl_CM_double 0 0 -1.7E+308 1.7E+308 ECU_ADDRESS 0x00220040 /end MEASUREMENT
/begin MEASUREMENT PHRControl_B.Product1_a "" FLOAT64_IEEE PHRControl_CM_double 0 0 -1.7E+308 1.7E+308 ECU_ADDRESS 0x00220090 /end MEASUREMENT
/begin MEASUREMENT PHRControl_B.Product1_c "" FLOAT64_IEEE PHRControl_CM_double 0 0 -1.7E+308 1.7E+308 ECU_ADDRESS 0x00220200 /end MEASUREMENT
/begin MEASUREMENT PHRControl_B.Product1_i "" FLOAT64_IEEE PHRControl_CM_double 0 0 -1.7E+308 1.7E+308 ECU_ADDRESS 0x00220270 /end MEASUREMENT
/begin MEASUREMENT PHRControl_B.Product1_j "" FLOAT64_IEEE PHRControl_CM_double 0 0 -1.7E+308 1.7E+308 ECU_ADDRESS 0x00220588 /end MEASUREMENT
/begin MEASUREMENT PHRControl_B.Product1_p "" FLOAT64_IEEE PHRControl_CM_double 0 0 -1.7E+308 1.7E+308 ECU_ADDRESS 0x00220140 /end MEASUREMENT
/begin MEASUREMENT PHRControl_B.Product2 "" FLOAT64_IEEE PHRControl_CM_double 0 0 -1.7E+308 1.7E+308 ECU_ADDRESS 0x0021FF98 /end MEASUREMENT
/begin MEASUREMENT PHRControl_B.Product2_c "" FLOAT64_IEEE PHRControl_CM_double 0 0 -1.7E+308 1.7E+308 ECU_ADDRESS 0x00220028 /end MEASUREMENT
/begin MEASUREMENT PHRControl_B.Product2_i "" FLOAT64_IEEE PHRControl_CM_double 0 0 -1.7E+308 1.7E+308 ECU_ADDRESS 0x002201E8 /end MEASUREMENT
/begin MEASUREMENT PHRControl_B.Product2_k "" FLOAT64_IEEE PHRControl_CM_double 0 0 -1.7E+308 1.7E+308 ECU_ADDRESS 0x00220128 /end MEASUREMENT
/begin MEASUREMENT PHRControl_B.Product2_l "" FLOAT64_IEEE PHRControl_CM_double 0 0 -1.7E+308 1.7E+308 ECU_ADDRESS 0x002205A0 /end MEASUREMENT
/begin MEASUREMENT PHRControl_B.Product2_p "" FLOAT64_IEEE PHRControl_CM_double 0 0 -1.7E+308 1.7E+308 ECU_ADDRESS 0x00220308 /end MEASUREMENT
/begin MEASUREMENT PHRControl_B.Product3 "" FLOAT64_IEEE PHRControl_CM_double 0 0 -1.7E+308 1.7E+308 ECU_ADDRESS 0x0021FFC0 /end MEASUREMENT
/begin MEASUREMENT PHRControl_B.Product3_b "" FLOAT64_IEEE PHRControl_CM_double 0 0 -1.7E+308 1.7E+308 ECU_ADDRESS 0x002201B8 /end MEASUREMENT
/begin MEASUREMENT PHRControl_B.Product3_bq "" FLOAT64_IEEE PHRControl_CM_double 0 0 -1.7E+308 1.7E+308 ECU_ADDRESS 0x002203D0 /end MEASUREMENT
/begin MEASUREMENT PHRControl_B.Product3_c "" FLOAT64_IEEE PHRControl_CM_double 0 0 -1.7E+308 1.7E+308 ECU_ADDRESS 0x002200C0 /end MEASUREMENT
/begin MEASUREMENT PHRControl_B.Product3_j "" FLOAT64_IEEE PHRControl_CM_double 0 0 -1.7E+308 1.7E+308 ECU_ADDRESS 0x00220298 /end MEASUREMENT
/begin MEASUREMENT PHRControl_B.Product4 "" FLOAT64_IEEE PHRControl_CM_double 0 0 -1.7E+308 1.7E+308 ECU_ADDRESS 0x0021FFA8 /end MEASUREMENT
/begin MEASUREMENT PHRControl_B.Product4_i "" FLOAT64_IEEE PHRControl_CM_double 0 0 -1.7E+308 1.7E+308 ECU_ADDRESS 0x002203B8 /end MEASUREMENT
/begin MEASUREMENT PHRControl_B.Product4_n "" FLOAT64_IEEE PHRControl_CM_double 0 0 -1.7E+308 1.7E+308 ECU_ADDRESS 0x00220280 /end MEASUREMENT
/begin MEASUREMENT PHRControl_B.Product4_p "" FLOAT64_IEEE PHRControl_CM_double 0 0 -1.7E+308 1.7E+308 ECU_ADDRESS 0x002200A8 /end MEASUREMENT
/begin MEASUREMENT PHRControl_B.Product5 "" FLOAT64_IEEE PHRControl_CM_double 0 0 -1.7E+308 1.7E+308 ECU_ADDRESS 0x0021FFF0 /end MEASUREMENT
/begin MEASUREMENT PHRControl_B.Product5_c "" FLOAT64_IEEE PHRControl_CM_double 0 0 -1.7E+308 1.7E+308 ECU_ADDRESS 0x002200F0 /end MEASUREMENT
/begin MEASUREMENT PHRControl_B.Product5_l "" FLOAT64_IEEE PHRControl_CM_double 0 0 -1.7E+308 1.7E+308 ECU_ADDRESS 0x002203F8 /end MEASUREMENT
/begin MEASUREMENT PHRControl_B.Product5_m "" FLOAT64_IEEE PHRControl_CM_double 0 0 -1.7E+308 1.7E+308 ECU_ADDRESS 0x002202C8 /end MEASUREMENT
/begin MEASUREMENT PHRControl_B.Product6 "" FLOAT64_IEEE PHRControl_CM_double 0 0 -1.7E+308 1.7E+308 ECU_ADDRESS 0x0021FFE0 /end MEASUREMENT
/begin MEASUREMENT PHRControl_B.Product6_i "" FLOAT64_IEEE PHRControl_CM_double 0 0 -1.7E+308 1.7E+308 ECU_ADDRESS 0x002200E0 /end MEASUREMENT
/begin MEASUREMENT PHRControl_B.Product6_j "" FLOAT64_IEEE PHRControl_CM_double 0 0 -1.7E+308 1.7E+308 ECU_ADDRESS 0x002202B8 /end MEASUREMENT
/begin MEASUREMENT PHRControl_B.Product6_je "" FLOAT64_IEEE PHRControl_CM_double 0 0 -1.7E+308 1.7E+308 ECU_ADDRESS 0x002203E8 /end MEASUREMENT
/begin MEASUREMENT PHRControl_B.Product7 "" FLOAT64_IEEE PHRControl_CM_double 0 0 -1.7E+308 1.7E+308 ECU_ADDRESS 0x00220068 /end MEASUREMENT
/begin MEASUREMENT PHRControl_B.Product7_a "" FLOAT64_IEEE PHRControl_CM_double 0 0 -1.7E+308 1.7E+308 ECU_ADDRESS 0x00220168 /end MEASUREMENT
/begin MEASUREMENT PHRControl_B.Product7_ad "" FLOAT64_IEEE PHRControl_CM_double 0 0 -1.7E+308 1.7E+308 ECU_ADDRESS 0x00220228 /end MEASUREMENT
/begin MEASUREMENT PHRControl_B.Product8 "" FLOAT64_IEEE PHRControl_CM_double 0 0 -1.7E+308 1.7E+308 ECU_ADDRESS 0x00220058 /end MEASUREMENT
/begin MEASUREMENT PHRControl_B.Product8_a "" FLOAT64_IEEE PHRControl_CM_double 0 0 -1.7E+308 1.7E+308 ECU_ADDRESS 0x00220218 /end MEASUREMENT
/begin MEASUREMENT PHRControl_B.Product8_m "" FLOAT64_IEEE PHRControl_CM_double 0 0 -1.7E+308 1.7E+308 ECU_ADDRESS 0x00220158 /end MEASUREMENT
/begin MEASUREMENT PHRControl_B.Product_h "" FLOAT64_IEEE PHRControl_CM_double 0 0 -1.7E+308 1.7E+308 ECU_ADDRESS 0x002205B0 /end MEASUREMENT
/begin MEASUREMENT PHRControl_B.Product_l "" FLOAT64_IEEE PHRControl_CM_double 0 0 -1.7E+308 1.7E+308 ECU_ADDRESS 0x002202F8 /end MEASUREMENT
/begin MEASUREMENT PHRControl_B.ProportionalGain "" FLOAT64_IEEE PHRControl_CM_double 0 0 -1.7E+308 1.7E+308 ECU_ADDRESS 0x00220350 /end MEASUREMENT
/begin MEASUREMENT PHRControl_B.ProportionalGain_a "" FLOAT64_IEEE PHRControl_CM_double 0 0 -1.7E+308 1.7E+308 ECU_ADDRESS 0x002206F8 /end MEASUREMENT
/begin MEASUREMENT PHRControl_B.ProportionalGain_a5 "" FLOAT64_IEEE PHRControl_CM_double 0 0 -1.7E+308 1.7E+308 ECU_ADDRESS 0x00220810 /end MEASUREMENT
/begin MEASUREMENT PHRControl_B.ProportionalGain_c "" FLOAT64_IEEE PHRControl_CM_double 0 0 -1.7E+308 1.7E+308 ECU_ADDRESS 0x00220500 /end MEASUREMENT
/begin MEASUREMENT PHRControl_B.ProportionalGain_cc "" FLOAT64_IEEE PHRControl_CM_double 0 0 -1.7E+308 1.7E+308 ECU_ADDRESS 0x00220858 /end MEASUREMENT
/begin MEASUREMENT PHRControl_B.ProportionalGain_d "" FLOAT64_IEEE PHRControl_CM_double 0 0 -1.7E+308 1.7E+308 ECU_ADDRESS 0x002205F8 /end MEASUREMENT
/begin MEASUREMENT PHRControl_B.ProportionalGain_dm "" FLOAT64_IEEE PHRControl_CM_double 0 0 -1.7E+308 1.7E+308 ECU_ADDRESS 0x00220640 /end MEASUREMENT
/begin MEASUREMENT PHRControl_B.ProportionalGain_f "" FLOAT64_IEEE PHRControl_CM_double 0 0 -1.7E+308 1.7E+308 ECU_ADDRESS 0x002203A0 /end MEASUREMENT
/begin MEASUREMENT PHRControl_B.ProportionalGain_m "" FLOAT64_IEEE PHRControl_CM_double 0 0 -1.7E+308 1.7E+308 ECU_ADDRESS 0x00220560 /end MEASUREMENT
/begin MEASUREMENT PHRControl_B.ProportionalGain_mv "" FLOAT64_IEEE PHRControl_CM_double 0 0 -1.7E+308 1.7E+308 ECU_ADDRESS 0x00220698 /end MEASUREMENT
/begin MEASUREMENT PHRControl_B.ProportionalGain_n "" FLOAT64_IEEE PHRControl_CM_double 0 0 -1.7E+308 1.7E+308 ECU_ADDRESS 0x002204B8 /end MEASUREMENT
/begin MEASUREMENT PHRControl_B.ProportionalGain_p "" FLOAT64_IEEE PHRControl_CM_double 0 0 -1.7E+308 1.7E+308 ECU_ADDRESS 0x00220740 /end MEASUREMENT
/begin MEASUREMENT PHRControl_B.RateTransition "" FLOAT64_IEEE PHRControl_CM_double 0 0 -1.7E+308 1.7E+308 ECU_ADDRESS 0x0021FE80 /end MEASUREMENT
/begin MEASUREMENT PHRControl_B.Sin "" FLOAT64_IEEE PHRControl_CM_double 0 0 -1.7E+308 1.7E+308 ECU_ADDRESS 0x00220188 /end MEASUREMENT
/begin MEASUREMENT PHRControl_B.Sin1 "" FLOAT64_IEEE PHRControl_CM_double 0 0 -1.7E+308 1.7E+308 ECU_ADDRESS 0x00220038 /end MEASUREMENT
/begin MEASUREMENT PHRControl_B.Sin1_a "" FLOAT64_IEEE PHRControl_CM_double 0 0 -1.7E+308 1.7E+308 ECU_ADDRESS 0x00220458 /end MEASUREMENT
/begin MEASUREMENT PHRControl_B.Sin1_b "" FLOAT64_IEEE PHRControl_CM_double 0 0 -1.7E+308 1.7E+308 ECU_ADDRESS 0x00220598 /end MEASUREMENT
/begin MEASUREMENT PHRControl_B.Sin1_bn "" FLOAT64_IEEE PHRControl_CM_double 0 0 -1.7E+308 1.7E+308 ECU_ADDRESS 0x002207B0 /end MEASUREMENT
/begin MEASUREMENT PHRControl_B.Sin1_g "" FLOAT64_IEEE PHRControl_CM_double 0 0 -1.7E+308 1.7E+308 ECU_ADDRESS 0x00220138 /end MEASUREMENT
/begin MEASUREMENT PHRControl_B.Sin1_k "" FLOAT64_IEEE PHRControl_CM_double 0 0 -1.7E+308 1.7E+308 ECU_ADDRESS 0x002201F8 /end MEASUREMENT
/begin MEASUREMENT PHRControl_B.Sin1_p "" FLOAT64_IEEE PHRControl_CM_double 0 0 -1.7E+308 1.7E+308 ECU_ADDRESS 0x00220088 /end MEASUREMENT
/begin MEASUREMENT PHRControl_B.Sin2 "" FLOAT64_IEEE PHRControl_CM_double 0 0 -1.7E+308 1.7E+308 ECU_ADDRESS 0x0021FFB8 /end MEASUREMENT
/begin MEASUREMENT PHRControl_B.Sin2_f "" FLOAT64_IEEE PHRControl_CM_double 0 0 -1.7E+308 1.7E+308 ECU_ADDRESS 0x002200B8 /end MEASUREMENT
/begin MEASUREMENT PHRControl_B.Sin2_l "" FLOAT64_IEEE PHRControl_CM_double 0 0 -1.7E+308 1.7E+308 ECU_ADDRESS 0x00220290 /end MEASUREMENT
/begin MEASUREMENT PHRControl_B.Sin2_p "" FLOAT64_IEEE PHRControl_CM_double 0 0 -1.7E+308 1.7E+308 ECU_ADDRESS 0x002203C8 /end MEASUREMENT
/begin MEASUREMENT PHRControl_B.Sin3 "" FLOAT64_IEEE PHRControl_CM_double 0 0 -1.7E+308 1.7E+308 ECU_ADDRESS 0x0021FF90 /end MEASUREMENT
/begin MEASUREMENT PHRControl_B.Sin3_e "" FLOAT64_IEEE PHRControl_CM_double 0 0 -1.7E+308 1.7E+308 ECU_ADDRESS 0x0021FFA0 /end MEASUREMENT
/begin MEASUREMENT PHRControl_B.Sin3_g "" FLOAT64_IEEE PHRControl_CM_double 0 0 -1.7E+308 1.7E+308 ECU_ADDRESS 0x00220278 /end MEASUREMENT
/begin MEASUREMENT PHRControl_B.Sin3_j "" FLOAT64_IEEE PHRControl_CM_double 0 0 -1.7E+308 1.7E+308 ECU_ADDRESS 0x002200A0 /end MEASUREMENT
/begin MEASUREMENT PHRControl_B.Sin3_o "" FLOAT64_IEEE PHRControl_CM_double 0 0 -1.7E+308 1.7E+308 ECU_ADDRESS 0x002203B0 /end MEASUREMENT
/begin MEASUREMENT PHRControl_B.Sin4 "" FLOAT64_IEEE PHRControl_CM_double 0 0 -1.7E+308 1.7E+308 ECU_ADDRESS 0x0021FFE8 /end MEASUREMENT
/begin MEASUREMENT PHRControl_B.Sin4_a "" FLOAT64_IEEE PHRControl_CM_double 0 0 -1.7E+308 1.7E+308 ECU_ADDRESS 0x002203F0 /end MEASUREMENT
/begin MEASUREMENT PHRControl_B.Sin4_f "" FLOAT64_IEEE PHRControl_CM_double 0 0 -1.7E+308 1.7E+308 ECU_ADDRESS 0x002202C0 /end MEASUREMENT
/begin MEASUREMENT PHRControl_B.Sin4_m "" FLOAT64_IEEE PHRControl_CM_double 0 0 -1.7E+308 1.7E+308 ECU_ADDRESS 0x002200E8 /end MEASUREMENT
/begin MEASUREMENT PHRControl_B.Sin5 "" FLOAT64_IEEE PHRControl_CM_double 0 0 -1.7E+308 1.7E+308 ECU_ADDRESS 0x0021FFD8 /end MEASUREMENT
/begin MEASUREMENT PHRControl_B.Sin5_a "" FLOAT64_IEEE PHRControl_CM_double 0 0 -1.7E+308 1.7E+308 ECU_ADDRESS 0x002201B0 /end MEASUREMENT
/begin MEASUREMENT PHRControl_B.Sin5_e "" FLOAT64_IEEE PHRControl_CM_double 0 0 -1.7E+308 1.7E+308 ECU_ADDRESS 0x002200D8 /end MEASUREMENT
/begin MEASUREMENT PHRControl_B.Sin5_g "" FLOAT64_IEEE PHRControl_CM_double 0 0 -1.7E+308 1.7E+308 ECU_ADDRESS 0x002202B0 /end MEASUREMENT
/begin MEASUREMENT PHRControl_B.Sin5_i "" FLOAT64_IEEE PHRControl_CM_double 0 0 -1.7E+308 1.7E+308 ECU_ADDRESS 0x002203E0 /end MEASUREMENT
/begin MEASUREMENT PHRControl_B.Sin6 "" FLOAT64_IEEE PHRControl_CM_double 0 0 -1.7E+308 1.7E+308 ECU_ADDRESS 0x00220020 /end MEASUREMENT
/begin MEASUREMENT PHRControl_B.Sin6_b "" FLOAT64_IEEE PHRControl_CM_double 0 0 -1.7E+308 1.7E+308 ECU_ADDRESS 0x002201E0 /end MEASUREMENT
/begin MEASUREMENT PHRControl_B.Sin6_p "" FLOAT64_IEEE PHRControl_CM_double 0 0 -1.7E+308 1.7E+308 ECU_ADDRESS 0x00220120 /end MEASUREMENT
/begin MEASUREMENT PHRControl_B.Sin7 "" FLOAT64_IEEE PHRControl_CM_double 0 0 -1.7E+308 1.7E+308 ECU_ADDRESS 0x00220060 /end MEASUREMENT
/begin MEASUREMENT PHRControl_B.Sin7_f "" FLOAT64_IEEE PHRControl_CM_double 0 0 -1.7E+308 1.7E+308 ECU_ADDRESS 0x00220220 /end MEASUREMENT
/begin MEASUREMENT PHRControl_B.Sin7_h "" FLOAT64_IEEE PHRControl_CM_double 0 0 -1.7E+308 1.7E+308 ECU_ADDRESS 0x00220160 /end MEASUREMENT
/begin MEASUREMENT PHRControl_B.Sin8 "" FLOAT64_IEEE PHRControl_CM_double 0 0 -1.7E+308 1.7E+308 ECU_ADDRESS 0x00220050 /end MEASUREMENT
/begin MEASUREMENT PHRControl_B.Sin8_e "" FLOAT64_IEEE PHRControl_CM_double 0 0 -1.7E+308 1.7E+308 ECU_ADDRESS 0x00220150 /end MEASUREMENT
/begin MEASUREMENT PHRControl_B.Sin8_l "" FLOAT64_IEEE PHRControl_CM_double 0 0 -1.7E+308 1.7E+308 ECU_ADDRESS 0x00220210 /end MEASUREMENT
/begin MEASUREMENT PHRControl_B.Sin_k "" FLOAT64_IEEE PHRControl_CM_double 0 0 -1.7E+308 1.7E+308 ECU_ADDRESS 0x00220798 /end MEASUREMENT
/begin MEASUREMENT PHRControl_B.Sin_m "" FLOAT64_IEEE PHRControl_CM_double 0 0 -1.7E+308 1.7E+308 ECU_ADDRESS 0x00220440 /end MEASUREMENT
/begin MEASUREMENT PHRControl_B.Sin_o "" FLOAT64_IEEE PHRControl_CM_double 0 0 -1.7E+308 1.7E+308 ECU_ADDRESS 0x00220580 /end MEASUREMENT
/begin MEASUREMENT PHRControl_B.Square2 "" FLOAT64_IEEE PHRControl_CM_double 0 0 -1.7E+308 1.7E+308 ECU_ADDRESS 0x0021FFD0 /end MEASUREMENT
/begin MEASUREMENT PHRControl_B.Square2_b "" FLOAT64_IEEE PHRControl_CM_double 0 0 -1.7E+308 1.7E+308 ECU_ADDRESS 0x002202A8 /end MEASUREMENT
/begin MEASUREMENT PHRControl_B.Square2_d "" FLOAT64_IEEE PHRControl_CM_double 0 0 -1.7E+308 1.7E+308 ECU_ADDRESS 0x00220408 /end MEASUREMENT
/begin MEASUREMENT PHRControl_B.Square2_e "" FLOAT64_IEEE PHRControl_CM_double 0 0 -1.7E+308 1.7E+308 ECU_ADDRESS 0x002200D0 /end MEASUREMENT
/begin MEASUREMENT PHRControl_B.Square3 "" FLOAT64_IEEE PHRControl_CM_double 0 0 -1.7E+308 1.7E+308 ECU_ADDRESS 0x00220000 /end MEASUREMENT
/begin MEASUREMENT PHRControl_B.Square3_j "" FLOAT64_IEEE PHRControl_CM_double 0 0 -1.7E+308 1.7E+308 ECU_ADDRESS 0x002202D8 /end MEASUREMENT
/begin MEASUREMENT PHRControl_B.Square3_l "" FLOAT64_IEEE PHRControl_CM_double 0 0 -1.7E+308 1.7E+308 ECU_ADDRESS 0x00220100 /end MEASUREMENT
/begin MEASUREMENT PHRControl_B.Square3_p "" FLOAT64_IEEE PHRControl_CM_double 0 0 -1.7E+308 1.7E+308 ECU_ADDRESS 0x00220410 /end MEASUREMENT
/begin MEASUREMENT PHRControl_B.Sum "" FLOAT64_IEEE PHRControl_CM_double 0 0 -1.7E+308 1.7E+308 ECU_ADDRESS 0x0021FFB0 /end MEASUREMENT
/begin MEASUREMENT PHRControl_B.Sum1 "" FLOAT64_IEEE PHRControl_CM_double 0 0 -1.7E+308 1.7E+308 ECU_ADDRESS 0x00220288 /end MEASUREMENT
/begin MEASUREMENT PHRControl_B.Sum1_a "" FLOAT64_IEEE PHRControl_CM_double 0 0 -1.7E+308 1.7E+308 ECU_ADDRESS 0x00220318 /end MEASUREMENT
/begin MEASUREMENT PHRControl_B.Sum1_h "" FLOAT64_IEEE PHRControl_CM_double 0 0 -1.7E+308 1.7E+308 ECU_ADDRESS 0x00220300 /end MEASUREMENT
/begin MEASUREMENT PHRControl_B.Sum1_n "" FLOAT64_IEEE PHRControl_CM_double 0 0 -1.7E+308 1.7E+308 ECU_ADDRESS 0x002203C0 /end MEASUREMENT
/begin MEASUREMENT PHRControl_B.Sum2 "" FLOAT64_IEEE PHRControl_CM_double 0 0 -1.7E+308 1.7E+308 ECU_ADDRESS 0x00220018 /end MEASUREMENT
/begin MEASUREMENT PHRControl_B.Sum2_a "" FLOAT64_IEEE PHRControl_CM_double 0 0 -1.7E+308 1.7E+308 ECU_ADDRESS 0x00220660 /end MEASUREMENT
/begin MEASUREMENT PHRControl_B.Sum2_k "" FLOAT64_IEEE PHRControl_CM_double 0 0 -1.7E+308 1.7E+308 ECU_ADDRESS 0x00220368 /end MEASUREMENT
/begin MEASUREMENT PHRControl_B.Sum2_o "" FLOAT64_IEEE PHRControl_CM_double 0 0 -1.7E+308 1.7E+308 ECU_ADDRESS 0x00220518 /end MEASUREMENT
/begin MEASUREMENT PHRControl_B.Sum2_p "" FLOAT64_IEEE PHRControl_CM_double 0 0 -1.7E+308 1.7E+308 ECU_ADDRESS 0x00220708 /end MEASUREMENT
/begin MEASUREMENT PHRControl_B.Sum3 "" FLOAT64_IEEE PHRControl_CM_double 0 0 -1.7E+308 1.7E+308 ECU_ADDRESS 0x00220430 /end MEASUREMENT
/begin MEASUREMENT PHRControl_B.Sum3_b "" FLOAT64_IEEE PHRControl_CM_double 0 0 -1.7E+308 1.7E+308 ECU_ADDRESS 0x00220570 /end MEASUREMENT
/begin MEASUREMENT PHRControl_B.Sum3_h "" FLOAT64_IEEE PHRControl_CM_double 0 0 -1.7E+308 1.7E+308 ECU_ADDRESS 0x00220788 /end MEASUREMENT
/begin MEASUREMENT PHRControl_B.Sum3_n "" FLOAT64_IEEE PHRControl_CM_double 0 0 -1.7E+308 1.7E+308 ECU_ADDRESS 0x00220658 /end MEASUREMENT
/begin MEASUREMENT PHRControl_B.Sum4 "" FLOAT64_IEEE PHRControl_CM_double 0 0 -1.7E+308 1.7E+308 ECU_ADDRESS 0x002201A8 /end MEASUREMENT
/begin MEASUREMENT PHRControl_B.Sum4_f "" FLOAT64_IEEE PHRControl_CM_double 0 0 -1.7E+308 1.7E+308 ECU_ADDRESS 0x00220750 /end MEASUREMENT
/begin MEASUREMENT PHRControl_B.Sum4_l "" FLOAT64_IEEE PHRControl_CM_double 0 0 -1.7E+308 1.7E+308 ECU_ADDRESS 0x00220260 /end MEASUREMENT
/begin MEASUREMENT PHRControl_B.Sum5 "" FLOAT64_IEEE PHRControl_CM_double 0 0 -1.7E+308 1.7E+308 ECU_ADDRESS 0x0021FF88 /end MEASUREMENT
/begin MEASUREMENT PHRControl_B.Sum5_c "" FLOAT64_IEEE PHRControl_CM_double 0 0 -1.7E+308 1.7E+308 ECU_ADDRESS 0x00220820 /end MEASUREMENT
/begin MEASUREMENT PHRControl_B.Sum5_e "" FLOAT64_IEEE PHRControl_CM_double 0 0 -1.7E+308 1.7E+308 ECU_ADDRESS 0x002204C8 /end MEASUREMENT
/begin MEASUREMENT PHRControl_B.Sum5_h "" FLOAT64_IEEE PHRControl_CM_double 0 0 -1.7E+308 1.7E+308 ECU_ADDRESS 0x00220608 /end MEASUREMENT
/begin MEASUREMENT PHRControl_B.Sum6 "" FLOAT64_IEEE PHRControl_CM_double 0 0 -1.7E+308 1.7E+308 ECU_ADDRESS 0x0021FF80 /end MEASUREMENT
/begin MEASUREMENT PHRControl_B.Sum6_d "" FLOAT64_IEEE PHRControl_CM_double 0 0 -1.7E+308 1.7E+308 ECU_ADDRESS 0x00220590 /end MEASUREMENT
/begin MEASUREMENT PHRControl_B.Sum6_dr "" FLOAT64_IEEE PHRControl_CM_double 0 0 -1.7E+308 1.7E+308 ECU_ADDRESS 0x00220758 /end MEASUREMENT
/begin MEASUREMENT PHRControl_B.Sum6_dy "" FLOAT64_IEEE PHRControl_CM_double 0 0 -1.7E+308 1.7E+308 ECU_ADDRESS 0x002207A8 /end MEASUREMENT
/begin MEASUREMENT PHRControl_B.Sum6_i "" FLOAT64_IEEE PHRControl_CM_double 0 0 -1.7E+308 1.7E+308 ECU_ADDRESS 0x00220360 /end MEASUREMENT
/begin MEASUREMENT PHRControl_B.Sum7 "" FLOAT64_IEEE PHRControl_CM_double 0 0 -1.7E+308 1.7E+308 ECU_ADDRESS 0x002201F0 /end MEASUREMENT
/begin MEASUREMENT PHRControl_B.Sum7_f "" FLOAT64_IEEE PHRControl_CM_double 0 0 -1.7E+308 1.7E+308 ECU_ADDRESS 0x00220450 /end MEASUREMENT
/begin MEASUREMENT PHRControl_B.Sum7_k "" FLOAT64_IEEE PHRControl_CM_double 0 0 -1.7E+308 1.7E+308 ECU_ADDRESS 0x00220258 /end MEASUREMENT
/begin MEASUREMENT PHRControl_B.Sum8 "" FLOAT64_IEEE PHRControl_CM_double 0 0 -1.7E+308 1.7E+308 ECU_ADDRESS 0x00220008 /end MEASUREMENT
/begin MEASUREMENT PHRControl_B.Sum8_b "" FLOAT64_IEEE PHRControl_CM_double 0 0 -1.7E+308 1.7E+308 ECU_ADDRESS 0x00220108 /end MEASUREMENT
/begin MEASUREMENT PHRControl_B.Sum8_g "" FLOAT64_IEEE PHRControl_CM_double 0 0 -1.7E+308 1.7E+308 ECU_ADDRESS 0x002202E0 /end MEASUREMENT
/begin MEASUREMENT PHRControl_B.Sum8_gi "" FLOAT64_IEEE PHRControl_CM_double 0 0 -1.7E+308 1.7E+308 ECU_ADDRESS 0x00220418 /end MEASUREMENT
/begin MEASUREMENT PHRControl_B.SumD "" FLOAT64_IEEE PHRControl_CM_double 0 0 -1.7E+308 1.7E+308 MATRIX_DIM 1 1 ECU_ADDRESS 0x00220330 /end MEASUREMENT
/begin MEASUREMENT PHRControl_B.SumD_c "" FLOAT64_IEEE PHRControl_CM_double 0 0 -1.7E+308 1.7E+308 ECU_ADDRESS 0x002206D8 /end MEASUREMENT
/begin MEASUREMENT PHRControl_B.SumD_ct "" FLOAT64_IEEE PHRControl_CM_double 0 0 -1.7E+308 1.7E+308 MATRIX_DIM 1 1 ECU_ADDRESS 0x00220838 /end MEASUREMENT
/begin MEASUREMENT PHRControl_B.SumD_e "" FLOAT64_IEEE PHRControl_CM_double 0 0 -1.7E+308 1.7E+308 MATRIX_DIM 1 1 ECU_ADDRESS 0x002204E0 /end MEASUREMENT
/begin MEASUREMENT PHRControl_B.SumD_en "" FLOAT64_IEEE PHRControl_CM_double 0 0 -1.7E+308 1.7E+308 ECU_ADDRESS 0x00220720 /end MEASUREMENT
/begin MEASUREMENT PHRControl_B.SumD_f "" FLOAT64_IEEE PHRControl_CM_double 0 0 -1.7E+308 1.7E+308 MATRIX_DIM 1 1 ECU_ADDRESS 0x00220380 /end MEASUREMENT
/begin MEASUREMENT PHRControl_B.SumD_fv "" FLOAT64_IEEE PHRControl_CM_double 0 0 -1.7E+308 1.7E+308 MATRIX_DIM 1 1 ECU_ADDRESS 0x00220678 /end MEASUREMENT
/begin MEASUREMENT PHRControl_B.SumD_k "" FLOAT64_IEEE PHRControl_CM_double 0 0 -1.7E+308 1.7E+308 MATRIX_DIM 1 1 ECU_ADDRESS 0x002207F0 /end MEASUREMENT
/begin MEASUREMENT PHRControl_B.SumD_l "" FLOAT64_IEEE PHRControl_CM_double 0 0 -1.7E+308 1.7E+308 MATRIX_DIM 1 1 ECU_ADDRESS 0x002205D8 /end MEASUREMENT
/begin MEASUREMENT PHRControl_B.SumD_m "" FLOAT64_IEEE PHRControl_CM_double 0 0 -1.7E+308 1.7E+308 MATRIX_DIM 1 1 ECU_ADDRESS 0x00220540 /end MEASUREMENT
/begin MEASUREMENT PHRControl_B.SumD_o "" FLOAT64_IEEE PHRControl_CM_double 0 0 -1.7E+308 1.7E+308 MATRIX_DIM 1 1 ECU_ADDRESS 0x00220620 /end MEASUREMENT
/begin MEASUREMENT PHRControl_B.SumD_p "" FLOAT64_IEEE PHRControl_CM_double 0 0 -1.7E+308 1.7E+308 MATRIX_DIM 1 1 ECU_ADDRESS 0x00220498 /end MEASUREMENT
/begin MEASUREMENT PHRControl_B.Sum_a "" FLOAT64_IEEE PHRControl_CM_double 0 0 -1.7E+308 1.7E+308 MATRIX_DIM 1 1 ECU_ADDRESS 0x00220818 /end MEASUREMENT
/begin MEASUREMENT PHRControl_B.Sum_b "" FLOAT64_IEEE PHRControl_CM_double 0 0 -1.7E+308 1.7E+308 ECU_ADDRESS 0x00220030 /end MEASUREMENT
/begin MEASUREMENT PHRControl_B.Sum_bj "" FLOAT64_IEEE PHRControl_CM_double 0 0 -1.7E+308 1.7E+308 MATRIX_DIM 1 1 ECU_ADDRESS 0x00220860 /end MEASUREMENT
/begin MEASUREMENT PHRControl_B.Sum_c "" FLOAT64_IEEE PHRControl_CM_double 0 0 -1.7E+308 1.7E+308 ECU_ADDRESS 0x00220130 /end MEASUREMENT
/begin MEASUREMENT PHRControl_B.Sum_c1 "" FLOAT64_IEEE PHRControl_CM_double 0 0 -1.7E+308 1.7E+308 MATRIX_DIM 1 1 ECU_ADDRESS 0x002203A8 /end MEASUREMENT
/begin MEASUREMENT PHRControl_B.Sum_ch "" FLOAT64_IEEE PHRControl_CM_double 0 0 -1.7E+308 1.7E+308 ECU_ADDRESS 0x002202F0 /end MEASUREMENT
/begin MEASUREMENT PHRControl_B.Sum_cr "" FLOAT64_IEEE PHRControl_CM_double 0 0 -1.7E+308 1.7E+308 MATRIX_DIM 1 1 ECU_ADDRESS 0x00220648 /end MEASUREMENT
/begin MEASUREMENT PHRControl_B.Sum_ct "" FLOAT64_IEEE PHRControl_CM_double 0 0 -1.7E+308 1.7E+308 MATRIX_DIM 1 1 ECU_ADDRESS 0x00220358 /end MEASUREMENT
/begin MEASUREMENT PHRControl_B.Sum_d "" FLOAT64_IEEE PHRControl_CM_double 0 0 -1.7E+308 1.7E+308 ECU_ADDRESS 0x00220748 /end MEASUREMENT
/begin MEASUREMENT PHRControl_B.Sum_e "" FLOAT64_IEEE PHRControl_CM_double 0 0 -1.7E+308 1.7E+308 MATRIX_DIM 1 1 ECU_ADDRESS 0x00220568 /end MEASUREMENT
/begin MEASUREMENT PHRControl_B.Sum_g "" FLOAT64_IEEE PHRControl_CM_double 0 0 -1.7E+308 1.7E+308 MATRIX_DIM 1 1 ECU_ADDRESS 0x002206A0 /end MEASUREMENT
/begin MEASUREMENT PHRControl_B.Sum_h "" FLOAT64_IEEE PHRControl_CM_double 0 0 -1.7E+308 1.7E+308 MATRIX_DIM 1 1 ECU_ADDRESS 0x00220508 /end MEASUREMENT
/begin MEASUREMENT PHRControl_B.Sum_hl "" FLOAT64_IEEE PHRControl_CM_double 0 0 -1.7E+308 1.7E+308 ECU_ADDRESS 0x00220700 /end MEASUREMENT
/begin MEASUREMENT PHRControl_B.Sum_i "" FLOAT64_IEEE PHRControl_CM_double 0 0 -1.7E+308 1.7E+308 ECU_ADDRESS 0x00220118 /end MEASUREMENT
/begin MEASUREMENT PHRControl_B.Sum_l "" FLOAT64_IEEE PHRControl_CM_double 0 0 -1.7E+308 1.7E+308 ECU_ADDRESS 0x00220528 /end MEASUREMENT
/begin MEASUREMENT PHRControl_B.Sum_lf "" FLOAT64_IEEE PHRControl_CM_double 0 0 -1.7E+308 1.7E+308 ECU_ADDRESS 0x002206C0 /end MEASUREMENT
/begin MEASUREMENT PHRControl_B.Sum_o "" FLOAT64_IEEE PHRControl_CM_double 0 0 -1.7E+308 1.7E+308 MATRIX_DIM 1 1 ECU_ADDRESS 0x002204C0 /end MEASUREMENT
/begin MEASUREMENT PHRControl_B.Sum_od "" FLOAT64_IEEE PHRControl_CM_double 0 0 -1.7E+308 1.7E+308 MATRIX_DIM 1 1 ECU_ADDRESS 0x00220600 /end MEASUREMENT
/begin MEASUREMENT PHRControl_B.Sum_og "" FLOAT64_IEEE PHRControl_CM_double 0 0 -1.7E+308 1.7E+308 ECU_ADDRESS 0x002205C0 /end MEASUREMENT
/begin MEASUREMENT PHRControl_B.Sum_p "" FLOAT64_IEEE PHRControl_CM_double 0 0 -1.7E+308 1.7E+308 ECU_ADDRESS 0x002200B0 /end MEASUREMENT
/begin MEASUREMENT PHRControl_B.Switch "" FLOAT64_IEEE PHRControl_CM_double 0 0 -1.7E+308 1.7E+308 ECU_ADDRESS 0x0021FEC8 /end MEASUREMENT
/begin MEASUREMENT PHRControl_B.Switch2 "" FLOAT64_IEEE PHRControl_CM_double 0 0 -1.7E+308 1.7E+308 ECU_ADDRESS 0x002206B0 /end MEASUREMENT
/begin MEASUREMENT PHRControl_B.T1 "" FLOAT64_IEEE PHRControl_CM_double 0 0 -1.7E+308 1.7E+308 MATRIX_DIM 1 1 ECU_ADDRESS 0x0021FF68 /end MEASUREMENT
/begin MEASUREMENT PHRControl_B.T1_f "" FLOAT64_IEEE PHRControl_CM_double 0 0 -1.7E+308 1.7E+308 MATRIX_DIM 1 1 ECU_ADDRESS 0x00220760 /end MEASUREMENT
/begin MEASUREMENT PHRControl_B.T2 "" FLOAT64_IEEE PHRControl_CM_double 0 0 -1.7E+308 1.7E+308 MATRIX_DIM 1 1 ECU_ADDRESS 0x0021FF60 /end MEASUREMENT
/begin MEASUREMENT PHRControl_B.T2_e "" FLOAT64_IEEE PHRControl_CM_double 0 0 -1.7E+308 1.7E+308 MATRIX_DIM 1 1 ECU_ADDRESS 0x00220768 /end MEASUREMENT
/begin MEASUREMENT PHRControl_B.TSamp "" FLOAT64_IEEE PHRControl_CM_double 0 0 -1.7E+308 1.7E+308 ECU_ADDRESS 0x0021FE88 /end MEASUREMENT
/begin MEASUREMENT PHRControl_B.TSamp_j "" FLOAT64_IEEE PHRControl_CM_double 0 0 -1.7E+308 1.7E+308 ECU_ADDRESS 0x0021FEA0 /end MEASUREMENT
/begin MEASUREMENT PHRControl_B.TmpSignalConversionAtDelay1Inport1 "" FLOAT64_IEEE PHRControl_CM_double 0 0 -1.7E+308 1.7E+308 LAYOUT COLUMN_DIR MATRIX_DIM 2 ECU_ADDRESS 0x0021FF08 /end MEASUREMENT
/begin MEASUREMENT PHRControl_B.TrigonometricFunction "" FLOAT64_IEEE PHRControl_CM_double 0 0 -1.7E+308 1.7E+308 ECU_ADDRESS 0x00220080 /end MEASUREMENT
/begin MEASUREMENT PHRControl_B.TrigonometricFunction_g "" FLOAT64_IEEE PHRControl_CM_double 0 0 -1.7E+308 1.7E+308 ECU_ADDRESS 0x00220240 /end MEASUREMENT
/begin MEASUREMENT PHRControl_B.TrigonometricFunction_m "" FLOAT64_IEEE PHRControl_CM_double 0 0 -1.7E+308 1.7E+308 ECU_ADDRESS 0x00220180 /end MEASUREMENT
/begin MEASUREMENT PHRControl_B.Uk1 "" FLOAT64_IEEE PHRControl_CM_double 0 0 -1.7E+308 1.7E+308 ECU_ADDRESS 0x0021FE90 /end MEASUREMENT
/begin MEASUREMENT PHRControl_B.Uk1_d "" FLOAT64_IEEE PHRControl_CM_double 0 0 -1.7E+308 1.7E+308 ECU_ADDRESS 0x0021FEA8 /end MEASUREMENT
/begin MEASUREMENT PHRControl_B.WhileIterator "" SLONG PHRControl_CM_int32 0 0 -2147483648 2147483647 ECU_ADDRESS 0x00220900 /end MEASUREMENT
/begin MEASUREMENT PHRControl_B.X_actual "" FLOAT64_IEEE PHRControl_CM_double 0 0 -1.7E+308 1.7E+308 ECU_ADDRESS 0x002205A8 /end MEASUREMENT
/begin MEASUREMENT PHRControl_B.X_desired "" FLOAT64_IEEE PHRControl_CM_double 0 0 -1.7E+308 1.7E+308 ECU_ADDRESS 0x00220478 /end MEASUREMENT
/begin MEASUREMENT PHRControl_B.X_desired_e "" FLOAT64_IEEE PHRControl_CM_double 0 0 -1.7E+308 1.7E+308 ECU_ADDRESS 0x002207C8 /end MEASUREMENT
/begin MEASUREMENT PHRControl_B.X_desired_k "" FLOAT64_IEEE PHRControl_CM_double 0 0 -1.7E+308 1.7E+308 ECU_ADDRESS 0x002205B8 /end MEASUREMENT
/begin MEASUREMENT PHRControl_B.c "" FLOAT64_IEEE PHRControl_CM_double 0 0 -1.7E+308 1.7E+308 ECU_ADDRESS 0x0021FF30 /end MEASUREMENT
/begin MEASUREMENT PHRControl_B.currentlength "" FLOAT64_IEEE PHRControl_CM_double 0 0 -1.7E+308 1.7E+308 ECU_ADDRESS 0x00220010 /end MEASUREMENT
/begin MEASUREMENT PHRControl_B.currentlength_b "" FLOAT64_IEEE PHRControl_CM_double 0 0 -1.7E+308 1.7E+308 ECU_ADDRESS 0x002202E8 /end MEASUREMENT
/begin MEASUREMENT PHRControl_B.currentlength_g "" FLOAT64_IEEE PHRControl_CM_double 0 0 -1.7E+308 1.7E+308 ECU_ADDRESS 0x00220110 /end MEASUREMENT
/begin MEASUREMENT PHRControl_B.currentlength_p "" FLOAT64_IEEE PHRControl_CM_double 0 0 -1.7E+308 1.7E+308 ECU_ADDRESS 0x00220420 /end MEASUREMENT
/begin MEASUREMENT PHRControl_B.danger "" FLOAT64_IEEE PHRControl_CM_double 0 0 -1.7E+308 1.7E+308 ECU_ADDRESS 0x002208F8 /end MEASUREMENT
/begin MEASUREMENT PHRControl_B.desiredspeed "" FLOAT64_IEEE PHRControl_CM_double 0 0 -1.7E+308 1.7E+308 ECU_ADDRESS 0x00220520 /end MEASUREMENT
/begin MEASUREMENT PHRControl_B.error "" FLOAT64_IEEE PHRControl_CM_double 0 0 -1.7E+308 1.7E+308 ECU_ADDRESS 0x00220480 /end MEASUREMENT
/begin MEASUREMENT PHRControl_B.error_d "" FLOAT64_IEEE PHRControl_CM_double 0 0 -1.7E+308 1.7E+308 ECU_ADDRESS 0x002207D8 /end MEASUREMENT
/begin MEASUREMENT PHRControl_B.footx "" FLOAT64_IEEE PHRControl_CM_double 0 0 -1.7E+308 1.7E+308 ECU_ADDRESS 0x00220460 /end MEASUREMENT
/begin MEASUREMENT PHRControl_B.footx_o "" FLOAT64_IEEE PHRControl_CM_double 0 0 -1.7E+308 1.7E+308 ECU_ADDRESS 0x002207B8 /end MEASUREMENT
/begin MEASUREMENT PHRControl_B.footxposition "" FLOAT64_IEEE PHRControl_CM_double 0 0 -1.7E+308 1.7E+308 ECU_ADDRESS 0x0021FFC8 /end MEASUREMENT
/begin MEASUREMENT PHRControl_B.footxposition_a "" FLOAT64_IEEE PHRControl_CM_double 0 0 -1.7E+308 1.7E+308 ECU_ADDRESS 0x002200C8 /end MEASUREMENT
/begin MEASUREMENT PHRControl_B.footxposition_h "" FLOAT64_IEEE PHRControl_CM_double 0 0 -1.7E+308 1.7E+308 ECU_ADDRESS 0x00220048 /end MEASUREMENT
/begin MEASUREMENT PHRControl_B.footxposition_he "" FLOAT64_IEEE PHRControl_CM_double 0 0 -1.7E+308 1.7E+308 ECU_ADDRESS 0x00220148 /end MEASUREMENT
/begin MEASUREMENT PHRControl_B.footxposition_i "" FLOAT64_IEEE PHRControl_CM_double 0 0 -1.7E+308 1.7E+308 ECU_ADDRESS 0x00220208 /end MEASUREMENT
/begin MEASUREMENT PHRControl_B.footxposition_j "" FLOAT64_IEEE PHRControl_CM_double 0 0 -1.7E+308 1.7E+308 ECU_ADDRESS 0x002203D8 /end MEASUREMENT
/begin MEASUREMENT PHRControl_B.footxposition_m "" FLOAT64_IEEE PHRControl_CM_double 0 0 -1.7E+308 1.7E+308 ECU_ADDRESS 0x002202A0 /end MEASUREMENT
/begin MEASUREMENT PHRControl_B.footyposition "" FLOAT64_IEEE PHRControl_CM_double 0 0 -1.7E+308 1.7E+308 ECU_ADDRESS 0x0021FFF8 /end MEASUREMENT
/begin MEASUREMENT PHRControl_B.footyposition_a "" FLOAT64_IEEE PHRControl_CM_double 0 0 -1.7E+308 1.7E+308 ECU_ADDRESS 0x00220170 /end MEASUREMENT
/begin MEASUREMENT PHRControl_B.footyposition_c "" FLOAT64_IEEE PHRControl_CM_double 0 0 -1.7E+308 1.7E+308 ECU_ADDRESS 0x00220070 /end MEASUREMENT
/begin MEASUREMENT PHRControl_B.footyposition_g "" FLOAT64_IEEE PHRControl_CM_double 0 0 -1.7E+308 1.7E+308 ECU_ADDRESS 0x002202D0 /end MEASUREMENT
/begin MEASUREMENT PHRControl_B.footyposition_h "" FLOAT64_IEEE PHRControl_CM_double 0 0 -1.7E+308 1.7E+308 ECU_ADDRESS 0x002200F8 /end MEASUREMENT
/begin MEASUREMENT PHRControl_B.footyposition_k "" FLOAT64_IEEE PHRControl_CM_double 0 0 -1.7E+308 1.7E+308 ECU_ADDRESS 0x00220400 /end MEASUREMENT
/begin MEASUREMENT PHRControl_B.footyposition_n "" FLOAT64_IEEE PHRControl_CM_double 0 0 -1.7E+308 1.7E+308 ECU_ADDRESS 0x00220230 /end MEASUREMENT
/begin MEASUREMENT PHRControl_B.ground "" UBYTE PHRControl_CM_logical 0 0 0 1 ECU_ADDRESS 0x0022092B /end MEASUREMENT
/begin MEASUREMENT PHRControl_B.hiptorque "" FLOAT64_IEEE PHRControl_CM_double 0 0 -1.7E+308 1.7E+308 ECU_ADDRESS 0x002201D0 /end MEASUREMENT
/begin MEASUREMENT PHRControl_B.hiptorquedenom "" FLOAT64_IEEE PHRControl_CM_double 0 0 -1.7E+308 1.7E+308 ECU_ADDRESS 0x002201C8 /end MEASUREMENT
/begin MEASUREMENT PHRControl_B.hiptorquenum "" FLOAT64_IEEE PHRControl_CM_double 0 0 -1.7E+308 1.7E+308 ECU_ADDRESS 0x00220198 /end MEASUREMENT
/begin MEASUREMENT PHRControl_B.impactangle "" FLOAT64_IEEE PHRControl_CM_double 0 0 -1.7E+308 1.7E+308 ECU_ADDRESS 0x00220510 /end MEASUREMENT
/begin MEASUREMENT PHRControl_B.isReady "" FLOAT64_IEEE PHRControl_CM_double 0 0 -1.7E+308 1.7E+308 ECU_ADDRESS 0x0021FEB8 /end MEASUREMENT
/begin MEASUREMENT PHRControl_B.kneetorque "" FLOAT64_IEEE PHRControl_CM_double 0 0 -1.7E+308 1.7E+308 ECU_ADDRESS 0x00220310 /end MEASUREMENT
/begin MEASUREMENT PHRControl_B.kneex "" FLOAT64_IEEE PHRControl_CM_double 0 0 -1.7E+308 1.7E+308 ECU_ADDRESS 0x00220448 /end MEASUREMENT
/begin MEASUREMENT PHRControl_B.kneex_e "" FLOAT64_IEEE PHRControl_CM_double 0 0 -1.7E+308 1.7E+308 ECU_ADDRESS 0x002207A0 /end MEASUREMENT
/begin MEASUREMENT PHRControl_B.mult2 "" FLOAT64_IEEE PHRControl_CM_double 0 0 -1.7E+308 1.7E+308 ECU_ADDRESS 0x002201A0 /end MEASUREMENT
/begin MEASUREMENT PHRControl_B.mult3 "" FLOAT64_IEEE PHRControl_CM_double 0 0 -1.7E+308 1.7E+308 ECU_ADDRESS 0x002201C0 /end MEASUREMENT
/begin MEASUREMENT PHRControl_B.n "" FLOAT64_IEEE PHRControl_CM_double 0 0 -1.7E+308 1.7E+308 ECU_ADDRESS 0x0021FF70 /end MEASUREMENT
/begin MEASUREMENT PHRControl_B.offsetfromneutralpointtocontrollocomotionspeed "" FLOAT64_IEEE PHRControl_CM_double 0 0 -1.7E+308 1.7E+308 ECU_ADDRESS 0x00220578 /end MEASUREMENT
/begin MEASUREMENT PHRControl_B.pos "" FLOAT64_IEEE PHRControl_CM_double 0 0 -1.7E+308 1.7E+308 ECU_ADDRESS 0x00220888 /end MEASUREMENT
/begin MEASUREMENT PHRControl_B.pos_h "" FLOAT64_IEEE PHRControl_CM_double 0 0 -1.7E+308 1.7E+308 ECU_ADDRESS 0x00220898 /end MEASUREMENT
/begin MEASUREMENT PHRControl_B.sf_bytesfloats.I_ff "" FLOAT64_IEEE PHRControl_CM_double 0 0 -1.7E+308 1.7E+308 ECU_ADDRESS 0x00220A88 /end MEASUREMENT
/begin MEASUREMENT PHRControl_B.sf_bytesfloats.position "" FLOAT64_IEEE PHRControl_CM_double 0 0 -1.7E+308 1.7E+308 ECU_ADDRESS 0x00220A78 /end MEASUREMENT
/begin MEASUREMENT PHRControl_B.sf_bytesfloats.velocity "" FLOAT64_IEEE PHRControl_CM_double 0 0 -1.7E+308 1.7E+308 ECU_ADDRESS 0x00220A80 /end MEASUREMENT
/begin MEASUREMENT PHRControl_B.sf_bytesfloats1.I_ff "" FLOAT64_IEEE PHRControl_CM_double 0 0 -1.7E+308 1.7E+308 ECU_ADDRESS 0x00220A70 /end MEASUREMENT
/begin MEASUREMENT PHRControl_B.sf_bytesfloats1.position "" FLOAT64_IEEE PHRControl_CM_double 0 0 -1.7E+308 1.7E+308 ECU_ADDRESS 0x00220A60 /end MEASUREMENT
/begin MEASUREMENT PHRControl_B.sf_bytesfloats1.velocity "" FLOAT64_IEEE PHRControl_CM_double 0 0 -1.7E+308 1.7E+308 ECU_ADDRESS 0x00220A68 /end MEASUREMENT
/begin MEASUREMENT PHRControl_B.sf_floatsbytes.b "" UBYTE PHRControl_CM_uint8 0 0 0 255 LAYOUT COLUMN_DIR MATRIX_DIM 8 ECU_ADDRESS 0x00220A98 /end MEASUREMENT
/begin MEASUREMENT PHRControl_B.sf_floatsbytes_f.b "" UBYTE PHRControl_CM_uint8 0 0 0 255 LAYOUT COLUMN_DIR MATRIX_DIM 8 ECU_ADDRESS 0x00220A90 /end MEASUREMENT
/begin MEASUREMENT PHRControl_B.stop "" FLOAT64_IEEE PHRControl_CM_double 0 0 -1.7E+308 1.7E+308 ECU_ADDRESS 0x0021FF18 /end MEASUREMENT
/begin MEASUREMENT PHRControl_B.theta1 "" FLOAT64_IEEE PHRControl_CM_double 0 0 -1.7E+308 1.7E+308 ECU_ADDRESS 0x0021FF20 /end MEASUREMENT
/begin MEASUREMENT PHRControl_B.theta2 "" FLOAT64_IEEE PHRControl_CM_double 0 0 -1.7E+308 1.7E+308 ECU_ADDRESS 0x0021FF28 /end MEASUREMENT
/begin MEASUREMENT PHRControl_B.vel "" FLOAT64_IEEE PHRControl_CM_double 0 0 -1.7E+308 1.7E+308 ECU_ADDRESS 0x00220890 /end MEASUREMENT
/begin MEASUREMENT PHRControl_B.vel_e "" FLOAT64_IEEE PHRControl_CM_double 0 0 -1.7E+308 1.7E+308 ECU_ADDRESS 0x002208A0 /end MEASUREMENT
/begin MEASUREMENT PHRControl_B.x "" FLOAT64_IEEE PHRControl_CM_double 0 0 -1.7E+308 1.7E+308 ECU_ADDRESS 0x002208D8 /end MEASUREMENT
/begin MEASUREMENT PHRControl_B.x_actual "" FLOAT64_IEEE PHRControl_CM_double 0 0 -1.7E+308 1.7E+308 ECU_ADDRESS 0x00220468 /end MEASUREMENT
/begin MEASUREMENT PHRControl_B.x_actual_m "" FLOAT64_IEEE PHRControl_CM_double 0 0 -1.7E+308 1.7E+308 ECU_ADDRESS 0x002207D0 /end MEASUREMENT
/begin MEASUREMENT PHRControl_B.xd "" FLOAT64_IEEE PHRControl_CM_double 0 0 -1.7E+308 1.7E+308 ECU_ADDRESS 0x002208E0 /end MEASUREMENT
/begin MEASUREMENT PHRControl_B.z "" FLOAT64_IEEE PHRControl_CM_double 0 0 -1.7E+308 1.7E+308 ECU_ADDRESS 0x002208E8 /end MEASUREMENT
/begin MEASUREMENT PHRControl_B.zd "" FLOAT64_IEEE PHRControl_CM_double 0 0 -1.7E+308 1.7E+308 ECU_ADDRESS 0x002208F0 /end MEASUREMENT
/begin MEASUREMENT PHRControl_DW.CANUnpack1_ModeSignalID "" SLONG PHRControl_CM_int_T 0 0 -2147483648 2147483647 ECU_ADDRESS 0x0021FD4C /end MEASUREMENT
/begin MEASUREMENT PHRControl_DW.CANUnpack1_StatusPortID "" SLONG PHRControl_CM_int_T 0 0 -2147483648 2147483647 ECU_ADDRESS 0x0021FD50 /end MEASUREMENT
/begin MEASUREMENT PHRControl_DW.CANUnpack2_ModeSignalID "" SLONG PHRControl_CM_int_T 0 0 -2147483648 2147483647 ECU_ADDRESS 0x0021FD54 /end MEASUREMENT
/begin MEASUREMENT PHRControl_DW.CANUnpack2_StatusPortID "" SLONG PHRControl_CM_int_T 0 0 -2147483648 2147483647 ECU_ADDRESS 0x0021FD58 /end MEASUREMENT
/begin MEASUREMENT PHRControl_DW.CANUnpack3_ModeSignalID "" SLONG PHRControl_CM_int_T 0 0 -2147483648 2147483647 ECU_ADDRESS 0x0021FD5C /end MEASUREMENT
/begin MEASUREMENT PHRControl_DW.CANUnpack3_StatusPortID "" SLONG PHRControl_CM_int_T 0 0 -2147483648 2147483647 ECU_ADDRESS 0x0021FD60 /end MEASUREMENT
/begin MEASUREMENT PHRControl_DW.CANUnpack_ModeSignalID "" SLONG PHRControl_CM_int_T 0 0 -2147483648 2147483647 ECU_ADDRESS 0x0021FD44 /end MEASUREMENT
/begin MEASUREMENT PHRControl_DW.CANUnpack_StatusPortID "" SLONG PHRControl_CM_int_T 0 0 -2147483648 2147483647 ECU_ADDRESS 0x0021FD48 /end MEASUREMENT
/begin MEASUREMENT PHRControl_DW.Compress_SubsysRanBC "" SBYTE PHRControl_CM_int8 0 0 -128 127 ECU_ADDRESS 0x0021FD7D /end MEASUREMENT
/begin MEASUREMENT PHRControl_DW.Delay1_DSTATE "" FLOAT64_IEEE PHRControl_CM_double 0 0 -1.7E+308 1.7E+308 LAYOUT COLUMN_DIR MATRIX_DIM 2 ECU_ADDRESS 0x0021F978 /end MEASUREMENT
/begin MEASUREMENT PHRControl_DW.Delay2_DSTATE "" UBYTE PHRControl_CM_logical 0 0 0 1 ECU_ADDRESS 0x0021FD76 /end MEASUREMENT
/begin MEASUREMENT PHRControl_DW.DiscreteTimeIntegrator_DSTATE "" FLOAT64_IEEE PHRControl_CM_double 0 0 -1.7E+308 1.7E+308 ECU_ADDRESS 0x0021F970 /end MEASUREMENT
/begin MEASUREMENT PHRControl_DW.DiscreteTimeIntegrator_DSTATE_c "" FLOAT64_IEEE PHRControl_CM_double 0 0 -1.7E+308 1.7E+308 ECU_ADDRESS 0x0021FA08 /end MEASUREMENT
/begin MEASUREMENT PHRControl_DW.DiscreteTimeIntegrator_PrevResetState "" SBYTE PHRControl_CM_int8 0 0 -128 127 ECU_ADDRESS 0x0021FD77 /end MEASUREMENT
/begin MEASUREMENT PHRControl_DW.DiscreteTimeIntegrator_PrevResetState_c "" SBYTE PHRControl_CM_int8 0 0 -128 127 ECU_ADDRESS 0x0021FD80 /end MEASUREMENT
/begin MEASUREMENT PHRControl_DW.EnabledSubsystem_SubsysRanBC "" SBYTE PHRControl_CM_int8 0 0 -128 127 ECU_ADDRESS 0x0021FD82 /end MEASUREMENT
/begin MEASUREMENT PHRControl_DW.Filter_DSTATE "" FLOAT64_IEEE PHRControl_CM_double 0 0 -1.7E+308 1.7E+308 ECU_ADDRESS 0x0021F988 /end MEASUREMENT
/begin MEASUREMENT PHRControl_DW.Filter_DSTATE_a "" FLOAT64_IEEE PHRControl_CM_double 0 0 -1.7E+308 1.7E+308 ECU_ADDRESS 0x0021F9B8 /end MEASUREMENT
/begin MEASUREMENT PHRControl_DW.Filter_DSTATE_ai "" FLOAT64_IEEE PHRControl_CM_double 0 0 -1.7E+308 1.7E+308 ECU_ADDRESS 0x0021F9D8 /end MEASUREMENT
/begin MEASUREMENT PHRControl_DW.Filter_DSTATE_ak "" FLOAT64_IEEE PHRControl_CM_double 0 0 -1.7E+308 1.7E+308 ECU_ADDRESS 0x0021F9F8 /end MEASUREMENT
/begin MEASUREMENT PHRControl_DW.Filter_DSTATE_c "" FLOAT64_IEEE PHRControl_CM_double 0 0 -1.7E+308 1.7E+308 ECU_ADDRESS 0x0021F998 /end MEASUREMENT
/begin MEASUREMENT PHRControl_DW.Filter_DSTATE_ct "" FLOAT64_IEEE PHRControl_CM_double 0 0 -1.7E+308 1.7E+308 ECU_ADDRESS 0x0021FA10 /end MEASUREMENT
/begin MEASUREMENT PHRControl_DW.Filter_DSTATE_e "" FLOAT64_IEEE PHRControl_CM_double 0 0 -1.7E+308 1.7E+308 ECU_ADDRESS 0x0021F9A8 /end MEASUREMENT
/begin MEASUREMENT PHRControl_DW.Filter_DSTATE_el "" FLOAT64_IEEE PHRControl_CM_double 0 0 -1.7E+308 1.7E+308 ECU_ADDRESS 0x0021F9E8 /end MEASUREMENT
/begin MEASUREMENT PHRControl_DW.Filter_DSTATE_f "" FLOAT64_IEEE PHRControl_CM_double 0 0 -1.7E+308 1.7E+308 ECU_ADDRESS 0x0021FA30 /end MEASUREMENT
/begin MEASUREMENT PHRControl_DW.Filter_DSTATE_fx "" FLOAT64_IEEE PHRControl_CM_double 0 0 -1.7E+308 1.7E+308 ECU_ADDRESS 0x0021FA40 /end MEASUREMENT
/begin MEASUREMENT PHRControl_DW.Filter_DSTATE_h "" FLOAT64_IEEE PHRControl_CM_double 0 0 -1.7E+308 1.7E+308 ECU_ADDRESS 0x0021FA20 /end MEASUREMENT
/begin MEASUREMENT PHRControl_DW.Filter_DSTATE_k "" FLOAT64_IEEE PHRControl_CM_double 0 0 -1.7E+308 1.7E+308 ECU_ADDRESS 0x0021F9C8 /end MEASUREMENT
/begin MEASUREMENT PHRControl_DW.Flight_SubsysRanBC "" SBYTE PHRControl_CM_int8 0 0 -128 127 ECU_ADDRESS 0x0021FD7A /end MEASUREMENT
/begin MEASUREMENT PHRControl_DW.Flight_SubsysRanBC_f "" SBYTE PHRControl_CM_int8 0 0 -128 127 ECU_ADDRESS 0x0021FD81 /end MEASUREMENT
/begin MEASUREMENT PHRControl_DW.Flight_SubsysRanBC_m "" SBYTE PHRControl_CM_int8 0 0 -128 127 ECU_ADDRESS 0x0021FD7C /end MEASUREMENT
/begin MEASUREMENT PHRControl_DW.HSW_SubsysRanBC "" SBYTE PHRControl_CM_int8 0 0 -128 127 ECU_ADDRESS 0x0021FD7F /end MEASUREMENT
/begin MEASUREMENT PHRControl_DW.Hip_Impact_Angle "" FLOAT64_IEEE PHRControl_CM_double 0 0 -1.7E+308 1.7E+308 ECU_ADDRESS 0x0021FA50 /end MEASUREMENT
/begin MEASUREMENT PHRControl_DW.Idle.Filter_DSTATE "" FLOAT64_IEEE PHRControl_CM_double 0 0 -1.7E+308 1.7E+308 ECU_ADDRESS 0x0021FDC0 /end MEASUREMENT
/begin MEASUREMENT PHRControl_DW.Idle.Filter_DSTATE_f "" FLOAT64_IEEE PHRControl_CM_double 0 0 -1.7E+308 1.7E+308 ECU_ADDRESS 0x0021FDD0 /end MEASUREMENT
/begin MEASUREMENT PHRControl_DW.Idle.Idle_SubsysRanBC "" SBYTE PHRControl_CM_int8 0 0 -128 127 ECU_ADDRESS 0x0021FDE0 /end MEASUREMENT
/begin MEASUREMENT PHRControl_DW.Idle.Integrator_DSTATE "" FLOAT64_IEEE PHRControl_CM_double 0 0 -1.7E+308 1.7E+308 ECU_ADDRESS 0x0021FDC8 /end MEASUREMENT
/begin MEASUREMENT PHRControl_DW.Idle.Integrator_DSTATE_g "" FLOAT64_IEEE PHRControl_CM_double 0 0 -1.7E+308 1.7E+308 ECU_ADDRESS 0x0021FDD8 /end MEASUREMENT
/begin MEASUREMENT PHRControl_DW.Idle_SubsysRanBC "" SBYTE PHRControl_CM_int8 0 0 -128 127 ECU_ADDRESS 0x0021FD79 /end MEASUREMENT
/begin MEASUREMENT PHRControl_DW.Idle_l.Filter_DSTATE "" FLOAT64_IEEE PHRControl_CM_double 0 0 -1.7E+308 1.7E+308 ECU_ADDRESS 0x0021FD90 /end MEASUREMENT
/begin MEASUREMENT PHRControl_DW.Idle_l.Filter_DSTATE_f "" FLOAT64_IEEE PHRControl_CM_double 0 0 -1.7E+308 1.7E+308 ECU_ADDRESS 0x0021FDA0 /end MEASUREMENT
/begin MEASUREMENT PHRControl_DW.Idle_l.Idle_SubsysRanBC "" SBYTE PHRControl_CM_int8 0 0 -128 127 ECU_ADDRESS 0x0021FDB0 /end MEASUREMENT
/begin MEASUREMENT PHRControl_DW.Idle_l.Integrator_DSTATE "" FLOAT64_IEEE PHRControl_CM_double 0 0 -1.7E+308 1.7E+308 ECU_ADDRESS 0x0021FD98 /end MEASUREMENT
/begin MEASUREMENT PHRControl_DW.Idle_l.Integrator_DSTATE_g "" FLOAT64_IEEE PHRControl_CM_double 0 0 -1.7E+308 1.7E+308 ECU_ADDRESS 0x0021FDA8 /end MEASUREMENT
/begin MEASUREMENT PHRControl_DW.Integrator_DSTATE "" FLOAT64_IEEE PHRControl_CM_double 0 0 -1.7E+308 1.7E+308 ECU_ADDRESS 0x0021F990 /end MEASUREMENT
/begin MEASUREMENT PHRControl_DW.Integrator_DSTATE_a "" FLOAT64_IEEE PHRControl_CM_double 0 0 -1.7E+308 1.7E+308 ECU_ADDRESS 0x0021FA28 /end MEASUREMENT
/begin MEASUREMENT PHRControl_DW.Integrator_DSTATE_a1 "" FLOAT64_IEEE PHRControl_CM_double 0 0 -1.7E+308 1.7E+308 ECU_ADDRESS 0x0021FA48 /end MEASUREMENT
/begin MEASUREMENT PHRControl_DW.Integrator_DSTATE_b "" FLOAT64_IEEE PHRControl_CM_double 0 0 -1.7E+308 1.7E+308 ECU_ADDRESS 0x0021F9F0 /end MEASUREMENT
/begin MEASUREMENT PHRControl_DW.Integrator_DSTATE_c "" FLOAT64_IEEE PHRControl_CM_double 0 0 -1.7E+308 1.7E+308 ECU_ADDRESS 0x0021F9D0 /end MEASUREMENT
/begin MEASUREMENT PHRControl_DW.Integrator_DSTATE_e "" FLOAT64_IEEE PHRControl_CM_double 0 0 -1.7E+308 1.7E+308 ECU_ADDRESS 0x0021FA38 /end MEASUREMENT
/begin MEASUREMENT PHRControl_DW.Integrator_DSTATE_j "" FLOAT64_IEEE PHRControl_CM_double 0 0 -1.7E+308 1.7E+308 ECU_ADDRESS 0x0021F9A0 /end MEASUREMENT
/begin MEASUREMENT PHRControl_DW.Integrator_DSTATE_l "" FLOAT64_IEEE PHRControl_CM_double 0 0 -1.7E+308 1.7E+308 ECU_ADDRESS 0x0021FA18 /end MEASUREMENT
/begin MEASUREMENT PHRControl_DW.Integrator_DSTATE_o "" FLOAT64_IEEE PHRControl_CM_double 0 0 -1.7E+308 1.7E+308 ECU_ADDRESS 0x0021F9B0 /end MEASUREMENT
/begin MEASUREMENT PHRControl_DW.Integrator_DSTATE_oc "" FLOAT64_IEEE PHRControl_CM_double 0 0 -1.7E+308 1.7E+308 ECU_ADDRESS 0x0021FA00 /end MEASUREMENT
/begin MEASUREMENT PHRControl_DW.Integrator_DSTATE_p "" FLOAT64_IEEE PHRControl_CM_double 0 0 -1.7E+308 1.7E+308 ECU_ADDRESS 0x0021F9C0 /end MEASUREMENT
/begin MEASUREMENT PHRControl_DW.Integrator_DSTATE_pp "" FLOAT64_IEEE PHRControl_CM_double 0 0 -1.7E+308 1.7E+308 ECU_ADDRESS 0x0021F9E0 /end MEASUREMENT
/begin MEASUREMENT PHRControl_DW.Knee_Impact_Angle "" FLOAT64_IEEE PHRControl_CM_double 0 0 -1.7E+308 1.7E+308 ECU_ADDRESS 0x0021FA58 /end MEASUREMENT
/begin MEASUREMENT PHRControl_DW.Load.Load_SubsysRanBC "" SBYTE PHRControl_CM_int8 0 0 -128 127 ECU_ADDRESS 0x0021FDB8 /end MEASUREMENT
/begin MEASUREMENT PHRControl_DW.Load_h.Load_SubsysRanBC "" SBYTE PHRControl_CM_int8 0 0 -128 127 ECU_ADDRESS 0x0021FD8E /end MEASUREMENT
/begin MEASUREMENT PHRControl_DW.Load_k.Load_SubsysRanBC "" SBYTE PHRControl_CM_int8 0 0 -128 127 ECU_ADDRESS 0x0021FD8C /end MEASUREMENT
/begin MEASUREMENT PHRControl_DW.SLIP_impact_angle "" FLOAT64_IEEE PHRControl_CM_double 0 0 -1.7E+308 1.7E+308 ECU_ADDRESS 0x0021FA88 /end MEASUREMENT
/begin MEASUREMENT PHRControl_DW.Simscape_Transitions "" UBYTE PHRControl_CM_logical 0 0 0 1 ECU_ADDRESS 0x0021FD8A /end MEASUREMENT
/begin MEASUREMENT PHRControl_DW.Spring_SubsysRanBC "" SBYTE PHRControl_CM_int8 0 0 -128 127 ECU_ADDRESS 0x0021FD78 /end MEASUREMENT
/begin MEASUREMENT PHRControl_DW.Thrust_SubsysRanBC "" SBYTE PHRControl_CM_int8 0 0 -128 127 ECU_ADDRESS 0x0021FD7B /end MEASUREMENT
/begin MEASUREMENT PHRControl_DW.UD_DSTATE "" FLOAT64_IEEE PHRControl_CM_double 0 0 -1.7E+308 1.7E+308 ECU_ADDRESS 0x0021F960 /end MEASUREMENT
/begin MEASUREMENT PHRControl_DW.UD_DSTATE_n "" FLOAT64_IEEE PHRControl_CM_double 0 0 -1.7E+308 1.7E+308 ECU_ADDRESS 0x0021F968 /end MEASUREMENT
/begin MEASUREMENT PHRControl_DW.Unload_SubsysRanBC "" SBYTE PHRControl_CM_int8 0 0 -128 127 ECU_ADDRESS 0x0021FD7E /end MEASUREMENT
/begin MEASUREMENT PHRControl_DW.Unload_l.Unload_SubsysRanBC "" SBYTE PHRControl_CM_int8 0 0 -128 127 ECU_ADDRESS 0x0021FD8D /end MEASUREMENT
/begin MEASUREMENT PHRControl_DW.Unload_le.Unload_SubsysRanBC "" SBYTE PHRControl_CM_int8 0 0 -128 127 ECU_ADDRESS 0x0021FD8B /end MEASUREMENT
/begin MEASUREMENT PHRControl_DW.contactTime "" FLOAT64_IEEE PHRControl_CM_double 0 0 -1.7E+308 1.7E+308 ECU_ADDRESS 0x0021FA98 /end MEASUREMENT
/begin MEASUREMENT PHRControl_DW.contactTime_l "" FLOAT64_IEEE PHRControl_CM_double 0 0 -1.7E+308 1.7E+308 ECU_ADDRESS 0x0021FAE8 /end MEASUREMENT
/begin MEASUREMENT PHRControl_DW.foot_x_flight "" FLOAT64_IEEE PHRControl_CM_double 0 0 -1.7E+308 1.7E+308 ECU_ADDRESS 0x0021FA90 /end MEASUREMENT
/begin MEASUREMENT PHRControl_DW.foot_y_flight "" FLOAT64_IEEE PHRControl_CM_double 0 0 -1.7E+308 1.7E+308 ECU_ADDRESS 0x0021FA80 /end MEASUREMENT
/begin MEASUREMENT PHRControl_DW.hasHopped "" FLOAT64_IEEE PHRControl_CM_double 0 0 -1.7E+308 1.7E+308 ECU_ADDRESS 0x0021FAA8 /end MEASUREMENT
/begin MEASUREMENT PHRControl_DW.hip_bend_factor "" FLOAT64_IEEE PHRControl_CM_double 0 0 -1.7E+308 1.7E+308 ECU_ADDRESS 0x0021FA70 /end MEASUREMENT
/begin MEASUREMENT PHRControl_DW.hip_range "" FLOAT64_IEEE PHRControl_CM_double 0 0 -1.7E+308 1.7E+308 ECU_ADDRESS 0x0021FA60 /end MEASUREMENT
/begin MEASUREMENT PHRControl_DW.is_Command1 "" ULONG PHRControl_CM_uint32 0 0 0 4294967295 ECU_ADDRESS 0x0021FCAC /end MEASUREMENT
/begin MEASUREMENT PHRControl_DW.is_active_c3_PHRControl "" UBYTE PHRControl_CM_uint8 0 0 0 255 ECU_ADDRESS 0x0021FD84 /end MEASUREMENT
/begin MEASUREMENT PHRControl_DW.is_active_c4_PHRControl "" UBYTE PHRControl_CM_uint8 0 0 0 255 ECU_ADDRESS 0x0021FD86 /end MEASUREMENT
/begin MEASUREMENT PHRControl_DW.is_active_c5_PHRControl "" UBYTE PHRControl_CM_uint8 0 0 0 255 ECU_ADDRESS 0x0021FD88 /end MEASUREMENT
/begin MEASUREMENT PHRControl_DW.is_active_c8_PHRControl "" UBYTE PHRControl_CM_uint8 0 0 0 255 ECU_ADDRESS 0x0021FD83 /end MEASUREMENT
/begin MEASUREMENT PHRControl_DW.is_c3_PHRControl "" ULONG PHRControl_CM_uint32 0 0 0 4294967295 ECU_ADDRESS 0x0021FCB0 /end MEASUREMENT
/begin MEASUREMENT PHRControl_DW.is_c4_PHRControl "" ULONG PHRControl_CM_uint32 0 0 0 4294967295 ECU_ADDRESS 0x0021FCB4 /end MEASUREMENT
/begin MEASUREMENT PHRControl_DW.is_c5_PHRControl "" ULONG PHRControl_CM_uint32 0 0 0 4294967295 ECU_ADDRESS 0x0021FCB8 /end MEASUREMENT
/begin MEASUREMENT PHRControl_DW.is_c8_PHRControl "" ULONG PHRControl_CM_uint32 0 0 0 4294967295 ECU_ADDRESS 0x0021FCA8 /end MEASUREMENT
/begin MEASUREMENT PHRControl_DW.knee_bend_factor "" FLOAT64_IEEE PHRControl_CM_double 0 0 -1.7E+308 1.7E+308 ECU_ADDRESS 0x0021FA78 /end MEASUREMENT
/begin MEASUREMENT PHRControl_DW.knee_range "" FLOAT64_IEEE PHRControl_CM_double 0 0 -1.7E+308 1.7E+308 ECU_ADDRESS 0x0021FA68 /end MEASUREMENT
/begin MEASUREMENT PHRControl_DW.landingTime "" FLOAT64_IEEE PHRControl_CM_double 0 0 -1.7E+308 1.7E+308 ECU_ADDRESS 0x0021FAB8 /end MEASUREMENT
/begin MEASUREMENT PHRControl_DW.landingTime_g "" FLOAT64_IEEE PHRControl_CM_double 0 0 -1.7E+308 1.7E+308 ECU_ADDRESS 0x0021FB28 /end MEASUREMENT
/begin MEASUREMENT PHRControl_DW.landingTime_m "" FLOAT64_IEEE PHRControl_CM_double 0 0 -1.7E+308 1.7E+308 ECU_ADDRESS 0x0021FAF0 /end MEASUREMENT
/begin MEASUREMENT PHRControl_DW.run "" FLOAT64_IEEE PHRControl_CM_double 0 0 -1.7E+308 1.7E+308 ECU_ADDRESS 0x0021FAB0 /end MEASUREMENT
/begin MEASUREMENT PHRControl_DW.sfEvent "" SLONG PHRControl_CM_int32 0 0 -2147483648 2147483647 ECU_ADDRESS 0x0021FC98 /end MEASUREMENT
/begin MEASUREMENT PHRControl_DW.sfEvent_c "" SLONG PHRControl_CM_int32 0 0 -2147483648 2147483647 ECU_ADDRESS 0x0021FC9C /end MEASUREMENT
/begin MEASUREMENT PHRControl_DW.sfEvent_e "" SLONG PHRControl_CM_int32 0 0 -2147483648 2147483647 ECU_ADDRESS 0x0021FCA0 /end MEASUREMENT
/begin MEASUREMENT PHRControl_DW.sfEvent_h "" SLONG PHRControl_CM_int32 0 0 -2147483648 2147483647 ECU_ADDRESS 0x0021FCA4 /end MEASUREMENT
/begin MEASUREMENT PHRControl_DW.sf_internal_action_state_placeholder_data "" FLOAT64_IEEE PHRControl_CM_double 0 0 -1.7E+308 1.7E+308 ECU_ADDRESS 0x0021FAC0 /end MEASUREMENT
/begin MEASUREMENT PHRControl_DW.sf_internal_action_state_placeholder_data_a "" FLOAT64_IEEE PHRControl_CM_double 0 0 -1.7E+308 1.7E+308 ECU_ADDRESS 0x0021FB50 /end MEASUREMENT
/begin MEASUREMENT PHRControl_DW.sf_internal_action_state_placeholder_data_b "" FLOAT64_IEEE PHRControl_CM_double 0 0 -1.7E+308 1.7E+308 ECU_ADDRESS 0x0021FB10 /end MEASUREMENT
/begin MEASUREMENT PHRControl_DW.sf_internal_action_state_placeholder_data_e "" FLOAT64_IEEE PHRControl_CM_double 0 0 -1.7E+308 1.7E+308 ECU_ADDRESS 0x0021FAE0 /end MEASUREMENT
/begin MEASUREMENT PHRControl_DW.sf_internal_action_state_placeholder_data_f "" FLOAT64_IEEE PHRControl_CM_double 0 0 -1.7E+308 1.7E+308 ECU_ADDRESS 0x0021FAC8 /end MEASUREMENT
/begin MEASUREMENT PHRControl_DW.sf_internal_action_state_placeholder_data_g "" FLOAT64_IEEE PHRControl_CM_double 0 0 -1.7E+308 1.7E+308 ECU_ADDRESS 0x0021FB08 /end MEASUREMENT
/begin MEASUREMENT PHRControl_DW.sf_internal_action_state_placeholder_data_gy "" FLOAT64_IEEE PHRControl_CM_double 0 0 -1.7E+308 1.7E+308 ECU_ADDRESS 0x0021FB40 /end MEASUREMENT
/begin MEASUREMENT PHRControl_DW.sf_internal_action_state_placeholder_data_h "" FLOAT64_IEEE PHRControl_CM_double 0 0 -1.7E+308 1.7E+308 ECU_ADDRESS 0x0021FAF8 /end MEASUREMENT
/begin MEASUREMENT PHRControl_DW.sf_internal_action_state_placeholder_data_i "" FLOAT64_IEEE PHRControl_CM_double 0 0 -1.7E+308 1.7E+308 ECU_ADDRESS 0x0021FB18 /end MEASUREMENT
/begin MEASUREMENT PHRControl_DW.sf_internal_action_state_placeholder_data_if "" FLOAT64_IEEE PHRControl_CM_double 0 0 -1.7E+308 1.7E+308 ECU_ADDRESS 0x0021FB38 /end MEASUREMENT
/begin MEASUREMENT PHRControl_DW.sf_internal_action_state_placeholder_data_j "" FLOAT64_IEEE PHRControl_CM_double 0 0 -1.7E+308 1.7E+308 ECU_ADDRESS 0x0021FAD8 /end MEASUREMENT
/begin MEASUREMENT PHRControl_DW.sf_internal_action_state_placeholder_data_k "" FLOAT64_IEEE PHRControl_CM_double 0 0 -1.7E+308 1.7E+308 ECU_ADDRESS 0x0021FB20 /end MEASUREMENT
/begin MEASUREMENT PHRControl_DW.sf_internal_action_state_placeholder_data_l "" FLOAT64_IEEE PHRControl_CM_double 0 0 -1.7E+308 1.7E+308 ECU_ADDRESS 0x0021FB30 /end MEASUREMENT
/begin MEASUREMENT PHRControl_DW.sf_internal_action_state_placeholder_data_n "" FLOAT64_IEEE PHRControl_CM_double 0 0 -1.7E+308 1.7E+308 ECU_ADDRESS 0x0021FAD0 /end MEASUREMENT
/begin MEASUREMENT PHRControl_DW.sf_internal_action_state_placeholder_data_n4 "" FLOAT64_IEEE PHRControl_CM_double 0 0 -1.7E+308 1.7E+308 ECU_ADDRESS 0x0021FB48 /end MEASUREMENT
/begin MEASUREMENT PHRControl_DW.sf_internal_action_state_placeholder_data_p "" FLOAT64_IEEE PHRControl_CM_double 0 0 -1.7E+308 1.7E+308 ECU_ADDRESS 0x0021FB00 /end MEASUREMENT
/begin MEASUREMENT PHRControl_DW.simTime "" FLOAT64_IEEE PHRControl_CM_double 0 0 -1.7E+308 1.7E+308 ECU_ADDRESS 0x0021FAA0 /end MEASUREMENT
/begin MEASUREMENT PHRControl_DW.temporalCounter_i1 "" UWORD PHRControl_CM_uint16 0 0 0 65535 ECU_ADDRESS 0x0021FD74 /end MEASUREMENT
/begin MEASUREMENT PHRControl_DW.temporalCounter_i1_a "" UBYTE PHRControl_CM_uint8 0 0 0 255 ECU_ADDRESS 0x0021FD85 /end MEASUREMENT
/begin MEASUREMENT PHRControl_DW.temporalCounter_i1_b "" UBYTE PHRControl_CM_uint8 0 0 0 255 ECU_ADDRESS 0x0021FD89 /end MEASUREMENT
/begin MEASUREMENT PHRControl_DW.temporalCounter_i1_m "" UBYTE PHRControl_CM_uint8 0 0 0 255 ECU_ADDRESS 0x0021FD87 /end MEASUREMENT
/begin COMPU_METHOD PHRControl_CM_double "" IDENTICAL "%15.10" "" /end COMPU_METHOD
/begin COMPU_METHOD PHRControl_CM_int32 "" IDENTICAL "%10.0" "" /end COMPU_METHOD
/begin COMPU_METHOD PHRControl_CM_int8 "" IDENTICAL "%3.0" "" /end COMPU_METHOD
/begin COMPU_METHOD PHRControl_CM_int_T "" IDENTICAL "customformat" "" /end COMPU_METHOD
/begin COMPU_METHOD PHRControl_CM_logical "" IDENTICAL "%1.0" "" /end COMPU_METHOD
/begin COMPU_METHOD PHRControl_CM_uint16 "" IDENTICAL "%5.0" "" /end COMPU_METHOD
/begin COMPU_METHOD PHRControl_CM_uint32 "" IDENTICAL "%10.0" "" /end COMPU_METHOD
/begin COMPU_METHOD PHRControl_CM_uint8 "" IDENTICAL "%3.0" "" /end COMPU_METHOD
/begin RECORD_LAYOUT Scalar_BOOLEAN FNC_VALUES 1 UBYTE COLUMN_DIR DIRECT /end RECORD_LAYOUT
/begin RECORD_LAYOUT Scalar_FLOAT64_IEEE FNC_VALUES 1 FLOAT64_IEEE COLUMN_DIR DIRECT /end RECORD_LAYOUT
/begin RECORD_LAYOUT Scalar_SBYTE FNC_VALUES 1 SBYTE COLUMN_DIR DIRECT /end RECORD_LAYOUT
/begin RECORD_LAYOUT Scalar_SLONG FNC_VALUES 1 SLONG COLUMN_DIR DIRECT /end RECORD_LAYOUT
/begin RECORD_LAYOUT Scalar_UBYTE FNC_VALUES 1 UBYTE COLUMN_DIR DIRECT /end RECORD_LAYOUT
/begin RECORD_LAYOUT Scalar_ULONG FNC_VALUES 1 ULONG COLUMN_DIR DIRECT /end RECORD_LAYOUT
/begin RECORD_LAYOUT Scalar_UWORD FNC_VALUES 1 UWORD COLUMN_DIR DIRECT /end RECORD_LAYOUT
/begin GROUP PHRControl "PHRControl" ROOT
 /begin SUB_GROUP PHRControl_Discrete_Derivative PHRControl_Discrete_Derivative1 PHRControl_Enabled_Subsystem PHRControl_ID1_Write_Hip_Data PHRControl_ID2_Write_Knee_Data PHRControl_Read_All /end SUB_GROUP
 /begin REF_CHARACTERISTIC PHRControl_cal_impl.CANSetup_P1 PHRControl_cal_impl.CANSetup_P2 PHRControl_cal_impl.CANSetup_P3 PHRControl_cal_impl.CANStatus_P1 PHRControl_cal_impl.CANStatus_P10 PHRControl_cal_impl.CANStatus_P11 PHRControl_cal_impl.CANStatus_P12 PHRControl_cal_impl.CANStatus_P13 PHRControl_cal_impl.CANStatus_P14 PHRControl_cal_impl.CANStatus_P15 PHRControl_cal_impl.CANStatus_P16 PHRControl_cal_impl.CANStatus_P17 PHRControl_cal_impl.CANStatus_P18 PHRControl_cal_impl.CANStatus_P19 PHRControl_cal_impl.CANStatus_P2 PHRControl_cal_impl.CANStatus_P20 PHRControl_cal_impl.CANStatus_P21 PHRControl_cal_impl.CANStatus_P22 PHRControl_cal_impl.CANStatus_P23 PHRControl_cal_impl.CANStatus_P24 PHRControl_cal_impl.CANStatus_P25 PHRControl_cal_impl.CANStatus_P26 PHRControl_cal_impl.CANStatus_P27 PHRControl_cal_impl.CANStatus_P28 PHRControl_cal_impl.CANStatus_P29 PHRControl_cal_impl.CANStatus_P3 PHRControl_cal_impl.CANStatus_P30 PHRControl_cal_impl.CANStatus_P31 PHRControl_cal_impl.CANStatus_P32 PHRControl_cal_impl.CANStatus_P33 PHRControl_cal_impl.CANStatus_P34 PHRControl_cal_impl.CANStatus_P4 PHRControl_cal_impl.CANStatus_P5 PHRControl_cal_impl.CANStatus_P6 PHRControl_cal_impl.CANStatus_P7 PHRControl_cal_impl.CANStatus_P8 PHRControl_cal_impl.CANStatus_P9 PHRControl_cal_impl.Constant1_Value_p PHRControl_cal_impl.Constant2_Value_hf PHRControl_cal_impl.Constant3_Value_m PHRControl_cal_impl.Constant4_Value PHRControl_cal_impl.Constant5_Value PHRControl_cal_impl.Constant6_Value PHRControl_cal_impl.Constant_Value_c PHRControl_cal_impl.DataStoreMemory12_InitialValue PHRControl_cal_impl.DataStoreMemory13_InitialValue PHRControl_cal_impl.DataStoreMemory14_InitialValue PHRControl_cal_impl.DataStoreMemory15_InitialValue PHRControl_cal_impl.DataStoreMemory16_InitialValue PHRControl_cal_impl.DataStoreMemory1_InitialValue PHRControl_cal_impl.DataStoreMemory2_InitialValue PHRControl_cal_impl.DataStoreMemory3_InitialValue PHRControl_cal_impl.DataStoreMemory4_InitialValue PHRControl_cal_impl.DataStoreMemory5_InitialValue PHRControl_cal_impl.DataStoreMemory6_InitialValue PHRControl_cal_impl.DataStoreMemory7_InitialValue PHRControl_cal_impl.DataStoreMemory8_InitialValue PHRControl_cal_impl.DataStoreMemory_InitialValue PHRControl_cal_impl.Delay1_InitialCondition PHRControl_cal_impl.Delay2_InitialCondition PHRControl_cal_impl.DiscreteTimeIntegrator_IC_m PHRControl_cal_impl.DiscreteTimeIntegrator_gainval_f PHRControl_cal_impl.Gain10_Gain PHRControl_cal_impl.Gain1_Gain PHRControl_cal_impl.Gain6_Gain PHRControl_cal_impl.Gain8_Gain PHRControl_cal_impl.Switch_Threshold PHRControl_cal_impl.hip_bend_factor PHRControl_cal_impl.hip_fuzz PHRControl_cal_impl.initHip PHRControl_cal_impl.initKnee PHRControl_cal_impl.isReady_Value PHRControl_cal_impl.knee_bend_factor PHRControl_cal_impl.knee_fuzz /end REF_CHARACTERISTIC
 /begin REF_MEASUREMENT PHRControl_B.Clock PHRControl_B.Delay1 PHRControl_B.Delay2 PHRControl_B.Diff PHRControl_B.Diff_l PHRControl_B.DiscreteTimeIntegrator PHRControl_B.Gain PHRControl_B.Gain1 PHRControl_B.Gain10 PHRControl_B.Gain2 PHRControl_B.Gain6 PHRControl_B.Gain8 PHRControl_B.Kd1 PHRControl_B.Kd2 PHRControl_B.Kp1 PHRControl_B.Kp2 PHRControl_B.MachineState PHRControl_B.MultiportSwitch PHRControl_B.RateTransition PHRControl_B.Switch PHRControl_B.T1 PHRControl_B.T2 PHRControl_B.TmpSignalConversionAtDelay1Inport1 PHRControl_B.c PHRControl_B.danger PHRControl_B.ground PHRControl_B.isReady PHRControl_B.n PHRControl_B.stop PHRControl_B.theta1 PHRControl_B.theta2 PHRControl_B.xd PHRControl_B.z PHRControl_DW.Delay1_DSTATE PHRControl_DW.Delay2_DSTATE PHRControl_DW.DiscreteTimeIntegrator_DSTATE PHRControl_DW.DiscreteTimeIntegrator_PrevResetState PHRControl_DW.Hip_Impact_Angle PHRControl_DW.Knee_Impact_Angle PHRControl_DW.SLIP_impact_angle PHRControl_DW.Simscape_Transitions PHRControl_DW.contactTime PHRControl_DW.foot_x_flight PHRControl_DW.foot_y_flight PHRControl_DW.hasHopped PHRControl_DW.hip_bend_factor PHRControl_DW.hip_range PHRControl_DW.is_Command1 PHRControl_DW.is_active_c8_PHRControl PHRControl_DW.is_c8_PHRControl PHRControl_DW.knee_bend_factor PHRControl_DW.knee_range PHRControl_DW.run PHRControl_DW.sfEvent PHRControl_DW.simTime PHRControl_DW.temporalCounter_i1 /end REF_MEASUREMENT
/end GROUP
/begin GROUP PHRControl_Discrete_Derivative "PHRControl/Discrete Derivative"
 /begin REF_CHARACTERISTIC PHRControl_cal_impl.DiscreteDerivative_ICPrevScaledInput PHRControl_cal_impl.TSamp_WtEt_n /end REF_CHARACTERISTIC
 /begin REF_MEASUREMENT PHRControl_B.Diff_l PHRControl_B.TSamp_j PHRControl_B.Uk1_d PHRControl_DW.UD_DSTATE_n /end REF_MEASUREMENT
/end GROUP
/begin GROUP PHRControl_Discrete_Derivative1 "PHRControl/Discrete Derivative1"
 /begin REF_CHARACTERISTIC PHRControl_cal_impl.DiscreteDerivative1_ICPrevScaledInput PHRControl_cal_impl.TSamp_WtEt /end REF_CHARACTERISTIC
 /begin REF_MEASUREMENT PHRControl_B.Diff PHRControl_B.TSamp PHRControl_B.Uk1 PHRControl_DW.UD_DSTATE /end REF_MEASUREMENT
/end GROUP
/begin GROUP PHRControl_Enabled_Subsystem "PHRControl/Enabled
Subsystem"
 /begin REF_CHARACTERISTIC PHRControl_cal_impl.CANWrite1_P1 PHRControl_cal_impl.CANWrite2_P1 PHRControl_cal_impl.Constant_Value_g /end REF_CHARACTERISTIC
/end GROUP
/begin GROUP PHRControl_ID1_Write_Hip_Data "PHRControl/ID1 Write Hip Data"
 /begin REF_CHARACTERISTIC PHRControl_cal_impl.CANWrite1_P1_o PHRControl_cal_impl.Constant1_Value_n PHRControl_cal_impl.Constant2_Value_g PHRControl_cal_impl.Constant3_Value PHRControl_cal_impl.Constant_Value_fg /end REF_CHARACTERISTIC
 /begin REF_MEASUREMENT PHRControl_B.BytePacking_l PHRControl_B.Gain10 PHRControl_B.Gain8 PHRControl_B.Kd1 PHRControl_B.Kp1 PHRControl_B.MultiportSwitch_l PHRControl_B.c /end REF_MEASUREMENT
/end GROUP
/begin GROUP PHRControl_ID2_Write_Knee_Data "PHRControl/ID2 Write Knee Data"
 /begin REF_CHARACTERISTIC PHRControl_cal_impl.CANWrite1_P1_l PHRControl_cal_impl.Constant1_Value_d PHRControl_cal_impl.Constant2_Value_of PHRControl_cal_impl.Constant3_Value_e PHRControl_cal_impl.Constant_Value_k /end REF_CHARACTERISTIC
 /begin REF_MEASUREMENT PHRControl_B.BytePacking PHRControl_B.Gain1 PHRControl_B.Gain6 PHRControl_B.Kd2 PHRControl_B.Kp2 PHRControl_B.MultiportSwitch_e PHRControl_B.c /end REF_MEASUREMENT
/end GROUP
/begin GROUP PHRControl_Read_All "PHRControl/Read All"
 /begin REF_CHARACTERISTIC PHRControl_cal_impl.CANRead_P1 PHRControl_cal_impl.CPR PHRControl_cal_impl.Gain2_Gain PHRControl_cal_impl.Gain_Gain PHRControl_cal_impl.I1_Y0 PHRControl_cal_impl.I2_Y0 PHRControl_cal_impl.X_Y0 PHRControl_cal_impl.Xd_Y0 PHRControl_cal_impl.Z_Y0 PHRControl_cal_impl.Zd_Y0 PHRControl_cal_impl.h PHRControl_cal_impl.r PHRControl_cal_impl.th1_Y0 PHRControl_cal_impl.th2_Y0 /end REF_CHARACTERISTIC
 /begin REF_MEASUREMENT PHRControl_B.CANRead_o1 PHRControl_B.CANUnpack1_o3 PHRControl_B.CANUnpack2_o3 PHRControl_B.CANUnpack3_o1 PHRControl_B.CANUnpack3_o2 PHRControl_B.CANUnpack3_o3 PHRControl_B.CANUnpack3_o5 PHRControl_B.CANUnpack_o1 PHRControl_B.CANUnpack_o2 PHRControl_B.CANUnpack_o3 PHRControl_B.CANUnpack_o5 PHRControl_B.Gain PHRControl_B.Gain2 PHRControl_B.ID PHRControl_B.ID_j PHRControl_B.WhileIterator PHRControl_B.pos PHRControl_B.pos_h PHRControl_B.vel PHRControl_B.vel_e PHRControl_B.x PHRControl_B.xd PHRControl_B.z PHRControl_B.zd PHRControl_DW.CANUnpack1_ModeSignalID PHRControl_DW.CANUnpack1_StatusPortID PHRControl_DW.CANUnpack2_ModeSignalID PHRControl_DW.CANUnpack2_StatusPortID PHRControl_DW.CANUnpack3_ModeSignalID PHRControl_DW.CANUnpack3_StatusPortID PHRControl_DW.CANUnpack_ModeSignalID PHRControl_DW.CANUnpack_StatusPortID /end REF_MEASUREMENT
/end GROUP
/end MODULE
/end PROJECT
